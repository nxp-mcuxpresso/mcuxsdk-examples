## display_examples/sd_jpeg/Kconfig
```kconfig
# Copyright 2025 NXP
#
# SPDX-License-Identifier: BSD-3-Clause

menu "Project Settings"

config APP_FB_NUM
    int "Number of frame buffers"
    default 3
    help
        For better performance, by default, three frame buffers are used in this demo.
        If the memory region is not large enough, user can define to 2 to override
        this value.
        No prefix in generated macro

endmenu

source "${SdkRootDirPath}/Kconfig.mcuxpresso"
```

## driver_examples/edma3/interleave_transfer/Kconfig
```kconfig
# Copyright 2025 NXP
#
# SPDX-License-Identifier: BSD-3-Clause

menu "Project Settings"

config BUFFER_LENGTH
    int "Number of buffer length"
    default 16
    help
        No prefix in generated macro

config HALF_BUFFER_LENGTH
    int "Number of half buffer length"
    default 8
    help
        This value should be half of BUFFER_LENGTH
        No prefix in generated macro

endmenu

source "${SdkRootDirPath}/Kconfig.mcuxpresso"
```

## driver_examples/i3c/polling_b2b_transfer/slave/Kconfig
```kconfig
# Copyright 2025 NXP
#
# SPDX-License-Identifier: BSD-3-Clause

menu "Project Settings"

config EXAMPLE_I3C_HDR_SUPPORT
    bool "I3C HDR transfer case support"
    default y
    help
        No prefix in generated macro

endmenu

config MCUX_COMPONENT_driver.i3c
    default y
    depends on MCUX_HAS_COMPONENT_driver.i3c

config MCUX_COMPONENT_driver.dsc_i3c
    default y
    depends on MCUX_HAS_COMPONENT_driver.dsc_i3c

source "${SdkRootDirPath}/Kconfig.mcuxpresso"
```

## ecat_examples/dual_cores_servo_motor/primary/Kconfig.sysbuild
```kconfig
#
# Copyright 2025 NXP
#
# SPDX-License-Identifier: BSD-3-Clause

config secondary_board
    string
    default "$(board)"

config secondary_toolchain
    string
    default "$(toolchain)"

config secondary_core_id
    string
    default "cm7_core0" if $(board) = "imx943evk" && $(core_id) = "cm33_core1"

# This is for internal board support
osource "${SdkRootDirPath}/${board_root}/${board}/Kconfig.sysbuild"
```

## eiq_examples/Kconfig.sysbuild
```kconfig
#
# Copyright 2025 NXP
#
# SPDX-License-Identifier: BSD-3-Clause

config dsp_board
    string
    default "$(board)"

config dsp_toolchain
    string
    default "xtensa"

config secondary_board
    string
    default "$(board)"

config secondary_toolchain
    string
    default "$(toolchain)"

config secondary_config
    string
    default "debug" if $(config) = "flexspi_nor_debug"
    default "release" if $(config) = "flexspi_nor_release"
    default "debug" if $(config) = "flexspi_nor_sdram_debug"
    default "release" if $(config) = "flexspi_nor_sdram_release"
    default "debug" if $(config) = "debug"
    default "release" if $(config) = "release"

# This is for internal board support
osource "${SdkRootDirPath}/${board_root}/${board}/Kconfig.sysbuild"

# This is for external custom board support
osource "${CUSTOM_BOARD_ROOT}/${board}/Kconfig.sysbuild"
```

## el2go_examples/el2go_blob_test/el2go_blob_test/Kconfig
```kconfig
# Copyright 2025 NXP
#
# SPDX-License-Identifier: BSD-3-Clause
rsource "${SdkRootDirPath}/Kconfig.mcuxpresso"

mainmenu "EL2GO Blob Test Configuration"

config RUN_VERIFIED_ONLY
    default y
    bool "Only run testcases that are expected to pass"
```

## el2go_examples/el2go_csr/el2go_csr/Kconfig
```kconfig
# Copyright 2026 NXP
#
# SPDX-License-Identifier: BSD-3-Clause
rsource "${SdkRootDirPath}/Kconfig.mcuxpresso"

mainmenu "EL2GO CSR Configuration"
```

## el2go_examples/el2go_import_blob/el2go_import_blob/Kconfig
```kconfig
# Copyright 2025 NXP
#
# SPDX-License-Identifier: BSD-3-Clause
rsource "${SdkRootDirPath}/Kconfig.mcuxpresso"

mainmenu "EL2GO Import Blob Configuration"

config BLOB_AREA
    default 0x084B0000
    hex "The start address of the area where the blobs should be read from"
    help
        No prefix in generated macro

config BLOB_AREA_SIZE
    default 8192
    int "The size of the area where the blobs should be read from in bytes"
    help
        No prefix in generated macro

config VALIDATE_PSA_IMPORT_MASTER_KEY
    bool "If the imported blobs should be validated by PSA operations for Master key operations"
    help
        No prefix in generated macro

config VALIDATE_PSA_IMPORT_KEY_PAIR
    bool "Config can be used if the imported blobs need to be validated by KEY pair operations"
    help
        No prefix in generated macro

config VALIDATE_PSA_IMPORT_CERT
    bool "Config can be used if the imported blobs need to parse the x509 certificate"
    help
        No prefix in generated macro
```

## lvgl_examples/lvgl_sdk/Kconfig
```kconfig
# Copyright 2024-2025 NXP
# SPDX-License-Identifier: BSD-3-Clause

menuconfig MCUX_COMPONENT_middleware.lvgl
    bool "LVGL"
    imply MCUX_COMPONENT_middleware.lvgl.template

if MCUX_COMPONENT_middleware.lvgl

    # For MCUX SDK integration.
    # In MCUX SDK, the Kconfig string is translate macro with no quote,
    # to generate macro with quote, the Kconfig string value should be
    # set as "\"string\"".
    config LV_OS_CUSTOM_INCLUDE
        default "\"stdint.h\""

    config LV_DRAW_SW_ASM_CUSTOM_INCLUDE
        default "\"\""

    config LV_ASSERT_HANDLER_INCLUDE
        default "\"assert.h\""

    config LV_GLOBAL_CUSTOM_INCLUDE
        default "\"lv_global.h\""

    config LV_TXT_BREAK_CHARS
        default "\" ,.;:-_)}\""

    config LV_PROFILER_INCLUDE
        default "\"lvgl/src/misc/lv_profiler_builtin.h\""

    config LV_TXT_COLOR_CMD
        default "\"#\""

    config LV_MONDAY_STR
        default "\"Mo\""
    config LV_TUESDAY_STR
        default "\"Tu\""
    config LV_WEDNESDAY_STR
        default "\"We\""
    config LV_THURSDAY_STR
        default "\"Th\""
    config LV_FRIDAY_STR
        default "\"Fr\""
    config LV_SATURDAY_STR
        default "\"Sa\""
    config LV_SUNDAY_STR
        default "\"Su\""

    # Kconfig default settings
    config LV_USE_DRAW_VG_LITE
        default y if MCUX_COMPONENT_middleware.vglite

    config LV_USE_PXP
        default y if MCUX_COMPONENT_driver.pxp

    config LV_USE_DRAW_PXP
        default n if LV_USE_DRAW_VG_LITE

    config LV_DEMO_BENCHMARK_ALIGNED_FONTS
        default y if LV_USE_DRAW_VG_LITE

    config LV_DRAW_BUF_ALIGN
        default 32 if LV_USE_PXP

    osource "${SdkRootDirPath}/middleware/lvgl/Kconfig"

    config LV_ATTRIBUTE_MEM_ALIGN
        string "LV_ATTRIBUTE_MEM_ALIGN"
        default ""
        help
            Will be added where memories needs to be aligned
            (with -Os data might not be aligned to boundary by default).
            E.g. __attribute__((aligned(LV_ATTRIBUTE_MEM_ALIGN_SIZE)))

    config LV_ATTRIBUTE_LARGE_CONST
        string "LV_ATTRIBUTE_LARGE_CONST"
        default ""
        help
            Attribute to mark large constant arrays for example font's bitmaps.
            E.g. __attribute__((section("DataQuickAccess")))

    config LV_ATTRIBUTE_LARGE_RAM_ARRAY
        string "LV_ATTRIBUTE_LARGE_RAM_ARRAY"
        default ""
        help
            Attribute to mark large ram arrays for example font's bitmaps.
            E.g. __attribute__((section(\"NonCacheable.init\")))

    config LV_SYSMON_GET_IDLE
        string "LV_SYSMON_GET_IDLE"
        depends on LV_USE_SYSMON
        default "lv_timer_get_idle"
        help
            Get the idle percentage.
            E.g. uint32_t my_get_idle(void);

endif

menu "LVGL application layers"

    config MCUX_COMPONENT_middleware.lvgl.template
        bool "LVGL project template"

    menu "Demos"

        config MCUX_COMPONENT_middleware.lvgl.demo.common
            bool "common"
            imply MCUX_COMPONENT_middleware.lvgl

        config MCUX_COMPONENT_middleware.lvgl.demo.transform
            bool "transform"
            imply MCUX_COMPONENT_middleware.lvgl

        config MCUX_COMPONENT_middleware.lvgl.demo.multilang
            bool "multilang"
            imply MCUX_COMPONENT_middleware.lvgl

        config MCUX_COMPONENT_middleware.lvgl.demo.flex_layout
            bool "flex_layout"
            imply MCUX_COMPONENT_middleware.lvgl

        config MCUX_COMPONENT_middleware.lvgl.demo.scroll
            bool "scroll"
            imply MCUX_COMPONENT_middleware.lvgl

        config MCUX_COMPONENT_middleware.lvgl.demo.music
            bool "music"
            imply MCUX_COMPONENT_middleware.lvgl

        config MCUX_COMPONENT_middleware.lvgl.demo.keypad_encoder
            bool "keypad_encoder"
            imply MCUX_COMPONENT_middleware.lvgl

        config MCUX_COMPONENT_middleware.lvgl.demo.benchmark
            bool "benchmark"
            imply MCUX_COMPONENT_middleware.lvgl
            imply MCUX_COMPONENT_middleware.lvgl.demo.transform
            imply MCUX_COMPONENT_middleware.lvgl.demo.widgets
            imply MCUX_COMPONENT_middleware.lvgl.demo.common

        config MCUX_COMPONENT_middleware.lvgl.demo.stress
            bool "stress"
            imply MCUX_COMPONENT_middleware.lvgl
            imply MCUX_COMPONENT_middleware.lvgl.demo.common

        config MCUX_COMPONENT_middleware.lvgl.demo.widgets
            bool "widgets"
            imply MCUX_COMPONENT_middleware.lvgl
            imply MCUX_COMPONENT_middleware.lvgl.demo.common

        config MCUX_COMPONENT_middleware.lvgl.src.libs.thorvg
            bool "thorvg"
            imply MCUX_COMPONENT_middleware.lvgl
    endmenu

endmenu
```

## lvgl_examples/lvgl_sdk/lvgl_support/flexcomm_spi_lcd_par_s035/Kconfig.lvgl_support
```kconfig
if MCUX_PRJSEG_module.board.lvgl

    config LVGL_SUPPORT_VDB_COUNT
        int "LVGL virtual buffer count"
        default 2
        range 1 2

endif

config MCUX_PRJSEG_module.board.lvgl
    select MCUX_COMPONENT_driver.dbi_lpc_spi_dma
    select MCUX_COMPONENT_driver.flexcomm_i2c
    select MCUX_COMPONENT_driver.gt911
    select MCUX_COMPONENT_driver.inputmux
    select MCUX_COMPONENT_driver.inputmux_connections
    select MCUX_COMPONENT_driver.lpc_dma
    select MCUX_COMPONENT_driver.pint
    select MCUX_COMPONENT_driver.st7796s
```

## lvgl_examples/lvgl_sdk/lvgl_support/rt2xxx/Kconfig.lvgl_support
```kconfig
config MCUX_PRJSEG_module.board.lvgl
    select MCUX_COMPONENT_driver.gt911
    select MCUX_COMPONENT_driver.lpi2c
    select MCUX_PRJSEG_module.board.display_support
```

## multicore_examples/rpmsg_lite_pingpong_dsp/Kconfig
```kconfig
#
# Copyright 2025 NXP
#
# SPDX-License-Identifier: BSD-3-Clause

rsource "../../../Kconfig.mcuxpresso"

menu "RPMSG-Lite Ping-Pong DSP Config"

config RPMSG_LITE_PINGPONG_SWITCH_COMM
    bool "RPMSG-Lite PingPong DSP Switch Communication"
    default n
    help
        Set this to Switch Example communication channels.
        When Set to `n` the CM33_0 will communicate with the Hifi4 and
        CM33_1 will communicate with the Hifi1 by default.
        When Set to `y` the CM33_0 will communicate with the Hifi1 and
        CM33_1 will communicate with the Hifi4.

endmenu
```

## multicore_examples/rpmsg_lite_pingpong_dsp/primary/Kconfig.sysbuild
```kconfig
#
# Copyright 2025 NXP
#
# SPDX-License-Identifier: BSD-3-Clause

config dsp_board
    string
    default "$(board)"

config dsp_toolchain
    string
    default "xtensa"

source "${SdkRootDirPath}/${board_root}/${board}/Kconfig.sysbuild"
```

## multicore_examples/rpmsg_lite_pingpong_tzm/Kconfig.prj
```kconfig
# Copyright 2025 NXP
#
# SPDX-License-Identifier: BSD-3-Clause

menu "Project Settings"

config SECONDARY_CORE_USES_TZM
    bool "Is TZM allowed for secondary core?"
    default y
    help
        Does the secondary core use TrustZone-M, i.e. does it run both the secure or non-secure projects?

endmenu

source "${SdkRootDirPath}/Kconfig.mcuxpresso"
```

## serial_mux_examples/console_mux/Kconfig
```kconfig
# Copyright 2026 NXP
#
# SPDX-License-Identifier: BSD-3-Clause

menu "Project Settings"
endmenu

source "${SdkRootDirPath}/Kconfig.mcuxpresso"
```
