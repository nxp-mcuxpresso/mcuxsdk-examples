#!armclang --target=arm-arm-none-eabi -march=armv8-m.main -E -x c
/*
** ###################################################################
**     Processors:          RW612ETA2I
**                          RW612HNA2I
**                          RW612UKA2I
**
**     Compiler:            Keil ARM C/C++ Compiler
**     Reference manual:    RW61X User manual Rev. 0.95, June 2022
**     Version:             rev. 1.0, 2021-03-16
**     Build:               b231201
**
**     Abstract:
**         Linker file for the Keil ARM C/C++ Compiler

**     Copyright 2025 NXP
**     SPDX-License-Identifier: BSD-3-Clause
**
**     http:                 www.nxp.com
**     mail:                 support@nxp.com
**
** ###################################################################
*/


/* Sizes */
#if (defined(__stack_size__))
  #define Stack_Size                   __stack_size__
#else
  #define Stack_Size                   0x0800
#endif

#if (defined(__heap_size__))
  #define Heap_Size                    __heap_size__
#else
  #define Heap_Size                    0x0400
#endif

#define  m_interrupts_start            0x08001000
#define  m_interrupts_size             0x00000400

#define  m_text_start                  0x08001400
#define  m_text_size                   0x001FEC00

#define  coredump_ram_start            0x20000000
#define  coredump_ram_size             0x00000200

#define  m_data_start                  (coredump_ram_start + coredump_ram_size)
#define  m_data_size                   (0x00130000 - coredump_ram_size)

#define  m_flash_start                 0x08000000

LR_m_flash_conf m_flash_start m_interrupts_start-m_flash_start {
  FLASH_CONFIG +0 { ; load address = execution address
    * (.flash_conf)
  }
}

LR_m_interrupts m_interrupts_start m_text_start+m_text_size-m_interrupts_start {
  VECTOR_ROM m_interrupts_start FIXED m_interrupts_size { ; load address = execution address
    * (.isr_vector,+FIRST)
  }

  ER_m_text m_text_start FIXED m_text_size { ; load address = execution address
      .ANY(+RO)
  }

  /* Gen Hal init. */
  ER_m_init_start +0 EMPTY 0 {}

  ER_m_init_early +0 {
    * (.z_init_EARLY?_*)
  }
  ER_m_init_early_1 +0 {
    * (.z_init_EARLY??_*)
  }

  ER_m_init_pre_kernel_1 +0 {
    * (.z_init_PRE_KERNEL_1?_*)
  }
  ER_m_init_pre_kernel_1_1 +0 {
    * (.z_init_PRE_KERNEL_1??_*)
  }

  ER_m_init_pre_kernel_2 +0 {
    * (.z_init_PRE_KERNEL_2?_*)
  }
  ER_m_init_pre_kernel_2_1 +0 {
    * (.z_init_PRE_KERNEL_2??_*)
  }

  ER_m_init_post_kernel +0 {
    * (.z_init_POST_KERNEL?_*)
  }
  ER_m_init_post_kernel_1 +0 {
    * (.z_init_POST_KERNEL??_*)
  }

  ER_m_init_application +0 {
    * (.z_init_APPLICATION?_*)
  }
  ER_m_init_application_1 +0 {
    * (.z_init_APPLICATION??_*)
  }

  ER_m_init_end +0 EMPTY 0 {}

  /* Gen Hal deferred_init_list */
  ER_m_deferred_init_list_start +0 EMPTY 0 {}
  ER_m_deferred_init_list +0 {
     * (.z_deferred_init*)
  }
  ER_m_deferred_init_list_end +0 EMPTY 0 {}

  /* Gen Hal device_area */
  ER_m_device_list_start +0 ALIGN 4 EMPTY 0 {}
  ER_m_device_area +0 ALIGNALL 4 {
     * (._device.static.*_?_*)
  }
  ER_m_device_area_1 +0 ALIGNALL 4 {
     * (._device.static.*_??_*)
     flash_mcux_flexspi_nor.o(._device.static.*_??_*)
  }
  ER_m_device_list_end +0 EMPTY 0 {}

  /* Gen Hal device_deps */
  ER_m_device_deps_start +0 EMPTY 0 {}
  ER_m_device_deps +0 { ; load address = execution address
     * (.__device_deps_pass2*)
  }
  ER_m_device_deps_end +0 EMPTY 0 {}

  Coredump_ram_start coredump_ram_start ALIGN 4 EMPTY 0 {}
  Coredump_ram +0 ALIGNALL 4 { ; COREDUMP data
    * (.z_devstate)
    * (.z_devstate.*)
  }
  Coredump_ram_end +0 EMPTY 0 {}

  RW_m_data m_data_start ALIGN 4 m_data_size-Stack_Size-Heap_Size { ; RW data
    * (CodeQuickAccess)
    * (DataQuickAccess)
    .ANY (+RW +ZI)
    flexspi_clock_setup.o(RamFunction)
    flexspi_clock_setup.o(+RO +RW +ZI)
    fsl_flexspi.o (+RO +RW +ZI)
    fsl_clock.o (+RO +RW +ZI)
    fsl_reset.o (+RO +RW +ZI)
    fsl_cache.o (+RO +RW +ZI)
    memset.o(+RO +RW +ZI)
    memcpy.o(+RO +RW +ZI)
    flash_mcux_flexspi_nor.o(+CODE +RW +ZI)
    flash_mcux_flexspi_nor.o (.rodata*)
    jesd216.o(+RO)
    memc_mcux_flexspi.o(+CODE +RW +ZI)
    memc_mcux_flexspi.o (.rodata*)
    device.o(+RO +RW +ZI)
    zephyr_mcux_helper.o(+RO)
    clock_control_mcux_syscon.o(+CODE +RW +ZI)
    clock_control_mcux_syscon.o(.rodata*)
  }


  ARM_LIB_HEAP +0 EMPTY Heap_Size {    ; Heap region growing up
  }
  ARM_LIB_STACK m_data_start+m_data_size EMPTY -Stack_Size { ; Stack region growing down
  }
}

LR_m_boot +0 {
  ER_m_boot +0 { ; load address = execution address
    * (InRoot$$Sections)
  }
}
