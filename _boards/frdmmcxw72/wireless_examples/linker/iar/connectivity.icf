/*
** ###################################################################
**     Processors:          KW47B42Z83AFTA_cm33_core0
**                          KW47B42Z96FTA_cm33_core0
**                          KW47B42Z97AFTA_cm33_core0
**                          KW47B42ZB2AFTA_cm33_core0
**                          KW47B42ZB3AFTA_cm33_core0
**                          KW47B42ZB6AFTA_cm33_core0
**                          KW47B42ZB7AFTA_cm33_core0
**                          MCXW727CAFTA_cm33_core0
**                          MCXW727AAFTA_cm33_core0
**                          MCXW727DAFTA_cm33_core0
**
**     Compiler:            IAR ANSI C/C++ Compiler for ARM
**
**     Abstract:
**         Linker file for the IAR ANSI C/C++ Compiler for ARM for Connectivity Demo Applications
**
**     Copyright 2024-2026 NXP
**
**     SPDX-License-Identifier: BSD-3-Clause
**
**     http:                 www.nxp.com
**     mail:                 support@nxp.com
**
** ###################################################################
*/

/* Linker script for BLE or/and OpenThread applications
 * This is a generic layout with optional region that could be needed for BLE or OpenThread applications.
 * This Linker file can be used for BLE/OT combo applications. */

/*************************** FLASH LAYOUT ***********************************

                             0x001F_FFFF    m_flash_end
                    - - - +---------------+ - - - - - - - -
                          |               | m_ot_settings_end
                          |  OpenThread   |
                          |   Settings*   | Enable with gUseOtSettingsStorage_d=1
                          |               |
                          |               | m_ot_settings_start
                    - - - +---------------+ - - - - - - - -
                          |               | NV_STORAGE_END_ADDRESS
                          |  NV_STORAGE*  |
                          |               | Enable with gUseNVMLink_d=1
                          |               |
                          |               | NV_STORAGE_START_ADDRESS
                    - - - +---------------+ - - - - - - - -
                          |               | INT_STORAGE_END
                          |               |
                          |               |
                          |               |
                          | OTAP Internal | Enable with gUseInternalStorageLink_d=1
                          |      Storage* |
                          |               |
                          |               |
                          |               |
                          |               | INT_STORAGE_START
                    - - - +---------------+ - - - - - - - -
                          |               | m_text_end
                          |               |
                          |               |
                          |               |
                          | Application** |
                          |               |
                          |               |
                          |               |
                          |               | m_text_start
                    - - - +---------------+ - - - - - - - -
                          |   Interrupt   | m_interrupts_end
                          |    Vectors    |
                          |               | m_interrupts_start
                    - - - +---------------+ - - - - - - - -
                             0x0000_0000

        * - These sections are optional for certain applications
       ** - Application will occupy all the free space available
*****************************************************************************/

/* Symbols Flash checks */

if (!isdefinedsymbol(gUseNVMLink_d)) {
    define symbol gUseNVMLink_d = 0;
}

if (!isdefinedsymbol(gEraseNVMLink_d)) {
    define symbol gEraseNVMLink_d = 0;
}

if (!isdefinedsymbol(gUseInternalStorageLink_d)) {
    define symbol gUseInternalStorageLink_d = 0;
}

if (!isdefinedsymbol(gUseOtSettingsStorage_d)) {
    define symbol gUseOtSettingsStorage_d = 0;
}

if (!isdefinedsymbol(gFlashNbuImage_d)) {
    define symbol gFlashNbuImage_d = 0;
}

/* By default, gFlashNbuLogging_d is not used. */
if (!isdefinedsymbol(gFlashNbuLogging_d)) {
    define symbol gFlashNbuLogging_d = 0;
}

if (!isdefinedsymbol(gEnableCoverage_d)) {
    define symbol gEnableCoverage_d = 0;
}

/* Symbols RAM checks */


/* Enable this flag to move application data to 0x2004000, second SRAM bank except HADM buffer
     and warmboot stack. The first SRAM bank is used by ROM code on cold or warm boot  */
if (!isdefinedsymbol(gLowpowerPowerDownEnable_d)) {
    define exported symbol gLowpowerPowerDownEnable_d = 0;
}
else {
    export symbol gLowpowerPowerDownEnable_d;
}

if (!isdefinedsymbol(gReserveCeRam_d)) {
    define exported symbol gReserveCeRam_d = 0;
}

/********************************************** FLASH **********************************************/

/* Flash defines */
define symbol m_flash_start                             = 0x00000000;
define symbol m_flash_size                              = 0x200000;
define symbol m_flash_end                               = m_flash_start + m_flash_size - 1;
define symbol m_sector_size                             = 0x2000;
define symbol m_vector_table_size                       = 0x400;   /* define is used for warmboot stack size too */

/* interrupt vectors region */
define symbol m_interrupts_start                        = m_flash_start;
define symbol m_interrupts_end                          = m_interrupts_start + m_vector_table_size - 1;
define exported symbol __VECTOR_TABLE                   = m_interrupts_start;

/* OpenThread settings */
define exported symbol m_ot_settings_page_size          = m_sector_size;
if(gUseOtSettingsStorage_d) {
    define exported symbol m_ot_settings_page_count     = 2;
    define exported symbol m_ot_settings_size           = m_ot_settings_page_size * m_ot_settings_page_count;
}
else {
    define exported symbol m_ot_settings_page_count     = 0;
    define exported symbol m_ot_settings_size           = 0;
}
define exported symbol m_ot_settings_start              = m_flash_end - m_ot_settings_size + 1;
define exported symbol m_ot_settings_end                = m_flash_end;

/* NVM storage */
if ( gUseNVMLink_d ) {
    if (isdefinedsymbol(gNVMSectorCountLink_d)) {
        define exported symbol NV_STORAGE_MAX_SECTORS   = gNVMSectorCountLink_d;
    }
    else {
        define exported symbol NV_STORAGE_MAX_SECTORS   = 4;
    }
}
else {
    define exported symbol NV_STORAGE_MAX_SECTORS       = 0;
}
define exported symbol NV_STORAGE_SECTOR_SIZE           = m_sector_size;
define exported symbol NV_STORAGE_END_ADDRESS           = m_ot_settings_start - 1;
define exported symbol NV_STORAGE_SIZE                  = (NV_STORAGE_MAX_SECTORS * NV_STORAGE_SECTOR_SIZE);
define exported symbol NV_STORAGE_START_ADDRESS         = NV_STORAGE_END_ADDRESS - NV_STORAGE_SIZE + 1;

/* OTA */
define exported symbol INT_STORAGE_END                  = NV_STORAGE_START_ADDRESS - 1;
if (gUseInternalStorageLink_d) {
    define exported symbol INT_STORAGE_SIZE             = m_sector_size * ( ((INT_STORAGE_END + 1 - m_interrupts_start)/2)/m_sector_size +1);
}
else {
    define exported symbol INT_STORAGE_SIZE             = 0;
}
define exported symbol INT_STORAGE_START                = INT_STORAGE_END - INT_STORAGE_SIZE + 1;
define exported symbol INT_STORAGE_SECTOR_SIZE          = m_sector_size;

/* firmware region */
define exported symbol m_text_start                     = m_interrupts_end  + 1;
define exported symbol m_text_end                       = INT_STORAGE_START - 1;

/*************************** RAM LAYOUT ***********************************
Default address values are indicated between brackets they can be overridden if necessary by linker flags
                             RAM LAYOUT when gReserveCeRam_d = 0

             0x20039FFF                     m_ram1_end
                    - - - +---------------+ - - - - - - - -
            m_data1_end   |               | __HEAP_end__
                          |               |
                          |               |
                          |               |
                          |...............| __HEAP_start__
                          |               |
                          .     Data1     .
                          .               .
            m_data1_start |               |
                    - - - +---------------+ - - - - - - - -
                          |               | m_interrupts_ram_end
                          | vector table  |
                          |               |
            (0x20004E00)  |               | m_interrupts_ram_start
                    - - - +---------------+ - - - - - - - -
                          |               | m_cstack_end
                          |    CStack     |
            (0x20004400)  |               | m_cstack_start
                    - - - +---------------+ - - - - - - - -
                          |               | m_warmboot_stack_end
                          |   Warm stack  |
            (0x20004000)  |               | m_warmboot_stack_start
                    - - - +---------------+ - - - - - - - -
                          |               | m_ram1_reserved_end
                          |    Reserved   |
                          |               | m_ram1_reserved_start
                    - - - +---------------+ - - - - - - - -
              0x20000000  |               | m_ram1_start

                             RAM LAYOUT when gReserveCeRam_d = 1

             0x20039FFF                     m_ram1_end
                    - - - +---------------+ - - - - - - - -
            (0x20039FFF)  |               | m_upper_data1_end __HEAP_end__
                          |               |
                          |               |
                          |               |
            (0x2002D000)  |               | m_upper_data1_start __HEAP_start__ 
                    - - - +---------------+ - - - - - - - -
            (0x2002CFFF)  |               | m_ce_heap_end
                          |               |
                          |               |
                          |               |
            (0x20029640)  |               | m_ce_heap_start
                    - - - +---------------+ - - - - - - - -
            (0x2002963F)  |               | m_ce_ctrl_end
                          |               |
                          |               |
                          |               |
            (0x20029000)  |               | m_ce_ctrl_start
                    - - - +---------------+ - - - - - - - -
            (0x20028FFF)  |               | m_ce_stack_end
                          |               |
                          |               |
                          |               |
            (0x20028000)  |               | m_ce_stack_start
                    - - - +---------------+ - - - - - - - -
            (0x20027FFF)  |               | m_ce_image_end
                          |               |
                          |               |
                          |               |
            (0x20020000)  |               | m_ce_image_start
                    - - - +---------------+ - - - - - - - -
            m_data1_end   |               |
                          |               |
                          |               |
                          |...............| 
                          |               |
                          .     Data1     .
                          .               .
            m_data1_start |               |
                    - - - +---------------+ - - - - - - - -
                          |               | m_interrupts_ram_end
                          | vector table  |
                          |               |
            (0x20004E00)  |               | m_interrupts_ram_start
                    - - - +---------------+ - - - - - - - -
                          |               | m_cstack_end
                          |    CStack     |
            (0x20004400)  |               | m_cstack_start
                    - - - +---------------+ - - - - - - - -
                          |               | m_warmboot_stack_end
                          |   Warm stack  |
            (0x20004000)  |               | m_warmboot_stack_start
                    - - - +---------------+ - - - - - - - -
                          |               | m_ram1_reserved_end
                          |    Reserved   |
                          |               | m_ram1_reserved_start
                    - - - +---------------+ - - - - - - - -
              0x20000000  |               | m_ram1_start

**************************************************************************************************/

/********************************************** RAM **********************************************/

/* RAM defines */
define symbol m_ram0_start                              = 0x14000000;
define symbol m_ram0_end                                = 0x14007FFF;
define symbol m_ram1_start                              = 0x20000000;
define symbol m_ram1_end                                = 0x20039FFF;

/* This region is used by bootrom when exiting power down modes */
define symbol m_ram1_reserved_start                     = m_ram1_start;
define symbol m_ram_vector_table_size                   = m_vector_table_size;

if (!isdefinedsymbol(m_ram1_reserved_end))
{
    define symbol m_ram1_reserved_end                       = 0x20003FFF;
}

if (!isdefinedsymbol(__stack_size__))
{
    define symbol __stack_size__                        = 0x0A00;
}

if (!isdefinedsymbol(__heap_size__))
{
    define symbol __heap_size__                         = 0x0A00;
}

/* data0 region */
define symbol m_data0_start                             = m_ram0_start;
define symbol m_data0_end                               = m_ram0_end;

/* warmboot stack region */
if (gLowpowerPowerDownEnable_d) {
  define symbol m_warmboot_stack_size                   = 0x400;
  define symbol m_warmboot_stack_start                  = m_ram1_reserved_end + 1;
}
else
{
  /* In case PowerDown is not enabled, the warmboot stack is not used
   * and the bootrom won't used the Reserved RAM region */
  define symbol m_warmboot_stack_size                   = 0;
  define symbol m_warmboot_stack_start                  = m_ram1_start;
}

define exported symbol m_warmboot_stack_end             = m_warmboot_stack_start + m_warmboot_stack_size - 1;

/* stack region */
if (!isdefinedsymbol(m_cstack_start))
{
    define exported symbol m_cstack_start                   = m_warmboot_stack_end + 1;
}
define exported symbol m_cstack_end                     = m_cstack_start + __stack_size__ - 1;

/* Ram vector table */
define symbol m_interrupts_ram_start                    = m_cstack_end + 1;
define symbol m_interrupts_ram_end                      = m_interrupts_ram_start + m_ram_vector_table_size - 1;
define exported symbol __VECTOR_RAM                     = m_interrupts_ram_start;
define exported symbol __RAM_VECTOR_TABLE_SIZE          = m_ram_vector_table_size;

if ( gReserveCeRam_d && (m_ram1_end < 0x20039FFF))
{
  error "LCE is not supported on this part!";
}

/* data1 region */
define symbol m_data1_start                             = m_interrupts_ram_end + 1;

if (gReserveCeRam_d)
{
/* data1 region will end before CE data region */
    define symbol m_data1_end                          = 0x2001FFFF;
}
else
{
/* data1 is up to ram1 end */
    define symbol m_data1_end                           = m_ram1_end;
}

/* Heap region start and end address symbols used by usual memory allocator (malloc(), free())
   Not used by fsl_component_memory_manager_light component, __heap_size__ can be NULL */
define exported symbol __HEAP_start__                   = m_ram1_end - __heap_size__;
define exported symbol __HEAP_end__                     = m_ram1_end;

define exported symbol firmware_ram_upper_limit         = m_ram1_end;
define exported symbol firmware_ram_lower_limit         = m_cstack_start;

/* The layout of the RAM and the region of each section have been reorganized in order
 * to optimize the RAM banks in retention. The heap at the top, we do not need to retain
 * banks upper of the last address used by the heap. */

/********************************************** PLACEMENT **********************************************/

/* define all regions */
define region VECT_region               = mem:[from m_interrupts_start to m_interrupts_end];
define region TEXT_region               = mem:[from m_text_start to m_text_end];
define region DATA0_region              = mem:[from m_data0_start to m_data0_end];
define region DATA1_region              = mem:[from m_data1_start to m_data1_end];
define region CSTACK_region             = mem:[from m_cstack_start to m_cstack_end];

/* define blocks */
define block VECT                                                   { readonly section .intvec };
define block TEXT                                                   { readonly };

/* Use DATA1_region for all connectivity code - DATA0_Region is 32K, can be used for customer specific code */
define block DATA0                                                  {  };
if (gReserveCeRam_d)
{
/* .heap section is placed after the memory used by LCE. The extended heap is the last section placed in DATA1 */
    define block DATA1                                                  { readwrite, zi, last section .extHeap };
}
else
{
/* .heap section is the last section placed in DATA1 */
    define block DATA1                                                  { readwrite, zi, last section .heap };
}

define block CSTACK    with alignment = 8, size = __stack_size__    { };

initialize by copy { readwrite, section .textrw };

if (isdefinedsymbol(__USE_DLIB_PERTHREAD))
{
  /* Required in a multi-threaded application */
  initialize by copy with packing = none { section __DLIB_PERTHREAD };
}

do not initialize  { section .noinit };
do not initialize  { section .heap };
keep { section ._settings_handler_static* };
define block SETTINGS_HANDLERS with fixed order { readonly section ._settings_handler_static* };
define image symbol _settings_handler_static_list_start = ADDR(SETTINGS_HANDLERS);
define image symbol _settings_handler_static_list_end   = END(SETTINGS_HANDLERS);


place in VECT_region                            { block VECT };
place in TEXT_region                            { block TEXT };
place in TEXT_region                            { block SETTINGS_HANDLERS };
place in DATA0_region                           { block DATA0 };
place in DATA1_region                           { block DATA1 };
place in CSTACK_region                          { block CSTACK };

if (gUseNVMLink_d) {
    define symbol NV_VIRTUAL_PAGE_BOUND = NV_STORAGE_END_ADDRESS - (NV_STORAGE_MAX_SECTORS/2 * NV_STORAGE_SECTOR_SIZE);
    define region sNVM_region           = mem:[from  NV_VIRTUAL_PAGE_BOUND+1 to NV_STORAGE_END_ADDRESS];
    define region fNVM_region           = mem:[from  NV_STORAGE_START_ADDRESS to NV_VIRTUAL_PAGE_BOUND];
    if(gEraseNVMLink_d)
    {
        place in fNVM_region              {readonly section fEraseNVM };
        place in sNVM_region              {readonly section sEraseNVM };
    }
}

if (gUseInternalStorageLink_d) {
    define region InternalStorage       = mem:[from INT_STORAGE_START to INT_STORAGE_END];
}

if(gUseOtSettingsStorage_d) {
    define region OT_SETTINGS_region    = mem:[from m_ot_settings_start to m_ot_settings_end];
}

/********************************************** NBU shared memory **********************************************

                                            m_shared_ram_end
                    - - - +---------------+ - - - - - - - -
                          |               | m_free_data_end
                          |   free data   |
                          |               |
                          |               | m_free_data_start
                    - - - +---------------+ - - - - - - - -
                          |               | m_sqram_rldat_end
                          |     rldat     |
                          |               |
                          |               | m_sqram_rldat_start
                    - - - +---------------+ - - - - - - - -
                          |               | m_sqram_rldat_ae_end
                          |   rldat_ae    |
                          |               |
                          |               | m_sqram_rldat_ae_start
                    - - - +---------------+ - - - - - - - -
                          |               | m_sqram_btbleaesqbuf_end
                          |  btbleaesqbuf |
                          |               |
                          |               | m_sqram_btbleaesqbuf_start
                    - - - +---------------+ - - - - - - - -
                          |               | m_sqram_btblesqbuf_end
                          |   btblebuf    |
                          |               |
                          |               | m_sqram_btblesqbuf_start
                    - - - +---------------+ - - - - - - - -
                          |               | dbg_ext_logging_end
                          |  DBG logging  |
                          |               |
                          |               | dbg_ext_logging_start
                    - - - +---------------+ - - - - - - - -
                          |               | rpmsg_sh_mem_end
                          |     RPMSG     |
                          |               | rpmsg_sh_mem_start
                    - - - +---------------+ - - - - - - - -
                          |               | framework_info_sh_mem_end
                          |    FWK Info   |
                          |               | framework_info_sh_mem_start
                    - - - +---------------+ - - - - - - - -
                          |               | m_sqram_debug_end
                          |    LL Debug   |
                          |               | m_sqram_debug_start
                    - - - +---------------+ - - - - - - - -
                          |               | m_shared_ram_start
**************************************************************************************************/

/* Do not change shall be aligned with other core firmware */
define symbol m_shared_ram_start                = 0x489C0000;
define symbol m_shared_ram_size                 = 0x10000;
define symbol m_shared_ram_end                  = m_shared_ram_start + m_shared_ram_size - 1;

/* Section allowing to share debug info to CM33 (LL error/warnings).*/
define exported symbol m_sqram_debug_start      = m_shared_ram_start;
define symbol m_sqram_debug_size                = 0x200;
define symbol m_sqram_debug_end                 = m_shared_ram_start + m_sqram_debug_size - 1;

/* Section used to share platform/services (SFC, Lowpower) information on both cores */
define symbol framework_info_sh_mem_start       = m_sqram_debug_end + 1;
define symbol framework_info_sh_mem_size        = 0x20;
define symbol framework_info_sh_mem_end         = framework_info_sh_mem_start + framework_info_sh_mem_size - 1;

/* Section used for the sfc module intercore debug */
define exported symbol m_sfc_log_start          = framework_info_sh_mem_start;
define symbol m_sfc_log_size                    = 0x04;

/* Section used to share a flag on both cores for lowpower purpose */
define exported symbol m_lowpower_flag_start    = framework_info_sh_mem_start + m_sfc_log_size;
define symbol m_lowpower_flag_size              = 0x04;
define symbol m_lowpower_flag_end               = m_lowpower_flag_start + m_lowpower_flag_size - 1;

/* RPMSG section for intercore communication */
define exported symbol rpmsg_sh_mem_size        = 0xA00;
define exported symbol rpmsg_sh_mem_start       = framework_info_sh_mem_end + 1;
define exported symbol rpmsg_sh_mem_end         = rpmsg_sh_mem_start + rpmsg_sh_mem_size - 1;


if (gEnableCoverage_d) {
define exported symbol sh_mem_coverage_size     = 0x4;
define exported symbol sh_mem_coverage_start    = rpmsg_sh_mem_end + 1;
define exported symbol sh_mem_coverage_end      = sh_mem_coverage_start + sh_mem_coverage_size -1;
}

if (gEnableCoverage_d) {
define exported symbol dbg_ext_logging_size     = 0x000;
define exported symbol dbg_ext_logging_start    = sh_mem_coverage_end + 1;
} else {
define exported symbol dbg_ext_logging_size     = 0x1500;
define exported symbol dbg_ext_logging_start    = rpmsg_sh_mem_end + 1;
}
define exported symbol dbg_ext_logging_end      = dbg_ext_logging_start + dbg_ext_logging_size - 1;

define symbol m_sqram_btblesqbuf_start          = dbg_ext_logging_end + 1;
define symbol m_sqram_btblesqbuf_size           = 0x5800; /*Increased to hold 5 advertising sets.*/
define symbol m_sqram_btblesqbuf_end            = m_sqram_btblesqbuf_start + m_sqram_btblesqbuf_size - 1;

define symbol m_sqram_btbleaesqbuf_start        = m_sqram_btblesqbuf_end + 1;
define symbol m_sqram_btbleaesqbuf_size         = 0x3100; /*Increased to hold 5 advertising sets with 800 max adv data bytes each: 5 x 3 x 800.*/
define symbol m_sqram_btbleaesqbuf_end          = m_sqram_btbleaesqbuf_start + m_sqram_btbleaesqbuf_size -1;

define symbol m_sqram_rldat_ae_start            = m_sqram_btbleaesqbuf_end + 1;
define symbol m_sqram_rldat_ae_size             = 0x00258;
define symbol m_sqram_rldat_ae_end              = m_sqram_rldat_ae_start + m_sqram_rldat_ae_size -1;

define symbol m_sqram_rldat_start               = m_sqram_rldat_ae_end + 1;
if (gEnableCoverage_d) {
define symbol m_sqram_rldat_size                = 0x00100;
} else {
define symbol m_sqram_rldat_size                = 0x005dc;  /*to hold 24 connection contexts*/
}
define symbol m_sqram_rldat_end                 = m_sqram_rldat_start + m_sqram_rldat_size -1;

define symbol m_free_data_start                 = m_sqram_rldat_end + 1;
define symbol m_free_data_size                  = m_shared_ram_end - m_sqram_rldat_end;
define symbol m_free_data_end                   = m_shared_ram_end;

if (m_sqram_rldat_end > m_shared_ram_end)
{
  error "Total allocated sections in shared ram do not fit in available shared ram!";
}

define region rpmsg_sh_mem_region               = mem:[from rpmsg_sh_mem_start to rpmsg_sh_mem_end];
if (gEnableCoverage_d) {
define region sh_mem_coverage_region            = mem:[from sh_mem_coverage_start to sh_mem_coverage_end];
place in sh_mem_coverage_region                 { section .coverage };
}
place in rpmsg_sh_mem_region                    { section rpmsg_sh_mem_section };

if(gFlashNbuImage_d) {
    /* WARNING: the range here has to be consistent with symbol logging_start from nbu_flash_connectivity.icf */
    define exported symbol nbu_flash_image_start    = 0x48800000;
    define exported symbol nbu_flash_image_end      = 0x4887FFFF; /* nbu_flash_image_start+logging_start */

    define region nbu_flash_region                  = mem:[from nbu_flash_image_start to nbu_flash_image_end];
    define block NBU_FLASH_IMAGE_BLOCK              { section  __nbu_flash };

    place in nbu_flash_region                       { block NBU_FLASH_IMAGE_BLOCK };
}

/********************************************** Computeur Engine (CE) Memory **********************************************/
if (gReserveCeRam_d)
{
/* memory used to store the LCE code (32K)*/
    define symbol m_ce_image_start                = m_data1_end + 1;
    define symbol m_ce_image_size                 = 0x8000;
    define symbol m_ce_image_end                  = m_ce_image_start + m_ce_image_size - 1;
/* memory used for the LCE stack (4K)*/
    define symbol m_ce_stack_start                = m_ce_image_end + 1;
    define symbol m_ce_stack_size                 = 0x1000;
    define symbol m_ce_stack_end                  = m_ce_stack_start + m_ce_stack_size -1;
/* memory used for Core0<-->LCE communication (1.5K)*/
    define symbol m_ce_ctrl_start                 = m_ce_stack_end + 1;
    define symbol m_ce_ctrl_size                  = 0x640;
    define symbol m_ce_ctrl_end                   = m_ce_ctrl_start + m_ce_ctrl_size -1;
/* memory used for LCE heap (14.4K)*/
    define symbol m_ce_heap_start                 = m_ce_ctrl_end + 1;
    define symbol m_ce_heap_size                  = 0x39C0;
    define symbol m_ce_heap_end                   = m_ce_heap_start + m_ce_heap_size -1;
/* memory used for the main heap (52K)*/
    define symbol m_upper_data1_start             = m_ce_heap_end + 1;
    define symbol m_upper_data1_end               = m_ram1_end;

    define region CE_CTRL_region            = mem:[from m_ce_ctrl_start to m_ce_ctrl_end];
    define region CE_HEAP_region            = mem:[from m_ce_heap_start to m_ce_heap_end];
    define region CE_STACK_region           = mem:[from m_ce_stack_start to m_ce_stack_end];
    define region UPPER_DATA1_region        = mem:[from m_upper_data1_start to m_upper_data1_end];

    define block ce_ctrl_blk        { section ceCtrl };
    define block ce_heap_blk        { section ceHeap };

/* There are three heap memory areas defined in the localization applications: 
     - the main heap is accommodated in the UPPER_DATA1_region  (52K)
     - the heap used by LCE is accommodated in CE_HEAP_region   (14.4K)
     - the extended heap memory is accommodated in DATA1_region (24K) */

    define block UPPER_DATA1_blk    { last section .heap };

    place in CE_CTRL_region         { block ce_ctrl_blk };
    place in CE_HEAP_region         { block ce_heap_blk };
    place in UPPER_DATA1_region     { block UPPER_DATA1_blk };

    define exported symbol __CE_MEM_HEAP_end__            = m_ce_heap_end;
    define exported symbol __EXT_HEAP_end__               = m_data1_end;

/*  ce image will be loaded here in initialization stage */
    define region ce_image_region  = mem:[from m_ce_image_start to m_ce_image_end];
}
