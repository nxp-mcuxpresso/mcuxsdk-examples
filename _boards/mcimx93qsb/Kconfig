## _common/project_segments/common/Kconfig.prjseg
```kconfig
# Copyright 2024 NXP
#
# SPDX-License-Identifier: BSD-3-Clause

config MCUX_PRJSEG_module.board.boardfile
    bool "examples/_boards/<board>/board.c"
    if MCUX_PRJSEG_module.board.boardfile
    endif

config MCUX_PRJSEG_module.board.board_core_file
    bool "examples/_boards/<board>/board_<core_id>.c"
    if MCUX_PRJSEG_module.board.board_core_file
    endif

config MCUX_PRJSEG_module.board.console_lite
    bool "debug console_lite"
    default y
    imply MCUX_COMPONENT_utility.debug_console_lite
    imply MCUX_COMPONENT_utility.assert_lite
    if MCUX_PRJSEG_module.board.console_lite
    endif

config MCUX_PRJSEG_module.board.console
    bool "debug console"
    imply MCUX_COMPONENT_utility.debug_console
    imply MCUX_COMPONENT_utility.assert
    imply MCUX_COMPONENT_component.serial_manager
    imply MCUX_COMPONENT_component.lists
    imply MCUX_COMPONENT_component.serial_manager_uart

    if MCUX_PRJSEG_module.board.console
    endif

config MCUX_PRJSEG_module.board.suite
    bool "default board suite"
    default y
    imply MCUX_COMPONENT_driver.common
    imply MCUX_COMPONENT_device.CMSIS
    imply MCUX_COMPONENT_device.startup

# clock
config MCUX_PRJSEG_module.board.use_board_clock
    bool "provided board clock_config"
    default y
    help
        Use provided board clock_config

choice MCUX_PRJSEG_module.board.clock_sel
    prompt "clock_config.c location"
    depends on MCUX_PRJSEG_module.board.use_board_clock
    default MCUX_PRJSEG_module.board.clock

    config MCUX_PRJSEG_module.board.clock
        bool "Use examples/<board>/clock_config.c"
        help
            Use examples/_boards/<board>/clock_config.c

    config MCUX_PRJSEG_module.board.clock_board_folder
        bool "examples/_boards/<board>/common/clock/clock_config.c"
        help
            Use examples/_boards/<board>/common/clock/clock_config.c

    config MCUX_PRJSEG_module.board.clock_board_core_folder
        bool "examples/_boards/<board>/common/clock/<core_id>/clock_config.c"
        help
            Use examples/<board>/common/clock/<core_id>/clock_config.c

    config MCUX_PRJSEG_module.board.clock_customize_folder
        bool "project customized folder"

endchoice

config MCUX_HAS_PRJSEG_module.board.pinmux_sel
    bool "provided board pinmux"
    default y
    help
        Use provided board pinmux under examples folder

choice MCUX_PRJSEG_module.board.pinmux_sel
    bool "pin_mux.c and pin_mux.h files location"
    depends on MCUX_HAS_PRJSEG_module.board.pinmux_sel
    default MCUX_PRJSEG_module.board.pinmux_project_folder

    config MCUX_PRJSEG_module.board.pinmux_board_folder
        bool "examples/_boards/<board>/common/pin_mux/pin_mux.c"
        select MCUX_DEPENDENCY_PINMUX
        help
            Use examples/_boards/<board>/common/pinmux/pin_mux.c

    config MCUX_PRJSEG_module.board.pinmux_board_core_folder
        bool "examples/<board>/common/pin_mux/<core_id>/pin_mux.c"
        select MCUX_DEPENDENCY_PINMUX
        help
            Use examples/_boards/<board>/common/pin_mux/<core_id>/pin_mux.c

    config MCUX_PRJSEG_module.board.pinmux_project_folder
        bool "<project_board_port_path>/pin_mux.c"
        select MCUX_DEPENDENCY_PINMUX
        help
            Use pinmux in project board port folder:
            examples/_boards/<board>/<project_category>/<project>/pinmux.c

    config MCUX_PRJSEG_module.board.pinmux_project_core_folder
        bool "<project_board_port_path>/<core>/pin_mux.c"
        select MCUX_DEPENDENCY_PINMUX
        help
            Use pinmux in project board port folder by core:
            examples/_boards/<board>/<project_category>/<project>/<core>/pinmux.c

    config MCUX_PRJSEG_module.board.pinmux_customize_folder
        bool "project customized folder"
        select MCUX_DEPENDENCY_PINMUX

endchoice

config MCUX_HAS_PRJSEG_project.use_hw_app
    bool "app.h & hardware_init.c"
    default y
    help
        Use app.h and hardware_init.c in project.

choice MCUX_PRJSEG_project.hw_app_sel
    prompt "app.h & hardware_init.c location"
    depends on MCUX_HAS_PRJSEG_project.use_hw_app
    default MCUX_PRJSEG_project.hw_app_project_core_folder

    config MCUX_PRJSEG_project.hw_app_project_core_folder
        bool "app.h and hardware_init.c in <project>/<core>"
        help
            Use app.h and hardware_init.c in folder:
            examples/_boards/<board>/<project_category>/<project>/<core>

    config MCUX_PRJSEG_project.hw_app_project_folder
        bool "app.h and hardware_init.c in <project>"
        help
            Use app.h and hardware_init.c in folder:
            examples/_boards/<board>/<project_category>/<project>/

    config MCUX_PRJSEG_project.hw_app_core0
        bool "default hardware_init_core0.c and app_core0.h"

    config MCUX_PRJSEG_project.hw_app_core1
        bool "default hardware_init_core1.c and app_core1.h"

    config MCUX_PRJSEG_project.hw_project_core_folder
        bool "only hardware_init.c in <project>/<core>"
        help
            Use only hardware_init.c in folder:
            examples/_boards/<board>/<project_category>/<project>/<core>

    config MCUX_PRJSEG_project.hw_project_folder
        bool "only hardware_init.c in <project>"
        help
            Use only hardware_init.c in folder:
            examples/_boards/<board>/<project_category>/<project>/

    config MCUX_PRJSEG_project.hw_core0
        bool "only hardware_init_core0.c"

    config MCUX_PRJSEG_project.hw_core1
        bool "only hardware_init_core1.c"

    config MCUX_PRJSEG_project.hw_app_customize_folder
        bool "files in customized folder"

endchoice
```

## _common/project_segments/display_support/Kconfig.prjseg
```kconfig
# Copyright 2024-2025 NXP
#
# SPDX-License-Identifier: BSD-3-Clause

if MCUX_DEMO_PANEL_RK055AHD091_SUPPORT
    config DEMO_PANEL_RK055AHD091
        int
        default 0
        help
            Driver selection for panel RK055AHD091
            No prefix in generated macro
endif

if MCUX_DEMO_PANEL_RK055IQH091_SUPPORT
    config DEMO_PANEL_RK055IQH091
        int
        default 1
        help
            Driver selection for panel RK055IQH091
            No prefix in generated macro
endif

if MCUX_DEMO_PANEL_RK055MHD091A0_SUPPORT
    config DEMO_PANEL_RK055MHD091A0
        int
        default 2
        help
            Driver selection for panel RK055MHD091A0
            No prefix in generated macro
endif

if MCUX_DEMO_PANEL_G1120B0MIPI_SUPPORT
    config DEMO_PANEL_G1120B0MIPI
        int
        default 3
        help
            Driver selection for panel G1120B0MIPI
            No prefix in generated macro
endif

if MCUX_DEMO_PANEL_TFT_PROTO_5_SUPPORT
    config DEMO_PANEL_TFT_PROTO_5
        int
        default 4
        help
            Driver selection for panel TFT_PROTO_5
            No prefix in generated macro
endif

if MCUX_DEMO_PANEL_RASPI_7INCH_SUPPORT
    config DEMO_PANEL_RASPI_7INCH
        int
        default 5
        help
            Driver selection for panel RASPI_7INCH
            No prefix in generated macro
endif

if MCUX_DEMO_PANEL_ZC143AC72MIPI_SUPPORT
    config DEMO_PANEL_ZC143AC72MIPI
        int
        default 6
        help
            Driver selection for panel ZC143AC72MIPI
            No prefix in generated macro
endif

if MCUX_DEMO_PANEL_ADAFRUIT_2_8_SUPPORT
    config DEMO_PANEL_ADAFRUIT_2_8
        int
        default 7
        help
            Driver selection for panel ADAFRUIT_2_8
            No prefix in generated macro
endif

if MCUX_DEMO_PANEL_LCD_PAR_S035_SUPPORT
    config DEMO_PANEL_LCD_PAR_S035
        int
        default 8
        help
            Driver selection for panel LCD_PAR_S035
            No prefix in generated macro
endif

if MCUX_DEMO_PANEL_RK043FN02H_SUPPORT
    config DEMO_PANEL_RK043FN02H
        int
        default 9
        help
            Driver selection for panel RK043FN02H
            No prefix in generated macro
endif

if MCUX_DEMO_PANEL_RK043FN66HS_SUPPORT
    config DEMO_PANEL_RK043FN66HS
        int
        default 10
        help
            Driver selection for panel RK043FN66HS
            No prefix in generated macro
endif

if MCUX_DEMO_PANEL_LCD_SPEC_SUPPORT
    config DEMO_PANEL_LCD_SPEC
        int
        default 11
        help
            Driver selection for panel LCD_SPEC
            No prefix in generated macro
endif

if MCUX_DEMO_PANEL_LVDS_DUAL_PANEL_SUPPORT
    config DEMO_PANEL_LVDS_DUAL_PANEL
        int
        default 12
        help
            Driver selection for panel LVDS_DUAL_PANEL
            No prefix in generated macro
endif

if MCUX_DEMO_PANEL_MX9_DSI_OLED_SUPPORT
    config DEMO_PANEL_MX9_DSI_OLED
        int
        default 13
        help
            Driver selection for panel MX9_DSI_OLED
            No prefix in generated macro
endif

if MCUX_DEMO_PANEL_MIPI2HDMI_SUPPORT
    config DEMO_PANEL_MIPI2HDMI
        int
        default 14
        help
            Driver selection for panel MIPI2HDMI
            No prefix in generated macro
endif

if MCUX_DEMO_PANEL_LVDS2HDMI_SUPPORT
    config DEMO_PANEL_LVDS2HDMI
        int
        default 15
        help
            Driver selection for panel LVDS2HDMI
            No prefix in generated macro
endif

if MCUX_DEMO_PANEL_CAP_TOUCH_LVDS_SUPPORT
    config DEMO_PANEL_CAP_TOUCH_LVDS
        int
        default 16
        help
            Driver selection for panel CAP_TOUCH_LVDS
            No prefix in generated macro
endif

if MCUX_DEMO_PANEL_CAP_TOUCH_DSI_SUPPORT
    config DEMO_PANEL_CAP_TOUCH_DSI
        int
        default 17
        help
            Driver selection for panel CAP_TOUCH_DSI
            No prefix in generated macro
endif

config MCUX_PRJSEG_module.board.display_support
    bool "Enable Display Support"

config MCUX_DEMO_PANEL_RK055AHD091_SUPPORT
    bool

config MCUX_DEMO_PANEL_RK055IQH091_SUPPORT
    bool

config MCUX_DEMO_PANEL_RK055MHD091A0_SUPPORT
    bool

config MCUX_DEMO_PANEL_G1120B0MIPI_SUPPORT
    bool

config MCUX_DEMO_PANEL_TFT_PROTO_5_SUPPORT
    bool

config MCUX_DEMO_PANEL_RASPI_7INCH_SUPPORT
    bool

config MCUX_DEMO_PANEL_ZC143AC72MIPI_SUPPORT
    bool

config MCUX_DEMO_PANEL_ADAFRUIT_2_8_SUPPORT
    bool

config MCUX_DEMO_PANEL_LCD_PAR_S035_SUPPORT
    bool

config MCUX_DEMO_PANEL_RK043FN02H_SUPPORT
    bool

config MCUX_DEMO_PANEL_RK043FN66HS_SUPPORT
    bool

config MCUX_DEMO_PANEL_LCD_SPEC_SUPPORT
    bool

config MCUX_DEMO_PANEL_LVDS_DUAL_PANEL_SUPPORT
    bool

config MCUX_DEMO_PANEL_MX9_DSI_OLED_SUPPORT
    bool

config MCUX_DEMO_PANEL_MIPI2HDMI_SUPPORT
    bool

config MCUX_DEMO_PANEL_LVDS2HDMI_SUPPORT
    bool

config MCUX_DEMO_PANEL_CAP_TOUCH_LVDS_SUPPORT
    bool

config MCUX_DEMO_PANEL_CAP_TOUCH_DSI_SUPPORT
    bool

if MCUX_PRJSEG_module.board.display_support

config DEMO_PANEL
    int
    default 0 if RK055AHD091
    default 1 if RK055IQH091
    default 2 if RK055MHD091A0
    default 3 if G1120B0MIPI
    default 4 if TFT_PROTO_5
    default 5 if RASPI_7INCH
    default 6 if ZC143AC72MIPI
    default 7 if ADAFRUIT_2_8
    default 8 if LCD_PAR_S035
    default 9 if RK043FN02H
    default 10 if RK043FN66HS
    default 11 if LCD_SPEC
    default 12 if LVDS_DUAL_PANEL
    default 13 if MX9_DSI_OLED
    default 14 if MIPI2HDMI
    default 15 if LVDS2HDMI
    default 16 if CAP_TOUCH_LVDS
    default 17 if CAP_TOUCH_DSI
    help
        Panel selection for display support
        No prefix in generated macro

choice DISPLAY_SUPPORT_PANEL
    prompt "Panel Selection"

    config RK055AHD091
        bool "RK055AHD091-CTG" if MCUX_DEMO_PANEL_RK055AHD091_SUPPORT

    config RK055IQH091
        bool "RK055IQH091-CTG" if MCUX_DEMO_PANEL_RK055IQH091_SUPPORT

    config RK055MHD091A0
        bool "RK055MHD091A0-CTG" if MCUX_DEMO_PANEL_RK055MHD091A0_SUPPORT

    config G1120B0MIPI
        bool "MIPI Circular Display G1120B0MIPI" if MCUX_DEMO_PANEL_G1120B0MIPI_SUPPORT

    config TFT_PROTO_5
        bool "MikroE TFT Proto 5 inch CAPACITIVE" if MCUX_DEMO_PANEL_TFT_PROTO_5_SUPPORT

    config RASPI_7INCH
        bool "Raspberry Pi 7 inch" if MCUX_DEMO_PANEL_RASPI_7INCH_SUPPORT

    config ZC143AC72MIPI
        bool "MIPI Circular Display ZC143AC72MIPI" if MCUX_DEMO_PANEL_ZC143AC72MIPI_SUPPORT

    config ADAFRUIT_2_8
        bool "Adafruit 2.8 inch captative panel" if MCUX_DEMO_PANEL_ADAFRUIT_2_8_SUPPORT

    config LCD_PAR_S035
        bool "LCD_PAR_S035 panel" if MCUX_DEMO_PANEL_LCD_PAR_S035_SUPPORT

    config RK043FN02H
        bool "RK043FN02H-CT" if MCUX_DEMO_PANEL_RK043FN02H_SUPPORT

    config RK043FN66HS
        bool "RK043FN66HS-CTG" if MCUX_DEMO_PANEL_RK043FN66HS_SUPPORT

    config LCD_SPEC
        bool "LCD_SPEC panel" if MCUX_DEMO_PANEL_LCD_SPEC_SUPPORT

    config LVDS_DUAL_PANEL
        bool "LVDS_DUAL_PANEL panel" if MCUX_DEMO_PANEL_LVDS_DUAL_PANEL_SUPPORT

    config MX9_DSI_OLED
        bool "MX9_DSI_OLED panel" if MCUX_DEMO_PANEL_MX9_DSI_OLED_SUPPORT

    config MIPI2HDMI
        bool "MIPI2HDMI convertor card" if MCUX_DEMO_PANEL_MIPI2HDMI_SUPPORT

    config LVDS2HDMI
        bool "LVDS2HDMI convertor card" if MCUX_DEMO_PANEL_LVDS2HDMI_SUPPORT

    config CAP_TOUCH_LVDS
        bool "CAP_TOUCH_LVDS panel" if MCUX_DEMO_PANEL_CAP_TOUCH_LVDS_SUPPORT

    config CAP_TOUCH_DSI
        bool "CAP_TOUCH_DSI panel" if MCUX_DEMO_PANEL_CAP_TOUCH_DSI_SUPPORT

endchoice

endif

orsource "../../../../${board_root}/${board}/project_segments/display_support/Kconfig.prjseg"
```

## _common/project_segments/dsc/Kconfig.prjseg
```kconfig
# enable the choice item in guiconfig
config MCUX_HAS_PRJSEG_project.use_peripherals
    bool "Use peripherals[.c|.h]"
    default y
    help
        Use peripherals[.c|.h] in project.

choice MCUX_PRJSEG_project.peripherals_sel
    prompt "peripherals[.c|.h] selection"
    depends on MCUX_HAS_PRJSEG_project.use_peripherals

    config MCUX_PRJSEG_module.use_board_peripheral
        bool "Use examples/_boards/${board}/peripherals/peripherals[.c|.h]"

    config MCUX_PRJSEG_module.use_project_peripheral
        bool "Use examples/_boards/${board}/<demo>/peripherals[.c|.h]"
endchoice
```

## _common/project_segments/dsp/Kconfig.prjseg
```kconfig
config MCUX_PRJSEG_module.dsp_support
    bool "Use ${board_root}/${board}/dsp_examples/dsp_support.c"

config MCUX_PRJSEG_module.incbin
    bool "Use ${board_root}/${board}/dsp_examples/incbin.S"

config MCUX_PRJSEG_module.incbin_for_core
    bool "Use ${board_root}/${board}/dsp_examples/incbin_${core_id}.S"
```
