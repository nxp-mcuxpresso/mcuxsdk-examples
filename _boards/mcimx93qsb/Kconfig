## _boards/mcimx93qsb/Kconfig
```kconfig
# Copyright 2024 NXP
# All rights reserved.
#
# SPDX-License-Identifier: BSD-3-Clause

rsource "Kconfig.defconfig"

config MCUX_HW_BOARD_mcimx93qsb
    bool
    default y
    imply MCUX_HW_DEVICE_MIMX9322
```

## _boards/mcxn5xxevk/Kconfig
```kconfig
# Copyright 2024 NXP
#
# SPDX-License-Identifier: BSD-3-Clause

rsource "Kconfig.defconfig"

config MCUX_HW_BOARD_mcxn5xxevk
    bool
    default y
    imply MCUX_HW_DEVICE_MCXN547
    imply MCUX_COMPONENT_driver.common
    imply MCUX_COMPONENT_driver.clock
    imply MCUX_COMPONENT_driver.reset
    imply MCUX_COMPONENT_driver.gpio
    imply MCUX_COMPONENT_driver.port
    imply MCUX_COMPONENT_driver.lpflexcomm
    imply MCUX_COMPONENT_driver.lpflexcomm_lpuart
    imply MCUX_COMPONENT_driver.mcx_spc


    ## Board project segment dependency data

    select MCUX_COMPONENT_driver.port if MCUX_PRJSEG_module.board.pinmux
    select MCUX_COMPONENT_driver.gpio if MCUX_PRJSEG_module.board.pinmux
    select MCUX_COMPONENT_driver.clock if MCUX_PRJSEG_module.board.clock    
    select MCUX_COMPONENT_driver.reset if MCUX_PRJSEG_module.board.clock
    select MCUX_COMPONENT_component.lpuart_adapter if MCUX_PRJSEG_module.board.console_lite
    select MCUX_COMPONENT_driver.lpflexcomm if MCUX_PRJSEG_module.board.console_lite
    select MCUX_COMPONENT_driver.lpflexcomm_lpuart if MCUX_PRJSEG_module.board.console_lite
    select MCUX_COMPONENT_driver.dbi_flexio_edma if MCUX_COMPONENT_middleware.emwin
    select MCUX_COMPONENT_driver.dbi_flexio_edma if MCUX_COMPONENT_middleware.lvgl
```

## _boards/mcxw71evk/Kconfig.defconfig
```kconfig
# Copyright 2024 NXP
# All rights reserved.
#
# SPDX-License-Identifier: BSD-3-Clause

# FreeRTOS board config
if MCUX_COMPONENT_middleware.freertos-kernel
    config configENABLE_FPU
        default n

    config configENABLE_MPU
        default n

    config configENABLE_TRUSTZONE
        default n

    config configRUN_FREERTOS_SECURE_ONLY
        default y
endif

config HAL_RPMSG_SELECT_ROLE
    default n
```

## _boards/mcxw72evk/Kconfig
```kconfig
# Copyright 2024 NXP
#
# SPDX-License-Identifier: BSD-3-Clause

rsource "${core_id}/Kconfig"
rsource "Kconfig.defconfig"

config MCUX_HW_BOARD_mcxw72evk
    bool
    default y
    imply MCUX_HW_DEVICE_MCXW727C
    imply MCUX_COMPONENT_driver.clock
    imply MCUX_COMPONENT_driver.common
    imply MCUX_COMPONENT_driver.lpuart
    imply MCUX_COMPONENT_driver.port
    imply MCUX_COMPONENT_driver.gpio
    imply MCUX_COMPONENT_driver.ccm32k
    imply MCUX_COMPONENT_driver.spc

config MCUX_COMPONENT_device.utility
    bool "utility for MCXW727C"
    default n
```

## _boards/mimxrt685audevk/Kconfig.prjseg
```kconfig
# Copyright 2024 NXP
#
# SPDX-License-Identifier: BSD-3-Clause

orsource "${core_id}/Kconfig.prjseg"

rsource "../../_common/project_segments/lvgl/Kconfig.prjseg"
rsource "../../_common/project_segments/freertos/examples/tickless/Kconfig.prjseg"
rsource "../../lvgl_examples/lvgl_sdk/lvgl_support/flexcomm_spi/Kconfig.lvgl_support"
```

## _boards/mimxrt685audevk/cm33/Kconfig.prjseg
```kconfig
# Copyright 2024 NXP
# All rights reserved.
#
# SPDX-License-Identifier: BSD-3-Clause

rsource "../../../_common/project_segments/dsp/Kconfig.prjseg"
rsource "../../../_common/project_segments/pmic/Kconfig.prjseg"

config MCUX_PRJSEG_module.dsp_support
    select MCUX_PRJSEG_module.pmic_support
    select MCUX_COMPONENT_driver.dsp

config MCUX_PRJSEG_module.pmic_support
    select MCUX_COMPONENT_driver.pca9420
```

## _boards/mimxrt700evk/Kconfig
```kconfig
# Copyright 2024 NXP
# All rights reserved.
#
# SPDX-License-Identifier: BSD-3-Clause

rsource "${core_id}/Kconfig"
rsource "Kconfig.defconfig"
rsource "shields/a8974/Kconfig"
rsource "../../_common/project_segments/freertos/examples/tickless/Kconfig.prjseg"

config MCUX_HW_BOARD_mimxrt700evk
    bool
    default y
    imply MCUX_HW_DEVICE_MIMXRT798S
    imply MCUX_COMPONENT_driver.clock
    imply MCUX_COMPONENT_driver.common
    imply MCUX_COMPONENT_driver.power if MCUX_HW_DEVICE_MIMXRT798S_CORE_ID_cm33_core0 || MCUX_HW_DEVICE_MIMXRT798S_CORE_ID_cm33_core1
    imply MCUX_COMPONENT_driver.xspi if MCUX_HW_DEVICE_MIMXRT798S_CORE_ID_cm33_core0
    imply MCUX_COMPONENT_driver.cache_xcache if MCUX_HW_DEVICE_MIMXRT798S_CORE_ID_cm33_core0
    imply MCUX_COMPONENT_driver.lpuart
    imply MCUX_COMPONENT_driver.flash_config if MCUX_HW_DEVICE_MIMXRT798S_CORE_ID_cm33_core0
    imply MCUX_COMPONENT_driver.lpflexcomm
    imply MCUX_COMPONENT_driver.lpc_iopctl
    imply MCUX_COMPONENT_driver.gpio
    imply MCUX_COMPONENT_driver.glikey if MCUX_HW_DEVICE_MIMXRT798S_CORE_ID_cm33_core0 || MCUX_HW_DEVICE_MIMXRT798S_CORE_ID_cm33_core1
    imply MCUX_COMPONENT_driver.reset if MCUX_HW_DEVICE_MIMXRT798S_CORE_ID_cm33_core0 || MCUX_HW_DEVICE_MIMXRT798S_CORE_ID_cm33_core1
```

## _boards/mimxrt700evk/Kconfig.prjseg
```kconfig
# Copyright 2024 NXP
#
# SPDX-License-Identifier: BSD-3-Clause

orsource "${core_id}/Kconfig.prjseg"

rsource "../../_common/project_segments/freertos/examples/tickless/Kconfig.prjseg"
```

## _boards/mimxrt700evk/Kconfig.sysbuild
```kconfig
config secondary_config
    string
    default "debug" if $(config) = "debug"
    default "release" if $(config) = "release"
    default "debug" if $(config) = "flash_debug"
    default "release" if $(config) = "flash_release"

config secondary_core_id
    string
    default "cm33_core1" if $(core_id) = "cm33_core0"

config secondary_board
    string
    default "$(board)"

config secondary_toolchain
    string
    default "$(toolchain)"

config dsp_config
    string
    default "debug" if $(config) = "debug"
    default "release" if $(config) = "release"
    default "debug" if $(config) = "flash_debug"
    default "release" if $(config) = "flash_release"

config primary_dsp_core_id
    string
    default "hifi4"

config secondary_dsp_core_id
    string
    default "hifi1"

config ezhv_core_id
    string
    default "ezhv"

config ezhv_config
    string
    default "debug" if $(config) = "debug"
    default "release" if $(config) = "release"
    default "debug" if $(config) = "flash_debug"
    default "release" if $(config) = "flash_release"
```

## _boards/mimxrt700evk/cm33_core0/Kconfig.prjseg
```kconfig
# Copyright 2024 NXP
#
# SPDX-License-Identifier: BSD-3-Clause

rsource "../../../_common/project_segments/dsp/Kconfig.prjseg"
rsource "../../../_common/project_segments/multicore/Kconfig.prjseg"
rsource "../../../_common/project_segments/pmic/Kconfig.prjseg"
rsource "../../../_common/project_segments/display_support/Kconfig.prjseg"
rsource "../../../_common/project_segments/ezhv/Kconfig.prjseg"
rsource "../../../_common/project_segments/vglite_support/Kconfig.prjseg"
rsource "../../../_common/project_segments/lvgl/Kconfig.prjseg"

config MCUX_PRJSEG_module.dsp_support
    select MCUX_COMPONENT_driver.dsp

config MCUX_PRJSEG_module.pmic_support
    select MCUX_COMPONENT_driver.pca9422

config MCUX_PRJSEG_module.core1_support
    select MCUX_COMPONENT_driver.xcache
```

## _boards/mimxrt700evk/shields/a8974/Kconfig
```kconfig
# Copyright 2024 NXP
# All rights reserved.
#
# SPDX-License-Identifier: BSD-3-Clause


config MCUX_PRJSEG_module.shield.a8974.common
    bool "Shield a8974 configuration files"
```

## _boards/rdrw612bga/Kconfig
```kconfig
# Copyright 2024 NXP
#
# SPDX-License-Identifier: BSD-3-Clause

rsource "Kconfig.defconfig"

config MCUX_HW_BOARD_rdrw612bga
    bool
    default y
    imply MCUX_HW_DEVICE_RW612
    imply MCUX_COMPONENT_driver.common
    imply MCUX_COMPONENT_driver.lpc_gpio
    imply MCUX_COMPONENT_driver.flexspi
    imply MCUX_COMPONENT_driver.cache_cache64
    imply MCUX_COMPONENT_driver.flash_config
    imply MCUX_COMPONENT_component.els_pkc.platform.rw61x_standalone_clib_gdet_sensor
```

## _boards/rdrw612bga/Kconfig.prjseg
```kconfig
# Copyright 2024 NXP
# SPDX-License-Identifier: BSD-3-Clause

rsource "../../_common/project_segments/wireless/Kconfig.prjseg"
rsource "../../_common/project_segments/wireless/rw61x/Kconfig.prjseg"
rsource "../../_common/components/Kconfig.flash_config"
rsource "../../_common/project_segments/display_support/Kconfig.prjseg"
rsource "../../_common/project_segments/lvgl/Kconfig.prjseg"
rsource "../../_common/project_segments/freertos/examples/tickless/Kconfig.prjseg"
rsource "../../lvgl_examples/lvgl_sdk/lvgl_support/rw61x/Kconfig.lvgl_support"
```

## _boards/rdrw612bga/project_segments/display_support/Kconfig.prjseg
```kconfig
# Copyright 2024 NXP
# All rights reserved.
#
# SPDX-License-Identifier: BSD-3-Clause
#

config MCUX_PRJSEG_module.board.display_support
    select MCUX_COMPONENT_driver.st7796s
    select MCUX_COMPONENT_driver.ili9341
    select MCUX_COMPONENT_driver.gt911
    select MCUX_COMPONENT_driver.ft6x06
    select MCUX_COMPONENT_driver.dc-fb-dbi
    select MCUX_COMPONENT_driver.dbi_lcdic_dma
    select MCUX_COMPONENT_driver.inputmux
    select MCUX_COMPONENT_driver.flexcomm_i2c
    select ILI9341_USE_DBI_IFACE
    select FT6X06_USE_SIMPLE_I2C_API

if MCUX_PRJSEG_module.board.display_support

    config DEMO_PANEL
        int
        default 0 if MCUX_PRJSEG_module.board.display_support.ADAFRUIT_2_8
        default 1 if MCUX_PRJSEG_module.board.display_support.LCD_PAR_S035
        help
            Panel selection for display support
            No prefix in generated macro

    choice MCUX_PRJSEG_module.board.display_support.panel
        prompt "Panel Selection"
        default MCUX_PRJSEG_module.board.display_support.LCD_PAR_S035

        config MCUX_PRJSEG_module.board.display_support.ADAFRUIT_2_8
            bool "Adafruit 2.8 inch captative panel"

        config MCUX_PRJSEG_module.board.display_support.LCD_PAR_S035
            bool "LCD_PAR_S035 panel"

    endchoice
endif
```

## _boards/rdrw612bga/project_segments/wireless/Kconfig.prjseg
```kconfig
# Copyright 2024 NXP
# All rights reserved.
#
# SPDX-License-Identifier: BSD-3-Clause

config MCUX_PRJSEG_module.board.wireless.board_comp
    select MCUX_COMPONENT_component.button

config MCUX_PRJSEG_module.board.wireless.linker_script.zb_mcuboot
    bool "Connectivity linker script for Zigbee with MCUBoot"
    help
      Use the linker script provided by the Connectivity Framework for the current platform in case of zigbee examples
      using MCUBoot as a bootloader.
      This should be left disabled if the user wants to use a custom linker script.
```

## _boards/twrkm34z50mv3/Kconfig
```kconfig
# Copyright 2024 NXP
#
# SPDX-License-Identifier: BSD-3-Clause

rsource "Kconfig.defconfig"

config MCUX_HW_BOARD_twrkm34z50mv3
    bool
    default y
    imply MCUX_HW_DEVICE_MKM34ZA5
    imply MCUX_COMPONENT_driver.clock
    imply MCUX_COMPONENT_driver.common
    imply MCUX_COMPONENT_driver.uart
    imply MCUX_COMPONENT_driver.irtc
    imply MCUX_COMPONENT_driver.port
    imply MCUX_COMPONENT_driver.smc
    imply MCUX_COMPONENT_driver.gpio
    imply MCUX_COMPONENT_driver.xbar
```

## _boards/twrkm34z75m/Kconfig
```kconfig
# Copyright 2024 NXP
#
# SPDX-License-Identifier: BSD-3-Clause

rsource "Kconfig.defconfig"

config MCUX_HW_BOARD_twrkm34z75m
    bool
    default y
    imply MCUX_HW_DEVICE_MKM34Z7
    imply MCUX_COMPONENT_driver.clock
    imply MCUX_COMPONENT_driver.common
    imply MCUX_COMPONENT_driver.uart
    imply MCUX_COMPONENT_driver.lpuart
    imply MCUX_COMPONENT_driver.irtc
    imply MCUX_COMPONENT_driver.port
    imply MCUX_COMPONENT_driver.smc
    imply MCUX_COMPONENT_driver.gpio
    imply MCUX_COMPONENT_driver.xbar
```

## _common/Kconfig.interfaces
```kconfig
# Copyright 2024 NXP
# All rights reserved.
#
# SPDX-License-Identifier: BSD-3-Clause

# Configuration related to board-level interfaces, sockets, connectors and similar
# hardware. These should be selected by concrete board, and shouldn't be modified by user
# from application conf or guiconfig.

menu "Board interfaces"

visible if 0

config MCUX_HW_BOARD_interface.has_m2_socket
    bool
    default n
    help
        This symbol is y if the board has an M.2 socket, which can be used to inferface
        with Wi-Fi/BT external modules.

config MCUX_HW_BOARD_interface.has_sd_slot
    bool
    default n
    help
        This symbol is y if the board has an SD card slot.

endmenu
```

## _common/project_segments/ce/Kconfig.prjseg
```kconfig
# Copyright 2024 NXP
#
# SPDX-License-Identifier: BSD-3-Clause

config MCUX_PRJSEG_module.ce_support
    bool "Use ${board_root}/${board}/ce_examples/ce_support[.c|.h]"
```
