## _boards/mcimx93evk/ca55/Kconfig
```kconfig
# Copyright 2026 NXP
#
# SPDX-License-Identifier: BSD-3-Clause

config MCUX_HW_BOARD_mcimx93evk_ca55
    bool
    default y
```

## _boards/mcimx93wevk/Kconfig
```kconfig
# Copyright 2025 NXP
# All rights reserved.
#
# SPDX-License-Identifier: BSD-3-Clause

rsource "Kconfig.defconfig"

config MCUX_HW_BOARD_mcimx93wevk
    bool
    default y
    imply MCUX_HW_DEVICE_MIMX93W52
```

## _boards/mcxw23evk/Kconfig
```kconfig
# Copyright 2025 NXP
#
# SPDX-License-Identifier: BSD-3-Clause

rsource "Kconfig.defconfig"
rsource "../../../examples/_common/project_segments/freertos/examples/tickless/Kconfig.prjseg"

config MCUX_HW_BOARD_mcxw23evk
    bool
    default y
    imply MCUX_HW_DEVICE_MCXW236B
    imply MCUX_COMPONENT_driver.clock
    imply MCUX_COMPONENT_driver.common
    imply MCUX_COMPONENT_driver.flexcomm_i2c
    imply MCUX_COMPONENT_driver.flexcomm_spi
    imply MCUX_COMPONENT_driver.flexcomm_usart
    imply MCUX_COMPONENT_driver.lpc_gpio
    imply MCUX_COMPONENT_driver.lpc_iocon
    imply MCUX_COMPONENT_driver.power
    imply MCUX_COMPONENT_driver.reset
    imply MCUX_COMPONENT_driver.flexcomm

    ## Board project segment dependency data

    select MCUX_COMPONENT_driver.lpc_iocon if MCUX_PRJSEG_module.board.pinmux
    select MCUX_COMPONENT_driver.lpc_gpio if MCUX_PRJSEG_module.board.pinmux
    select MCUX_COMPONENT_driver.clock if MCUX_PRJSEG_module.board.clock    
    select MCUX_COMPONENT_driver.power if MCUX_PRJSEG_module.board.clock
    select MCUX_COMPONENT_driver.flexcomm if MCUX_PRJSEG_module.board.console_lite
    select MCUX_COMPONENT_driver.flexcomm_usart if MCUX_PRJSEG_module.board.console_lite
```

## _boards/mimxrt2660evk/Kconfig
```kconfig
# Copyright 2024 NXP
# All rights reserved.
#
# SPDX-License-Identifier: BSD-3-Clause

rsource "xip/Kconfig"
rsource "Kconfig.defconfig"

config MCUX_HW_BOARD_mimxrt2660evk
    bool
    default y
    imply MCUX_HW_DEVICE_MIMXRT2663

    imply MCUX_COMPONENT_driver.clock
    imply MCUX_COMPONENT_driver.gpio
    imply MCUX_COMPONENT_driver.iomuxc
    imply MCUX_COMPONENT_driver.trdc_1
    imply MCUX_COMPONENT_driver.modcon
    imply MCUX_COMPONENT_driver.power
    imply MCUX_COMPONENT_driver.xspi
    select MCUX_COMPONENT_component.lpuart_adapter  if MCUX_COMPONENT_component.serial_manager_uart
    select MCUX_COMPONENT_component.lpuart_adapter  if MCUX_COMPONENT_utility.debug_console_lite

config MCUX_BOARD_USE_PF9453
    bool "Supply VDD_CORE (and other rails) from the on-board PF9453 PMIC instead of the on-chip regulators"
    depends on MCUX_HW_BOARD_mimxrt2660evk
    default n
    select MCUX_COMPONENT_driver.pf9453
    help
      Board-level selection of the on-board PF9453 PMIC as the VDD_CORE/BUCK3/LDO1 supply,
      instead of the RT2660's on-chip DCDC/LDOs. The board registers external-regulator hooks
      with fsl_power (POWER_SetExtRegulatorHooks) so POWER_EnterHpRun/NormalRun/LpRun and the
      low-power entry points drive the PF9453 over I2C instead of the on-chip regulators. This
      is board-specific knowledge, not device-specific — fsl_power itself has no PF9453
      awareness. Unset (default): VDD_CORE/BUCK3/LDO1 behavior is unchanged (on-chip DCDC/LDOs,
      no fsl_pf9453 dependency).
```

## _boards/mimxrt2660evk/Kconfig.prjseg
```kconfig
# Copyright 2024 NXP
# SPDX-License-Identifier: BSD-3-Clause

rsource "${SdkRootDirPath}/examples/_common/project_segments/display_support/Kconfig.prjseg"
rsource "${SdkRootDirPath}/examples/_common/project_segments/lvgl/Kconfig.prjseg"
rsource "${SdkRootDirPath}/examples/lvgl_examples/lvgl_sdk/lvgl_support/rt2xxx/Kconfig.lvgl_support"
rsource "../../../examples/_common/project_segments/freertos/examples/tickless/Kconfig.prjseg"
```

## _boards/mimxrt2660evk/project_segments/display_support/Kconfig.prjseg
```kconfig
# Copyright 2025 NXP
# All rights reserved.
#
# SPDX-License-Identifier: BSD-3-Clause
#

config MCUX_PRJSEG_module.board.display_support
    select MCUX_COMPONENT_driver.display-hx8394
    select MCUX_COMPONENT_driver.st7796s
    select MCUX_COMPONENT_driver.display-adv7535
    select MCUX_COMPONENT_driver.dc-fb-dcif_1
    select MCUX_COMPONENT_driver.dc-fb-dbi
    select MCUX_COMPONENT_driver.dbi_dcif
    select MCUX_COMPONENT_driver.lpi2c
    select MCUX_COMPONENT_driver.gpio
    select MCUX_ABSTRACT_COMPONENT_component_expander
    select MCUX_COMPONENT_driver.pcal6524
    select MCUX_COMPONENT_driver.pca9555

# Which panels the board supports
config MCUX_DEMO_PANEL_RK055MHD091A0_SUPPORT
    default y

config MCUX_DEMO_PANEL_LCD_PAR_S035_SUPPORT
    default y

config MCUX_DEMO_PANEL_LCM_RGB_5INCH_SUPPORT
    default y

config MCUX_DEMO_PANEL_MIPI2HDMI_SUPPORT
    default n

if MCUX_PRJSEG_module.board.display_support

    config DEMO_FRAME_RATE
        int "Display frame rate (Hz)"
        default 50
        help
            Display refresh rate in Hz used by display_support. Lowering it reduces
            the DCIF / MIPI-DSI scan-out bandwidth from PSRAM, which avoids glitching
            on the large 720x1280 panel; set it lower (e.g. 20) for heavy
            software-rendered LVGL use cases.
            No prefix in generated macro

    choice DISPLAY_SUPPORT_PANEL
        default LCM_RGB_5INCH
    endchoice

endif
```

## _boards/mimxrt700evk/Kconfig.defconfig
```kconfig
# Copyright 2024 NXP
# All rights reserved.
#
# SPDX-License-Identifier: BSD-3-Clause

if MCUX_COMPONENT_middleware.lvgl

    config LV_DRAW_BUF_ALIGN
        default 192 if LV_COLOR_DEPTH_24
        default 64

endif
```

## _boards/mimxrt700evk/cm33_core0/Kconfig
```kconfig
# Copyright 2024-2025 NXP
# All rights reserved.
#
# SPDX-License-Identifier: BSD-3-Clause

rsource "../../../lvgl_examples/lvgl_sdk/lvgl_support/rt700/Kconfig.lvgl_support"
```

## _boards/mimxrt700evk/project_segments/display_support/Kconfig.prjseg
```kconfig
# Copyright 2024 NXP
# All rights reserved.
#
# SPDX-License-Identifier: BSD-3-Clause
#

config MCUX_PRJSEG_module.board.display_support
    select MCUX_COMPONENT_driver.display-rm68200
    select MCUX_COMPONENT_driver.display-rm68191
    select MCUX_COMPONENT_driver.display-hx8394
    select MCUX_COMPONENT_driver.display-rm67162
    select MCUX_COMPONENT_driver.display-co5300
    select MCUX_COMPONENT_driver.display-rpi
    select MCUX_COMPONENT_driver.ssd1963
    select MCUX_COMPONENT_driver.st7796s
    select MCUX_COMPONENT_driver.dc-fb-dsi-cmd
    select MCUX_COMPONENT_driver.dc-fb-lcdif
    select MCUX_COMPONENT_driver.dc-fb-dbi
    select MCUX_COMPONENT_driver.dbi_lcdif
    select MCUX_COMPONENT_driver.dbi_flexio_edma
    select MCUX_COMPONENT_driver.lpflexcomm_lpi2c
    select MCUX_COMPONENT_driver.gpio
    select MCUX_COMPONENT_driver.edma4
    select DBI_USE_MIPI_PANEL

# Which panels the board supports
config MCUX_DEMO_PANEL_TFT_PROTO_5_SUPPORT
    default y

config MCUX_DEMO_PANEL_RK055AHD091_SUPPORT
    default y

config MCUX_DEMO_PANEL_RK055IQH091_SUPPORT
    default y

config MCUX_DEMO_PANEL_G1120B0MIPI_SUPPORT
    default y

config MCUX_DEMO_PANEL_RK055MHD091A0_SUPPORT
    default y

config MCUX_DEMO_PANEL_RASPI_7INCH_SUPPORT
    default y

config MCUX_DEMO_PANEL_ZC143AC72MIPI_SUPPORT
    default y

config MCUX_DEMO_PANEL_LCD_PAR_S035_SUPPORT
    default y

if MCUX_PRJSEG_module.board.display_support

    choice DISPLAY_SUPPORT_PANEL
        default RK055MHD091A0
    endchoice

    config SSD1963_DRIVEN_BY
        int
        default 0 if DEMO_PANEL_TFT_PROTO_5_FLEXIO
        default 1 if DEMO_PANEL_TFT_PROTO_5_LCDIF
        help
            Driver selection for panel TFT_PROTO_5
            No prefix in generated macro

    choice DEMO_PANEL_TFT_PROTO_5_DRIVER
        prompt "TFT_PROTO_5 driver Selection"
        default DEMO_PANEL_TFT_PROTO_5_LCDIF

        config DEMO_PANEL_TFT_PROTO_5_FLEXIO
            bool "Use FLEXIO to drive TFT_PROTO_5"

        config DEMO_PANEL_TFT_PROTO_5_LCDIF
            bool "Use LCDIF to drive TFT_PROTO_5"

    endchoice

    config DEMO_SSD1963_BUFFER_FORMAT
        int
        default 0 if DEMO_SSD1963_BUFFER_RGB565
        default 1 if DEMO_SSD1963_BUFFER_RGB888
        help
            No prefix in generated macro

    choice DEMO_SSD1963_BUFFER_FORMAT_SELECTION
        prompt "TFT_PROTO_5 panel pixel format"
        default DEMO_SSD1963_BUFFER_RGB565 if LV_COLOR_DEPTH_16
        default DEMO_SSD1963_BUFFER_RGB888 if LV_COLOR_DEPTH_24
        default DEMO_SSD1963_BUFFER_RGB565

        config DEMO_SSD1963_BUFFER_RGB565
            bool "RGB565 - 16bit"

        config DEMO_SSD1963_BUFFER_RGB888
            bool "RGB888 - 24bit"
    endchoice


    config DEMO_RM67162_BUFFER_FORMAT
        int
        default 0 if DEMO_RM67162_BUFFER_RGB565
        default 1 if DEMO_RM67162_BUFFER_RGB888
        help
            No prefix in generated macro

    choice DEMO_RM67162_BUFFER_FORMAT_SELECTION
        prompt "G1120B0MIPI panel pixel format"
        default DEMO_RM67162_BUFFER_RGB565 if LV_COLOR_DEPTH_16
        default DEMO_RM67162_BUFFER_RGB888 if LV_COLOR_DEPTH_24
        default DEMO_RM67162_BUFFER_RGB565

        config DEMO_RM67162_BUFFER_RGB565
            bool "RGB565 - 16bit"

        config DEMO_RM67162_BUFFER_RGB888
            bool "RGB888 - 24bit"
    endchoice

    config DEMO_CO5300_BUFFER_FORMAT
        int
        default 0 if DEMO_CO5300_BUFFER_RGB565
        default 1 if DEMO_CO5300_BUFFER_RGB888
        help
            No prefix in generated macro

    choice DEMO_CO5300_BUFFER_FORMAT_SELECTION
        prompt "ZC143AC72MIPI pixel format"
        default DEMO_CO5300_BUFFER_RGB565 if LV_COLOR_DEPTH_16
        default DEMO_CO5300_BUFFER_RGB888 if LV_COLOR_DEPTH_24 || MCUX_COMPONENT_middleware.libjpeg
        default DEMO_CO5300_BUFFER_RGB565

        config DEMO_CO5300_BUFFER_RGB565
            bool "RGB565 - 16bit"

        config DEMO_CO5300_BUFFER_RGB888
            bool "RGB888 - 24bit"
    endchoice

    config DEMO_RK055AHD091_USE_XRGB8888
        int
        default 0 if DEMO_RK055AHD091_BUFFER_RGB565
        default 1 if DEMO_RK055AHD091_BUFFER_XRGB8888
        help
            No prefix in generated macro

    choice DEMO_RK055AHD091_BUFFER_FORMAT_SELECTION
        prompt "RK055HDMIPI4M MIPI Panel pixel format"
        default DEMO_RK055AHD091_BUFFER_RGB565   if LV_COLOR_DEPTH_16
        default DEMO_RK055AHD091_BUFFER_XRGB8888 if LV_COLOR_DEPTH_32
        default DEMO_RK055AHD091_BUFFER_RGB565

        config DEMO_RK055AHD091_BUFFER_RGB565
            bool "RGB565 - 16bit"

        config DEMO_RK055AHD091_BUFFER_XRGB8888
            bool "XRGB888 - 32bit"
    endchoice

    config DEMO_RK055MHD091_USE_XRGB8888
        int
        default 0 if DEMO_RK055MHD091_BUFFER_RGB565
        default 1 if DEMO_RK055MHD091_BUFFER_XRGB8888
        help
            No prefix in generated macro

    choice DEMO_RK055MHD091_BUFFER_FORMAT_SELECTION
        prompt "RK055MHD091A0-CTG MIPI Panel pixel format"
        default DEMO_RK055MHD091_BUFFER_RGB565   if LV_COLOR_DEPTH_16
        default DEMO_RK055MHD091_BUFFER_XRGB8888 if LV_COLOR_DEPTH_32
        default DEMO_RK055MHD091_BUFFER_RGB565

        config DEMO_RK055MHD091_BUFFER_RGB565
            bool "RGB565 - 16bit"

        config DEMO_RK055MHD091_BUFFER_XRGB8888
            bool "XRGB888 - 32bit"
    endchoice

    config ST7796S_DRIVEN_BY
        int
        default 0 if DEMO_PANEL_LCD_PAR_S035_FLEXIO
        default 1 if DEMO_PANEL_LCD_PAR_S035_LCDIF
        help
            Driver selection for panel LCD_PAR_S035
            No prefix in generated macro

    choice DEMO_PANEL_LCD_PAR_S035_DRIVER
        prompt "LCD_PAR_S035 driver Selection"
        default DEMO_PANEL_LCD_PAR_S035_LCDIF

        config DEMO_PANEL_LCD_PAR_S035_FLEXIO
            bool "Use FLEXIO to drive LCD_PAR_S035"

        config DEMO_PANEL_LCD_PAR_S035_LCDIF
            bool "Use LCDIF to drive LCD_PAR_S035"

    endchoice

    config DEMO_LCD_PAR_S035_BUFFER_FORMAT
        int
        default 0 if DEMO_LCD_PAR_S035_BUFFER_RGB565
        default 1 if DEMO_LCD_PAR_S035_BUFFER_RGB888
        help
            No prefix in generated macro

    choice DEMO_LCD_PAR_S035_BUFFER_FORMAT_SELECTION
        prompt "LCD-PAR-S035 panel pixel format"
        default DEMO_LCD_PAR_S035_BUFFER_RGB565 if LV_COLOR_DEPTH_16
        default DEMO_LCD_PAR_S035_BUFFER_RGB888 if LV_COLOR_DEPTH_24
        default DEMO_LCD_PAR_S035_BUFFER_RGB565

        config DEMO_LCD_PAR_S035_BUFFER_RGB565
            bool "RGB565 - 16bit"

        config DEMO_LCD_PAR_S035_BUFFER_RGB888
            bool "RGB888 - 24bit"
    endchoice

endif
```

## _boards/twrmc56f8400/Kconfig
```kconfig
# Copyright 2024-2025 NXP
#
# SPDX-License-Identifier: BSD-3-Clause

rsource "Kconfig.defconfig"

config MCUX_HW_BOARD_twrmc56f8400
    bool
    default y
    imply MCUX_HW_DEVICE_MC56F84789
    imply MCUX_COMPONENT_driver.clock
    imply MCUX_COMPONENT_driver.dsc_gpio
    imply MCUX_COMPONENT_driver.dsc_sim
    imply MCUX_COMPONENT_driver.intc

    ## Board project segment dependency data
    select MCUX_COMPONENT_component.qsci_adapter if MCUX_PRJSEG_module.board.console_lite
```

## _common/components/Kconfig.flash_config
```kconfig
# Copyright 2024-2026 NXP
#
# SPDX-License-Identifier: BSD-3-Clause

config MCUX_COMPONENT_driver.flash_config
    bool "Use flash_config in image"

config MCUX_COMPONENT_driver.flash_config_custom
    bool "Use custom flash_config in image"
    default n
```

## _common/project_segments/ce_lite/Kconfig.prjseg
```kconfig
# Copyright 2026 NXP
#
# SPDX-License-Identifier: BSD-3-Clause

config MCUX_PRJSEG_module.ce_lite_support
    bool "Use ${board_root}/${board}/ce_lite_examples/ce_support[.c|.h]"
```
