## _common/project_segments/freertos/examples/tickless/Kconfig.prjseg
```kconfig
#
# Copyright 2025 NXP
#
# SPDX-License-Identifier: BSD-3-Clause
#

config TICKLESS_HAS_LEGACY_IMPL
    bool
    default n
    help
      Detect whether Tickless is using legacy implementation

config MCUX_PRJSEG_ENABLE_FREERTOS_TICKLESS
    bool "Enable FreeRTOS Tickless Project Segments"
    default n
    help
      Use this symbol to Enable FreeRTOS Tickless Project Segments

config MCUX_PRJSEG_FREERTOS_TICKLESS_HAL
    bool "Unified Tickless HAL Implementation"
    default y if !TICKLESS_HAS_LEGACY_IMPL && MCUX_PRJSEG_ENABLE_FREERTOS_TICKLESS
    help
      Unified Tickless HAL Implementation for FreeRTOS

# Timer selection
choice MCUX_PRJSEG_TICKLESS_TIMER
    prompt "FreeRTOS Tickless Timer Selection"
    depends on MCUX_PRJSEG_FREERTOS_TICKLESS_HAL
    default MCUX_PRJSEG_TICKLESS_TIMER_GPT if MCUX_HAS_COMPONENT_driver.gpt
    default MCUX_PRJSEG_TICKLESS_TIMER_LPTMR if MCUX_HAS_COMPONENT_driver.lptmr
    default MCUX_PRJSEG_TICKLESS_TIMER_RTC if MCUX_HAS_COMPONENT_driver.rtc
    default MCUX_PRJSEG_TICKLESS_TIMER_RTC_JDP if MCUX_HAS_COMPONENT_driver.rtc_jdp
    help
      Select which timer peripheral to use for FreeRTOS tickless mode

# config TICKLESS_TIMER_GPT
config MCUX_PRJSEG_TICKLESS_TIMER_GPT
    bool "GPT"
    select MCUX_COMPONENT_driver.gpt
    help
      Use General Purpose Timer (GPT) for tickless mode

config MCUX_PRJSEG_TICKLESS_TIMER_LPTMR
    bool "LPTMR"
    select MCUX_COMPONENT_driver.lptmr
    help
      Use Low Power Timer (LPTMR) for tickless mode

config MCUX_PRJSEG_TICKLESS_TIMER_RTC
    bool "RTC"
    select MCUX_COMPONENT_driver.lpc_rtc
    help
      Use Real Time Clock (RTC) for tickless mode

config MCUX_PRJSEG_TICKLESS_TIMER_RTC_JDP
    bool "RTC"
    select MCUX_COMPONENT_driver.rtc_jdp
    help
      Use Real Time Clock (RTC) for tickless mode

config MCUX_PRJSEG_TICKLESS_TIMER_OSTIMER
    bool "OSTIMER"
    select MCUX_COMPONENT_driver.ostimer
    help
      Use OS Timer for tickless mode

config MCUX_PRJSEG_TICKLESS_TIMER_LPIT
    bool "LPIT"
    select MCUX_COMPONENT_driver.lpit
    help
      Use Low Power Interrupt Timer (LPIT) for tickless mode

endchoice

# GPIO/Button interface selection
choice MCUX_PRJSEG_TICKLESS_GPIO
    prompt "FreeRTOS Tickless GPIO/Button Interface"
    depends on MCUX_PRJSEG_FREERTOS_TICKLESS_HAL
    default MCUX_PRJSEG_TICKLESS_GPIO_RGPIO if MCUX_HAS_COMPONENT_driver.rgpio
    default MCUX_PRJSEG_TICKLESS_GPIO_IGPIO if MCUX_HAS_COMPONENT_driver.igpio
    default MCUX_PRJSEG_TICKLESS_GPIO_SIUL2 if MCUX_HAS_COMPONENT_driver.siul2
    default MCUX_PRJSEG_TICKLESS_GPIO_STANDARD if MCUX_HAS_COMPONENT_driver.gpio
    help
      Select which GPIO peripheral to use for button input

config MCUX_PRJSEG_TICKLESS_GPIO_STANDARD
    bool "Standard GPIO"
    select MCUX_COMPONENT_driver.gpio
    help
      Use standard GPIO interface

config MCUX_PRJSEG_TICKLESS_GPIO_IGPIO
    bool "iMX GPIO"
    select MCUX_COMPONENT_driver.igpio
    help
      Use iMX GPIO interface

config MCUX_PRJSEG_TICKLESS_GPIO_RGPIO
    bool "RGPIO"
    select MCUX_COMPONENT_driver.rgpio_1
    help
      Use RGPIO interface

config MCUX_PRJSEG_TICKLESS_GPIO_SIUL2
    bool "SIUL2"
    select MCUX_COMPONENT_driver.siul2
    help
      Use SIUL2 interface

endchoice

config MCUX_PRJSEG_freertos_tickless_lpc_rtc_segment
    bool "freertos_tickless_gpt_igpio_segment"
    default n
    select TICKLESS_HAS_LEGACY_IMPL
    select MCUX_COMPONENT_driver.lpc_rtc

config MCUX_PRJSEG_freertos_tickless_ostimer_segment
    bool "freertos_tickless_ostimer_segment"
    default n
    select TICKLESS_HAS_LEGACY_IMPL
    select MCUX_COMPONENT_driver.ostimer

config MCUX_PRJSEG_freertos_tickless_lptmr_portmax32_segment
    bool "freertos_tickless_lptmr_portmax32_segment"
    default n
    select TICKLESS_HAS_LEGACY_IMPL
    select MCUX_COMPONENT_driver.lptmr

config MCUX_PRJSEG_freertos_tickless_lptmr_segment
    bool "freertos_tickless_lptmr_segment"
    default n
    select TICKLESS_HAS_LEGACY_IMPL
    select MCUX_COMPONENT_driver.lptmr

config MCUX_PRJSEG_freertos_tickless_lpit_segment
    bool "freertos_tickless_lpit_segment"
    default n
    select TICKLESS_HAS_LEGACY_IMPL
    select MCUX_COMPONENT_driver.lpit
    select MCUX_COMPONENT_driver.irqsteer
    select MCUX_COMPONENT_driver.igpio

config MCUX_PRJSEG_freertos_tickless_gpt_igpio_segment
    bool "freertos_tickless_gpt_igpio_segment"
    default n
    select TICKLESS_HAS_LEGACY_IMPL
    select MCUX_COMPONENT_driver.gpt
    select MCUX_COMPONENT_driver.igpio

config MCUX_PRJSEG_freertos_tickless_epit_segment
    bool "freertos_tickless_epit_segment"
    default n
    select TICKLESS_HAS_LEGACY_IMPL

config MCUX_PRJSEG_freertos_tickless_qn_rtc_segment
    bool "freertos_tickless_gpt_igpio_segment"
    default n
    select TICKLESS_HAS_LEGACY_IMPL

config MCUX_PRJSEG_freertos_tickless_rgpio_gpt_segment
    bool "freertos_tickless_gpt_igpio_segment"
    default n
    select TICKLESS_HAS_LEGACY_IMPL
    select MCUX_COMPONENT_driver.gpt
    select MCUX_COMPONENT_driver.rgpio
```

## _common/project_segments/wireless/rw61x/Kconfig.prjseg
```kconfig
# Copyright 2024 NXP
# SPDX-License-Identifier: BSD-3-Clause

config MCUX_PRJSEG_module.board.wireless.app_services
    bool "Wireless Application Services"
    help
      This is a collection of APP helpers used in wireless examples to abstract the initialization flow of
      some software components acting like services. This is a template for demo purpose and doesn't aim to
      always support all use cases.

config MCUX_PRJSEG_module.board.wireless.board_comp
    bool "Wireless Board Components"
    help
      This is a collection of BOARD helpers used in wireless examples to configure some SDK components such
      as LEDs, buttons, IOs. This is a template for demo purpose and doesn't aim to always support all use cases.

config MCUX_PRJSEG_module.board.wireless.board.lowpower
    bool "Wireless Board Low Power"
    select MCUX_COMPONENT_component.power_manager_framework
    select MCUX_COMPONENT_middleware.wireless.framework
    select MCUX_COMPONENT_middleware.wireless.framework.platform
    help
      This is a collection of BOARD helpers used in wireless examples to handle low power entry/exit at board level.
      This is a template for demo purpose and doesn't aim to always support all use cases.

config MCUX_PRJSEG_module.board.wireless.ble_app_mbedtls_psa_config
    bool "Optimized configuration file for BLE Applications with PSA"
    depends on MCUX_COMPONENT_middleware.wireless.framework.seclib_rng_port.psa
    help
      This is a customized PSA configuration file used in wireless BLE examples.

orsource "../../../../../${board_root}/${board}/project_segments/wireless/Kconfig.prjseg"
```
