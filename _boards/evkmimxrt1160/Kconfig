## _boards/evkmimxrt1160/Kconfig
```kconfig
# Copyright 2024 NXP
#
# SPDX-License-Identifier: BSD-3-Clause

rsource "${core_id}/Kconfig"
rsource "Kconfig.defconfig"

config MCUX_HW_BOARD_evkmimxrt1160
    bool
    default y
    imply MCUX_HW_DEVICE_MIMXRT1166

    imply MCUX_COMPONENT_driver.clock
    imply MCUX_COMPONENT_driver.igpio
    imply MCUX_COMPONENT_driver.iomuxc
    imply MCUX_COMPONENT_driver.anatop_ai
    imply MCUX_COMPONENT_driver.memory
    imply MCUX_COMPONENT_driver.dcdc_2
    imply MCUX_COMPONENT_driver.gpc_xxx_ctrl
    imply MCUX_COMPONENT_driver.pgmc
    imply MCUX_COMPONENT_driver.anadig_pmu
    imply MCUX_COMPONENT_driver.src_2
    select MCUX_COMPONENT_component.lpuart_adapter  if MCUX_COMPONENT_component.serial_manager_uart
    select MCUX_COMPONENT_component.lpuart_adapter  if MCUX_COMPONENT_utility.debug_console_lite
```

## _boards/evkmimxrt1160/demo_apps/tee_fault/core0/Kconfig.sysbuild
```kconfig
config secondary_core_id
    string
    default "cm4"

config secondary_config
    string
    default "debug"   if $(config) = "debug"
    default "debug"   if $(config) = "flexspi_nor_debug"
    default "release"   if $(config) = "release"
    default "release"   if $(config) = "flexspi_nor_release"
```

## _boards/evkmimxrt1180/Kconfig
```kconfig
# Copyright 2024 NXP
# All rights reserved.
#
# SPDX-License-Identifier: BSD-3-Clause

rsource "${core_id}/Kconfig"
rsource "Kconfig.defconfig"
rsource "../../_common/project_segments/freertos/examples/tickless/Kconfig.prjseg"

config MCUX_HW_BOARD_evkmimxrt1180
    bool
    default y
    imply MCUX_HW_DEVICE_MIMXRT1189

    select MCUX_HW_BOARD_interface.has_m2_slot
    imply MCUX_COMPONENT_driver.clock
    imply MCUX_COMPONENT_driver.rgpio
    imply MCUX_COMPONENT_driver.iomuxc
    imply MCUX_COMPONENT_driver.memory
    imply MCUX_COMPONENT_driver.ele_base_api
    imply MCUX_COMPONENT_driver.dcdc_3
    imply MCUX_COMPONENT_driver.gpc_3
    imply MCUX_COMPONENT_driver.anadig_pmu_1
    imply MCUX_COMPONENT_driver.src_3
    imply MCUX_COMPONENT_driver.misc
    select MCUX_COMPONENT_component.lpuart_adapter  if MCUX_COMPONENT_component.serial_manager_uart
    select MCUX_COMPONENT_component.lpuart_adapter  if MCUX_COMPONENT_utility.debug_console_lite
```

## _boards/evkmimxrt1180/Kconfig.sysbuild
```kconfig
config secondary_config
    string
    default "debug" if $(config) = "flexspi_nor_debug"
    default "release" if $(config) = "flexspi_nor_release"
    default "debug" if $(config) = "debug"
    default "release" if $(config) = "release"
    
config secondary_core_id
    string
    default "cm7" if $(core_id) = "cm33"
```

## _boards/evkmimxrt1180/demo_apps/tee_fault/core0/Kconfig.sysbuild
```kconfig
config secondary_core_id
    string
    default "cm7"

config secondary_config
    string
    default "debug"   if $(config) = "flexspi_nor_debug"
    default "release"   if $(config) = "flexspi_nor_release"
```

## _boards/evkmimxrt1180/driver_examples/netc/psi_vsi_message/cm33/Kconfig.sysbuild
```kconfig
config secondary_core_id
    string
    default "cm7"

config secondary_config
    string
```

## _boards/evkmimxrt595/Kconfig
```kconfig
# Copyright 2024 NXP
# All rights reserved.
#
# SPDX-License-Identifier: BSD-3-Clause

rsource "${core_id}/Kconfig"
rsource "Kconfig.defconfig"
rsource "../../_common/project_segments/lvgl/Kconfig.prjseg"
rsource "../../lvgl_examples/lvgl_sdk/lvgl_support/rt595/Kconfig.lvgl_support"
rsource "../../_common/project_segments/freertos/examples/tickless/Kconfig.prjseg"

config MCUX_HW_BOARD_evkmimxrt595
    bool
    default y
    imply MCUX_HW_DEVICE_MIMXRT595S
    imply MCUX_COMPONENT_driver.clock
    imply MCUX_COMPONENT_driver.common
    imply MCUX_COMPONENT_driver.power if MCUX_HW_DEVICE_MIMXRT595S_CORE_ID_cm33
    imply MCUX_COMPONENT_driver.flexspi if MCUX_HW_DEVICE_MIMXRT595S_CORE_ID_cm33
    imply MCUX_COMPONENT_driver.cache_cache64 if MCUX_HW_DEVICE_MIMXRT595S_CORE_ID_cm33
    imply MCUX_COMPONENT_driver.flexcomm_usart
    imply MCUX_COMPONENT_driver.flash_config if MCUX_HW_DEVICE_MIMXRT595S_CORE_ID_cm33
    imply MCUX_COMPONENT_driver.flexcomm
    imply MCUX_COMPONENT_driver.lpc_iopctl
    imply MCUX_COMPONENT_driver.lpc_gpio
    imply MCUX_COMPONENT_driver.reset if MCUX_HW_DEVICE_MIMXRT595S_CORE_ID_cm33
    imply MCUX_COMPONENT_driver.iap3 if MCUX_HW_DEVICE_MIMXRT595S_CORE_ID_cm33
```

## _boards/evkmimxrt595/cm33/Kconfig
```kconfig
# Copyright 2024 NXP
# All rights reserved.
#
# SPDX-License-Identifier: BSD-3-Clause

rsource "../../../_common/components/Kconfig.flash_config"
```

## _boards/evkmimxrt595/cm33/Kconfig.prjseg
```kconfig
# Copyright 2024 NXP
# All rights reserved.
#
# SPDX-License-Identifier: BSD-3-Clause

rsource "../../../_common/project_segments/dsp/Kconfig.prjseg"
rsource "../../../_common/project_segments/pmic/Kconfig.prjseg"
rsource "../../../_common/project_segments/display_support/Kconfig.prjseg"
rsource "../../../_common/project_segments/vglite_support/Kconfig.prjseg"

config MCUX_PRJSEG_module.dsp_support
    select MCUX_PRJSEG_module.pmic_support
    select MCUX_COMPONENT_driver.dsp

config MCUX_PRJSEG_module.pmic_support
    select MCUX_COMPONENT_driver.pca9420
```

## _boards/evkmimxrt685/Kconfig
```kconfig
# Copyright 2024 NXP
#
# SPDX-License-Identifier: BSD-3-Clause

rsource "${core_id}/Kconfig"
rsource "Kconfig.defconfig"

config MCUX_HW_BOARD_evkmimxrt685
    bool
    default y
    imply MCUX_HW_DEVICE_MIMXRT685S
    imply MCUX_COMPONENT_driver.clock
    imply MCUX_COMPONENT_driver.common
    imply MCUX_COMPONENT_driver.power if MCUX_HW_DEVICE_MIMXRT685S_CORE_ID_cm33
    imply MCUX_COMPONENT_driver.flexspi if MCUX_HW_DEVICE_MIMXRT685S_CORE_ID_cm33
    imply MCUX_COMPONENT_driver.cache_cache64 if MCUX_HW_DEVICE_MIMXRT685S_CORE_ID_cm33
    imply MCUX_COMPONENT_driver.flexcomm_usart
    imply MCUX_COMPONENT_driver.flash_config if MCUX_HW_DEVICE_MIMXRT685S_CORE_ID_cm33
    imply MCUX_COMPONENT_driver.flexcomm
    imply MCUX_COMPONENT_driver.lpc_iopctl
    imply MCUX_COMPONENT_driver.lpc_gpio
    imply MCUX_COMPONENT_driver.reset if MCUX_HW_DEVICE_MIMXRT685S_CORE_ID_cm33
```

## _boards/frdmk22f/Kconfig
```kconfig
# Copyright 2024 NXP
#
# SPDX-License-Identifier: BSD-3-Clause

rsource "Kconfig.defconfig"

config MCUX_HW_BOARD_frdmk22f
    bool
    default y
    imply MCUX_HW_DEVICE_MK22F51212
    imply MCUX_COMPONENT_driver.clock
    imply MCUX_COMPONENT_driver.common
    imply MCUX_COMPONENT_driver.uart
    imply MCUX_COMPONENT_driver.lpuart
    imply MCUX_COMPONENT_driver.port
    imply MCUX_COMPONENT_driver.smc
    imply MCUX_COMPONENT_driver.gpio
```

## _boards/frdmk32l2a4s/Kconfig
```kconfig
# Copyright 2024 NXP
#
# SPDX-License-Identifier: BSD-3-Clause

rsource "Kconfig.defconfig"

config MCUX_HW_BOARD_frdmk32l2a4s
    bool
    default y
    imply MCUX_HW_DEVICE_K32L2A41A
    imply MCUX_COMPONENT_driver.clock
    imply MCUX_COMPONENT_driver.common
    imply MCUX_COMPONENT_driver.lpuart
    imply MCUX_COMPONENT_driver.port
    imply MCUX_COMPONENT_driver.smc
    imply MCUX_COMPONENT_driver.gpio
```

## _boards/frdmk32l3a6/Kconfig
```kconfig
# Copyright 2024 NXP
#
# SPDX-License-Identifier: BSD-3-Clause

rsource "Kconfig.defconfig"

config MCUX_HW_BOARD_frdmk32l3a6
    bool
    default y
    imply MCUX_HW_DEVICE_K32L3A60
    imply MCUX_COMPONENT_driver.clock
    imply MCUX_COMPONENT_driver.common
    imply MCUX_COMPONENT_driver.msmc
    imply MCUX_COMPONENT_driver.port
    imply MCUX_COMPONENT_driver.lpuart
    imply MCUX_COMPONENT_driver.gpio
```

## _boards/frdmk32l3a6/Kconfig.sysbuild
```kconfig
config secondary_config
    string
    default "debug" if $(config) = "debug"
    default "release" if $(config) = "release"

config secondary_core_id
    string
    default "cm0plus" if $(core_id) = "cm4"
```

## _boards/frdmke02z40m/Kconfig
```kconfig
# Copyright 2024 NXP
# All rights reserved.
#
# SPDX-License-Identifier: BSD-3-Clause

rsource "Kconfig.defconfig"

config MCUX_HW_BOARD_frdmke02z40m
    bool
    default y
    imply MCUX_HW_DEVICE_MKE02Z4
    imply MCUX_COMPONENT_driver.clock
    imply MCUX_COMPONENT_driver.common
    imply MCUX_COMPONENT_driver.uart
    imply MCUX_COMPONENT_driver.port_ke02
    imply MCUX_COMPONENT_driver.gpio_1
```

## _boards/frdmke15z/Kconfig
```kconfig
# Copyright 2024 NXP
#
# SPDX-License-Identifier: BSD-3-Clause

rsource "Kconfig.defconfig"

config MCUX_HW_BOARD_frdmke15z
    bool
    default y
    imply MCUX_HW_DEVICE_MKE15Z7
```

## _boards/frdmke16z/Kconfig
```kconfig
# Copyright 2024 NXP
#
# SPDX-License-Identifier: BSD-3-Clause

rsource "Kconfig.defconfig"

config MCUX_HW_BOARD_frdmke16z
    bool
    default y
    imply MCUX_HW_DEVICE_MKE16Z4
```

## _boards/frdmmcxa166/Kconfig
```kconfig
# Copyright 2024 NXP
#
# SPDX-License-Identifier: BSD-3-Clause

rsource "Kconfig.defconfig"

config MCUX_HW_BOARD_frdmmcxa166
    bool
    default y
    imply MCUX_HW_DEVICE_MCXA166
    imply MCUX_COMPONENT_driver.clock
    imply MCUX_COMPONENT_driver.common
    imply MCUX_COMPONENT_driver.gpio
    imply MCUX_COMPONENT_driver.lpuart
    imply MCUX_COMPONENT_driver.port
    imply MCUX_COMPONENT_driver.mcx_spc
    imply MCUX_COMPONENT_driver.reset

    ## Board project segment dependency data

    select MCUX_COMPONENT_driver.port if MCUX_PRJSEG_module.board.pinmux
    select MCUX_COMPONENT_driver.gpio if MCUX_PRJSEG_module.board.pinmux
    select MCUX_COMPONENT_driver.clock if MCUX_PRJSEG_module.board.clock    
    select MCUX_COMPONENT_driver.reset if MCUX_PRJSEG_module.board.clock
    select MCUX_COMPONENT_driver.mcx_spc if MCUX_PRJSEG_module.board.clock 
    select MCUX_COMPONENT_component.lpuart_adapter if MCUX_PRJSEG_module.board.console_lite
    select MCUX_COMPONENT_driver.lpuart if MCUX_PRJSEG_module.board.console_lite
```

## _boards/frdmmcxa276/Kconfig
```kconfig
# Copyright 2024 NXP
# All rights reserved.
#
# SPDX-License-Identifier: BSD-3-Clause

rsource "Kconfig.defconfig"
rsource "../../_common/project_segments/lvgl/Kconfig.prjseg"
rsource "../../_common/project_segments/freertos/examples/tickless/Kconfig.prjseg"
rsource "../../lvgl_examples/lvgl_sdk/lvgl_support/mcx_flexio/Kconfig.lvgl_support"

config MCUX_HW_BOARD_frdmmcxa276
    bool
    default y
    imply MCUX_HW_DEVICE_MCXA276
    imply MCUX_COMPONENT_driver.clock
    imply MCUX_COMPONENT_driver.common
    imply MCUX_COMPONENT_driver.gpio
    imply MCUX_COMPONENT_driver.lpuart
    imply MCUX_COMPONENT_driver.port
    imply MCUX_COMPONENT_driver.mcx_spc
    imply MCUX_COMPONENT_driver.reset

    ## Board project segment dependency data

    select MCUX_COMPONENT_driver.port if MCUX_PRJSEG_module.board.pinmux
    select MCUX_COMPONENT_driver.gpio if MCUX_PRJSEG_module.board.pinmux
    select MCUX_COMPONENT_driver.clock if MCUX_PRJSEG_module.board.clock    
    select MCUX_COMPONENT_driver.reset if MCUX_PRJSEG_module.board.clock
    select MCUX_COMPONENT_driver.mcx_spc if MCUX_PRJSEG_module.board.clock 
    select MCUX_COMPONENT_component.lpuart_adapter if MCUX_PRJSEG_module.board.console_lite
    select MCUX_COMPONENT_driver.lpuart if MCUX_PRJSEG_module.board.console_lite
    select MCUX_COMPONENT_driver.dbi_flexio_edma if MCUX_COMPONENT_middleware.emwin
    select MCUX_COMPONENT_driver.dbi_flexio_edma if MCUX_COMPONENT_middleware.lvgl
```

## _boards/frdmmcxc242/Kconfig
```kconfig
# Copyright 2024 NXP
# All rights reserved.
#
# SPDX-License-Identifier: BSD-3-Clause

rsource "Kconfig.defconfig"
rsource "../../_common/project_segments/freertos/examples/tickless/Kconfig.prjseg"

config MCUX_HW_BOARD_frdmmcxc242
    bool
    default y
    imply MCUX_HW_DEVICE_MCXC242
    imply MCUX_COMPONENT_driver.clock
    imply MCUX_COMPONENT_driver.common
    imply MCUX_COMPONENT_driver.gpio
    imply MCUX_COMPONENT_driver.lpuart
    imply MCUX_COMPONENT_driver.port
    imply MCUX_COMPONENT_driver.smc

    ## Board project segment dependency data

    imply MCUX_COMPONENT_driver.clock if MCUX_PRJSEG_module.board.clock
    imply MCUX_COMPONENT_driver.smc if MCUX_PRJSEG_module.board.clock
    imply MCUX_COMPONENT_driver.lpuart if MCUX_PRJSEG_module.board.console_lite
    imply MCUX_COMPONENT_driver.smc if MCUX_PRJSEG_module.board.console_lite
    imply MCUX_COMPONENT_component.lpuart_adapter if MCUX_PRJSEG_module.board.console_lite
```

## _boards/frdmmcxn947/Kconfig.prjseg
```kconfig
# Copyright 2024 NXP
# SPDX-License-Identifier: BSD-3-Clause

rsource "../../_common/project_segments/lvgl/Kconfig.prjseg"
rsource "../../_common/project_segments/freertos/examples/tickless/Kconfig.prjseg"
rsource "../../lvgl_examples/lvgl_sdk/lvgl_support/mcx_flexio/Kconfig.lvgl_support"
```
