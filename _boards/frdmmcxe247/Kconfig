## _boards/frdmmcxe247/Kconfig
```kconfig
# Copyright 2024 NXP
# All rights reserved.
#
# SPDX-License-Identifier: BSD-3-Clause

rsource "Kconfig.defconfig"
rsource "../../_common/project_segments/freertos/examples/tickless/Kconfig.prjseg"

config MCUX_HW_BOARD_frdmmcxe247
    bool
    default y
    imply MCUX_HW_DEVICE_MCXE247
    imply MCUX_COMPONENT_driver.port
```

## _boards/frdmmcxe31b/Kconfig
```kconfig
# Copyright 2024, 2026 NXP
#
# SPDX-License-Identifier: BSD-3-Clause

rsource "Kconfig.defconfig"

config MCUX_HW_BOARD_frdmmcxe31b
    bool
    default y
    imply MCUX_HW_DEVICE_MCXE31B
    imply MCUX_COMPONENT_driver.cache_armv7_m7
    imply MCUX_COMPONENT_driver.clock
    imply MCUX_COMPONENT_driver.common
    imply MCUX_COMPONENT_driver.memory
    imply MCUX_COMPONENT_driver.siul2
    imply MCUX_COMPONENT_driver.lpuart

    ## Board project segment dependency data
    imply MCUX_COMPONENT_driver.clock if MCUX_PRJSEG_module.board.clock
    imply MCUX_COMPONENT_driver.lpuart if MCUX_PRJSEG_module.board.console_lite
    imply MCUX_COMPONENT_component.lpuart_adapter if MCUX_PRJSEG_module.board.console_lite
```

## _boards/frdmmcxe32b/Kconfig.sysbuild
```kconfig
#
# Copyright 2026 NXP
#
# SPDX-License-Identifier: BSD-3-Clause
#

config secondary_config
    string
    default "debug" if $(config) = "debug"
    default "release" if $(config) = "release"

config secondary_core_id
    string
    default "core1" if $(core_id) = "core0"
```

## _boards/frdmmcxl255/Kconfig
```kconfig
# Copyright 2025 NXP
# All rights reserved.
#
# SPDX-License-Identifier: BSD-3-Clause

rsource "${core_id}/Kconfig"
rsource "Kconfig.defconfig"
#rsource "../common/project_segments/display_support/Kconfig.prjseg"

config MCUX_HW_BOARD_frdmmcxl255
    bool
    default y
    imply MCUX_HW_DEVICE_MCXL255
    imply MCUX_COMPONENT_driver.clock
    imply MCUX_COMPONENT_driver.common
    imply MCUX_COMPONENT_driver.gpio
    imply MCUX_COMPONENT_driver.lpuart
    imply MCUX_COMPONENT_driver.port
    imply MCUX_COMPONENT_driver.reset
    imply MCUX_COMPONENT_driver.inputmux_connections

    ## Board project segment dependency data

    select MCUX_COMPONENT_driver.port if MCUX_PRJSEG_module.board.pinmux
    select MCUX_COMPONENT_driver.gpio if MCUX_PRJSEG_module.board.pinmux
    select MCUX_COMPONENT_driver.clock if MCUX_PRJSEG_module.board.clock    
    select MCUX_COMPONENT_driver.reset if MCUX_PRJSEG_module.board.clock
    select MCUX_COMPONENT_component.lpuart_adapter if MCUX_PRJSEG_module.board.console_lite
    select MCUX_COMPONENT_driver.lpuart if MCUX_PRJSEG_module.board.console_lite
```

## _boards/frdmmcxl255/Kconfig.prjseg
```kconfig
# Copyright 2026 NXP
# All rights reserved.
#
# SPDX-License-Identifier: BSD-3-Clause

rsource "../../_common/project_segments/freertos/examples/tickless/Kconfig.prjseg"
```

## _boards/frdmmcxl255/Kconfig.sysbuild
```kconfig
# Copyright 2026 NXP
# All rights reserved.
#
# SPDX-License-Identifier: BSD-3-Clause

config secondary_config
    string
    default "debug" if $(config) = "debug"
    default "release" if $(config) = "release"

config secondary_core_id
    string
    default "cm0plus" if $(core_id) = "cm33"
```

## _boards/frdmmcxw23/Kconfig.prjseg
```kconfig
# Copyright 2025 NXP
# SPDX-License-Identifier: BSD-3-Clause

rsource "../../_common/project_segments/wireless/Kconfig.prjseg"
rsource "../../_common/project_segments/wireless/mcxw23/Kconfig.prjseg"
rsource "../../../middleware/wireless/bluetooth/application/common/Kconfig"
rsource "../../_common/project_segments/freertos/examples/tickless/Kconfig.prjseg"
```

## _boards/frdmmcxw70/Kconfig
```kconfig
# Copyright 2026 NXP
#
# SPDX-License-Identifier: BSD-3-Clause

rsource "Kconfig.defconfig"

config MCUX_HW_BOARD_frdmmcxw70
    bool
    default y
    imply MCUX_HW_DEVICE_MCXW70AC
    imply MCUX_COMPONENT_driver.clock
    imply MCUX_COMPONENT_driver.common
    imply MCUX_COMPONENT_driver.lpuart
    imply MCUX_COMPONENT_driver.port
    imply MCUX_COMPONENT_driver.gpio
    imply MCUX_COMPONENT_driver.ccm32k
    imply MCUX_COMPONENT_driver.glikey
    imply MCUX_COMPONENT_driver.spc

config MCUX_COMPONENT_device.utility
    bool "utility for MCXW70AC"
    default n
```

## _boards/frdmmcxw71/Kconfig.defconfig
```kconfig
# Copyright 2024-2025 NXP
#
# SPDX-License-Identifier: BSD-3-Clause

# FreeRTOS board config
if MCUX_COMPONENT_middleware.freertos-kernel
    config configENABLE_FPU
        default n

    config configENABLE_MPU
        default n

    config configENABLE_TRUSTZONE
        default n

    config configRUN_FREERTOS_SECURE_ONLY
        default y
endif

config HAL_RPMSG_SELECT_ROLE
    default n

if MCUX_COMPONENT_utilities.gcov
    config MCUX_COMPONENT_utilities.gcov.board_init
        select MCUX_COMPONENT_driver.cmc
        default y
endif
```

## _boards/frdmrw612/project_segments/display_support/Kconfig.prjseg
```kconfig
# Copyright 2024 NXP
# All rights reserved.
#
# SPDX-License-Identifier: BSD-3-Clause
#

config MCUX_PRJSEG_module.board.display_support
    select MCUX_COMPONENT_driver.st7796s
    select MCUX_COMPONENT_driver.ili9341
    select MCUX_COMPONENT_driver.gt911
    select MCUX_COMPONENT_driver.ft6x06
    select MCUX_COMPONENT_driver.dc-fb-dbi
    select MCUX_COMPONENT_driver.dbi_lcdic_dma
    select MCUX_COMPONENT_driver.dbi_lpc_spi_dma
    select MCUX_COMPONENT_driver.inputmux
    select MCUX_COMPONENT_driver.flexcomm_i2c
    select ILI9341_USE_DBI_IFACE
    select FT6X06_USE_SIMPLE_I2C_API

# Which panels the board supports
config MCUX_DEMO_PANEL_ADAFRUIT_2_8_SUPPORT
    default y

config MCUX_DEMO_PANEL_LCD_PAR_S035_SUPPORT
    default y

if MCUX_PRJSEG_module.board.display_support

    choice DISPLAY_SUPPORT_PANEL
        default DEMO_PANEL_LCD_PAR_S035

    endchoice

endif
```

## _boards/imx943_orangebox/Kconfig
```kconfig
# Copyright 2025 NXP
#
# SPDX-License-Identifier: BSD-3-Clause

rsource "Kconfig.defconfig"
rsource "${core_id}/Kconfig"

config MCUX_HW_BOARD_imx943_orangebox
    bool
    default y
    imply MCUX_ABSTRACT_COMPONENT_component_expander
    imply MCUX_COMPONENT_driver.pcal6524
    imply MCUX_COMPONENT_driver.pcal6408
    imply MCUX_HW_DEVICE_MIMX94398
    imply MCUX_COMPONENT_component.ele_base_api
    imply MCUX_COMPONENT_driver.mu1
    imply MCUX_COMPONENT_component.sm.crc
    imply MCUX_COMPONENT_component.sm.scmi
    imply MCUX_COMPONENT_component.sm.smt
    select MCUX_COMPONENT_driver.srtm_config if MCUX_COMPONENT_driver.srtm

config MCUX_COMPONENT_driver.srtm_config
    bool
    default n
```

## _boards/imx943_orangebox/cm33_core0/Kconfig
```kconfig
# Copyright 2024 NXP
#
# SPDX-License-Identifier: BSD-3-Clause

config MCUX_HW_BOARD_imx943_orangebox_cm33_core0
    bool
    default n
    imply MCUX_COMPONENT_middleware.freertos-kernel.cm33_non_trustzone if MCUX_COMPONENT_middleware.freertos-kernel
```

## _boards/imx943_orangebox/cm33_core1/Kconfig
```kconfig
# Copyright 2025 NXP
#
# SPDX-License-Identifier: BSD-3-Clause

config MCUX_HW_BOARD_imx943_orangebox_cm33_core1
    bool
    default y
    imply MCUX_COMPONENT_middleware.freertos-kernel.cm33_non_trustzone if MCUX_COMPONENT_middleware.freertos-kernel
    select MCUX_COMPONENT_driver.app_srtm.cm33_core1 if MCUX_COMPONENT_driver.srtm

config MCUX_COMPONENT_driver.app_srtm.cm33_core1
    bool
    default n

config RL_BUFFER_COUNT_VALUE
    int
    default 4
    default 256 if MCUX_COMPONENT_driver.app_srtm.cm33_core1
```

## _boards/imx943_orangebox/cm7_core1/Kconfig
```kconfig
# Copyright 2025 NXP
#
# SPDX-License-Identifier: BSD-3-Clause

config MCUX_HW_BOARD_imx943_orangebox_cm7_core1
    bool
    default y
    select MCUX_PRJSEG_module.app_srtm.cm7_core1 if MCUX_COMPONENT_driver.srtm

config MCUX_PRJSEG_module.app_srtm.cm7_core1
    bool
    default n

config RL_BUFFER_COUNT_VALUE
    int
    default 4
    default 256 if MCUX_PRJSEG_module.app_srtm.cm7_core1
```

## _boards/imx943evk/Kconfig
```kconfig
# Copyright 2024 NXP
#
# SPDX-License-Identifier: BSD-3-Clause

rsource "Kconfig.defconfig"
rsource "${core_id}/Kconfig"

config MCUX_HW_BOARD_imx943evk
    bool
    default y
    imply MCUX_ABSTRACT_COMPONENT_component_expander
    imply MCUX_COMPONENT_driver.pca6416a
    imply MCUX_COMPONENT_driver.pcal6408
    imply MCUX_COMPONENT_component.i2c_mux
    imply MCUX_COMPONENT_component.i2c_mux_pca954x
    imply MCUX_COMPONENT_component.enable_pca9544
    imply MCUX_COMPONENT_component.enable_pca9548
    imply MCUX_HW_DEVICE_MIMX94398
    imply MCUX_COMPONENT_driver.wm8962
    imply MCUX_COMPONENT_component.ele_base_api
    imply MCUX_COMPONENT_driver.mu1
    imply MCUX_COMPONENT_component.sm.crc
    imply MCUX_COMPONENT_component.sm.scmi
    imply MCUX_COMPONENT_component.sm.smt
    imply MCUX_COMPONENT_driver.xbar_1
    select MCUX_PRJSEG_module.srtm_config if MCUX_COMPONENT_driver.srtm
    select MCUX_PRJSEG_module.custom_rsc_table if MCUX_COMPONENT_driver.srtm

config MCUX_COMPONENT_driver.sm_cfg
    bool
    default n

config MCUX_COMPONENT_driver.non_sm_cfg
    bool
    default n

config MCUX_PRJSEG_module.srtm_config
    bool
    default n

config MCUX_PRJSEG_module.custom_rsc_table
    bool
    default n
```

## _boards/imx943evk/Kconfig.sysbuild
```kconfig
config secondary_config
    string
    default "debug" if $(config) = "debug"
    default "release" if $(config) = "release"

config secondary_core_id
    string
    default "cm7_core1" if $(core_id) = "cm33_core1"
    default "cm7_core0" if $(core_id) = "cm33_core1"
    default "cm7_core1" if $(core_id) = "cm7_core0"
    default "cm33_core1" if $(core_id) = "cm7_core0"
    default "cm33_core1" if $(core_id) = "cm7_core1"
    default "cm7_core0" if $(core_id) = "cm7_core1"
```

## _boards/imx943evk/ca55/Kconfig
```kconfig
# Copyright 2026 NXP
#
# SPDX-License-Identifier: BSD-3-Clause

config MCUX_HW_BOARD_imx943evk_ca55
    bool
    default y
    select MCUX_COMPONENT_component.sm.imx943_ca55
    select MCUX_COMPONENT_driver.sm_cfg
```

## _boards/imx943evk/cm33_core1/Kconfig
```kconfig
# Copyright 2024 NXP
#
# SPDX-License-Identifier: BSD-3-Clause

config MCUX_HW_BOARD_imx943evk_cm33_core1
    bool
    default y
    imply MCUX_COMPONENT_middleware.freertos-kernel.cm33_non_trustzone if MCUX_COMPONENT_middleware.freertos-kernel
    select MCUX_COMPONENT_driver.app_srtm.cm33_core1 if MCUX_COMPONENT_driver.srtm

config MCUX_COMPONENT_driver.app_srtm.cm33_core1
    bool
    select MCUX_COMPONENT_driver.rpmsg_config.cm33_core1
    default n

config MCUX_COMPONENT_driver.rpmsg_config.cm33_core1
    bool "The option is a common rpmsg config for demos using srtm"
    default n
```

## _boards/imx943evk/cm7_core0/Kconfig
```kconfig
# Copyright 2024 NXP
#
# SPDX-License-Identifier: BSD-3-Clause

config MCUX_HW_BOARD_imx943evk_cm7_core0
    bool
    default y
    select MCUX_PRJSEG_module.app_srtm.cm7_core0 if MCUX_COMPONENT_driver.srtm

config MCUX_PRJSEG_module.app_srtm.cm7_core0
    bool
    select MCUX_PRJSEG_module.rpmsg_config.cm7_core0
    default n

config MCUX_PRJSEG_module.rpmsg_config.cm7_core0
    bool "The option is a common rpmsg config for demos using srtm"
    default n
```

## _boards/imx943evk/cm7_core1/Kconfig
```kconfig
# Copyright 2024 NXP
#
# SPDX-License-Identifier: BSD-3-Clause

config MCUX_HW_BOARD_imx943evk_cm7_core1
    bool
    default y
    select MCUX_PRJSEG_module.app_srtm.cm7_core1 if MCUX_COMPONENT_driver.srtm

config MCUX_PRJSEG_module.app_srtm.cm7_core1
    bool
    select MCUX_PRJSEG_module.rpmsg_config.cm7_core1
    default n

config MCUX_PRJSEG_module.rpmsg_config.cm7_core1
    bool "The option is a common rpmsg config for demos using srtm"
    default n
```

## _boards/imx95lpd5evk19/Kconfig
```kconfig
# Copyright 2024, 2026 NXP
#
# SPDX-License-Identifier: BSD-3-Clause

rsource "Kconfig.defconfig"
orsource "$(core_id)/Kconfig"

config MCUX_HW_BOARD_imx95lpd5evk19
    bool
    default y
    imply MCUX_HW_DEVICE_MIMX9596
```

## _boards/kw47evk/Kconfig.prjseg
```kconfig
# Copyright 2024 NXP
# SPDX-License-Identifier: BSD-3-Clause

rsource "../../_common/project_segments/wireless/Kconfig.prjseg"
rsource "../../_common/project_segments/wireless/wireless_mcu/${core_id}/Kconfig.prjseg"
orsource "../../../middleware/wireless/bluetooth/application/common/Kconfig"
rsource "../../_common/project_segments/ce/Kconfig.prjseg"
rsource "../../_common/project_segments/freertos/examples/tickless/Kconfig.prjseg"
```

## _boards/lpcxpresso860max/Kconfig.prjseg
```kconfig
# Copyright 2025 NXP
#
# SPDX-License-Identifier: BSD-3-Clause
#

rsource "../../_common/project_segments/freertos/examples/tickless/Kconfig.prjseg"
```

## _boards/mc56f80000evk/Kconfig
```kconfig
# Copyright 2024-2025 NXP
#
# SPDX-License-Identifier: BSD-3-Clause

rsource "Kconfig.defconfig"

config MCUX_HW_BOARD_mc56f80000evk
    bool
    default y
    imply MCUX_HW_DEVICE_MC56F80748
    imply MCUX_COMPONENT_driver.clock
    imply MCUX_COMPONENT_driver.dsc_gpio
    imply MCUX_COMPONENT_driver.dsc_device_sim
    imply MCUX_COMPONENT_driver.intc

    ## Board project segment dependency data
    select MCUX_COMPONENT_component.qsci_adapter if MCUX_PRJSEG_module.board.console_lite
```
