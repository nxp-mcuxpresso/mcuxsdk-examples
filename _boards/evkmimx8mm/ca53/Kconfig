## _boards/frdmmcxc353/Kconfig
```kconfig
# Copyright 2026 NXP
#
# SPDX-License-Identifier: BSD-3-Clause

rsource "Kconfig.defconfig"

config MCUX_HW_BOARD_frdmmcxc353
    bool
    default y
    imply MCUX_HW_DEVICE_MCXC353
    imply MCUX_COMPONENT_driver.clock
    imply MCUX_COMPONENT_driver.common
    imply MCUX_COMPONENT_driver.gpio
    imply MCUX_COMPONENT_driver.lpuart
    imply MCUX_COMPONENT_driver.port
    #imply MCUX_COMPONENT_driver.mcx_spc
    imply MCUX_COMPONENT_driver.reset

    ## Board project segment dependency data

    select MCUX_COMPONENT_driver.port if MCUX_HAS_PRJSEG_module.board.pinmux_sel
    select MCUX_COMPONENT_driver.gpio if MCUX_HAS_PRJSEG_module.board.pinmux_sel
    select MCUX_COMPONENT_driver.xbar_1 if MCUX_HAS_PRJSEG_module.board.pinmux_sel
    select MCUX_COMPONENT_driver.clock if MCUX_PRJSEG_module.board.clock
    select MCUX_COMPONENT_driver.reset if MCUX_PRJSEG_module.board.clock
    #select MCUX_COMPONENT_driver.mcx_spc if MCUX_PRJSEG_module.board.clock
    select MCUX_COMPONENT_component.lpuart_adapter if MCUX_PRJSEG_module.board.console_lite
    select MCUX_COMPONENT_driver.lpuart if MCUX_PRJSEG_module.board.console_lite
```
