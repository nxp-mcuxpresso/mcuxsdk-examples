## _boards/evkmimx8mm/ca53/Kconfig
```kconfig
# Copyright 2026 NXP
#
# SPDX-License-Identifier: BSD-3-Clause

config MCUX_HW_BOARD_evkmimx8mm_ca53
    bool
    default y
```

## _boards/evkmimx8mp/ca53/Kconfig
```kconfig
# Copyright 2026 NXP
#
# SPDX-License-Identifier: BSD-3-Clause

config MCUX_HW_BOARD_evkmimx8mp_ca53
    bool
    default y
```

## _boards/evkmimx8ulp/project_segments/display_support/Kconfig.prjseg
```kconfig
# Copyright 2024 NXP
#
# SPDX-License-Identifier: BSD-3-Clause
#

config MCUX_PRJSEG_module.board.display_support
    select MCUX_COMPONENT_driver.display-rm68200
    select MCUX_COMPONENT_driver.display-hx8394
    select MCUX_COMPONENT_driver.lpi2c

# Which panels the board supports
config MCUX_DEMO_PANEL_RK055AHD091_SUPPORT
    default y

config MCUX_DEMO_PANEL_RK055MHD091A0_SUPPORT
    default y

if MCUX_PRJSEG_module.board.display_support

    choice DISPLAY_SUPPORT_PANEL
        default RK055MHD091A0

    endchoice

    config APP_DISPLAY_EXTERNAL_CONVERTOR
        bool "Use HDMI port"
        help
            No prefix in generated macro

endif
```

## _boards/evkmimxrt1040/project_segments/display_support/Kconfig.prjseg
```kconfig
config MCUX_PRJSEG_module.board.display_support
    select MCUX_COMPONENT_driver.dc-fb-elcdif

# Which panels the board supports
config MCUX_DEMO_PANEL_RK043FN02H_SUPPORT
    default y

config MCUX_DEMO_PANEL_RK043FN66HS_SUPPORT
    default y

if MCUX_PRJSEG_module.board.display_support

    choice DISPLAY_SUPPORT_PANEL
        default DEMO_PANEL_RK043FN66HS

    endchoice

endif
```

## _boards/evkmimxrt1160/project_segments/display_support/Kconfig.prjseg
```kconfig
# Copyright 2024 NXP
# All rights reserved.
#
# SPDX-License-Identifier: BSD-3-Clause
#

config MCUX_PRJSEG_module.board.display_support
    select MCUX_COMPONENT_driver.display-rm68200
    select MCUX_COMPONENT_driver.display-rm68191
    select MCUX_COMPONENT_driver.display-hx8394
    select MCUX_COMPONENT_driver.dc-fb-elcdif
    select MCUX_COMPONENT_driver.dc-fb-lcdifv2

# Which panels the board supports
config DEMO_PANEL_RK055AHD091_SUPPORT
    default y

config DEMO_PANEL_RK055IQH091_SUPPORT
    default y

config DEMO_PANEL_RK055MHD091A0_SUPPORT
    default y

if MCUX_PRJSEG_module.board.display_support

    config DEMO_DISPLAY_CONTROLLER
        int
        default 0 if DEMO_PANEL_elcdif
        default 1 if DEMO_PANEL_lcdifv2
        help
            Panel driver selection for display support
            No prefix in generated macro

    choice DISPLAY_SUPPORT_PANEL
        default DEMO_PANEL_RK055MHD091A0

    endchoice

    choice DEMO_PANEL_display_controller
        prompt "Display Controller Selection"
        default DEMO_PANEL_lcdifv2

        config DEMO_PANEL_elcdif
            bool "eLCDIF"

        config DEMO_PANEL_lcdifv2
            bool "LCDIFv2"

    endchoice

    config DEMO_USE_XRGB8888
        bool "Use XRGB8888 pixel format"
        help
            No prefix in generated macro

    config DEMO_USE_LUT8
        bool "Use LUT 8 pixel format"
        help
            No prefix in generated macro

endif
```

## _boards/evkmimxrt1160/xip/Kconfig
```kconfig
# Copyright 2024-2025 NXP
#
# SPDX-License-Identifier: BSD-3-Clause

config MCUX_COMPONENT_board.boot_header
    bool "Use board boot header"
```

## _boards/evkmimxrt595/project_segments/display_support/Kconfig.prjseg
```kconfig
# Copyright 2024 NXP
# All rights reserved.
#
# SPDX-License-Identifier: BSD-3-Clause
#

config MCUX_PRJSEG_module.board.display_support
    select MCUX_COMPONENT_driver.display-rm68200
    select MCUX_COMPONENT_driver.display-rm68191
    select MCUX_COMPONENT_driver.display-hx8394
    select MCUX_COMPONENT_driver.display-rm67162
    select MCUX_COMPONENT_driver.dc-fb-lcdif
    select MCUX_COMPONENT_driver.dc-fb-dsi-cmd
    select MCUX_COMPONENT_driver.dc-fb-ssd1963
    select MCUX_COMPONENT_driver.mipi_dsi_smartdma
    select MCUX_COMPONENT_driver.flexio_mculcd_smartdma
    select MCUX_COMPONENT_driver.dbi_flexio_smartdma

# Which panels the board supports
config MCUX_DEMO_PANEL_TFT_PROTO_5_SUPPORT
    default y

config MCUX_DEMO_PANEL_RK055AHD091_SUPPORT
    default y

config MCUX_DEMO_PANEL_RK055IQH091_SUPPORT
    default y

config MCUX_DEMO_PANEL_G1120B0MIPI_SUPPORT
    default y

config MCUX_DEMO_PANEL_RK055MHD091A0_SUPPORT
    default y

if MCUX_PRJSEG_module.board.display_support

    choice DISPLAY_SUPPORT_PANEL
        default DEMO_PANEL_RK055MHD091A0

    endchoice
endif
```

## _boards/frdmimx937/Kconfig.prjseg
```kconfig
# Copyright 2026 NXP
# SPDX-License-Identifier: BSD-3-Clause

rsource "../../../examples/_common/project_segments/display_support/Kconfig.prjseg"
```

## _boards/frdmimx95/project_segments/display_support/Kconfig.prjseg
```kconfig
# Copyright 2024 NXP
#
# SPDX-License-Identifier: BSD-3-Clause
#

config MCUX_PRJSEG_module.board.display_support
    select MCUX_COMPONENT_driver.display-rm692c9
    select MCUX_COMPONENT_driver.display-adv7535
    select MCUX_COMPONENT_driver.display-it6263
    select MCUX_COMPONENT_driver.lpi2c

# Which panels the board supports
config MCUX_DEMO_PANEL_MX9_DSI_OLED_SUPPORT
    default y

config MCUX_DEMO_PANEL_MIPI2HDMI_SUPPORT
    default y

if MCUX_PRJSEG_module.board.display_support

    config DPU_EXAMPLE_DI
        string
        default DPU_DI_MIPI if MCUX_PRJSEG_module.board.display_support.DPU_DI_MIPI
        default DPU_DI_LVDS if MCUX_PRJSEG_module.board.display_support.DPU_DI_LVDS
        help
            Port selection for display support
            No prefix in generated macro

    choice MCUX_PRJSEG_module.board.display_support.port
        prompt "port Selection"
        default MCUX_PRJSEG_module.board.display_support.DPU_DI_MIPI

        config MCUX_PRJSEG_module.board.display_support.DPU_DI_MIPI
            bool "DPU_DI_MIPI port"

        config MCUX_PRJSEG_module.board.display_support.DPU_DI_LVDS
            bool "DPU_DI_LVDS port"
    endchoice

    config APP_DISPLAY_EXTERNAL_CONVERTOR
        bool "MIPI or LVDS to HDMI convertor card"
        help
            No prefix in generated macro

    choice DISPLAY_SUPPORT_PANEL
        default MX9_DSI_OLED
    endchoice

endif
```

## _boards/frdmimx952/Kconfig
```kconfig
# Copyright 2026 NXP
# All rights reserved.
#
# SPDX-License-Identifier: BSD-3-Clause

rsource "Kconfig.defconfig"

config MCUX_HW_BOARD_frdmimx952
    bool
    default y
    imply MCUX_HW_DEVICE_MIMX9529
    imply MCUX_COMPONENT_driver.mu1
    imply MCUX_COMPONENT_component.sm.crc
    imply MCUX_COMPONENT_component.sm.scmi
    imply MCUX_COMPONENT_component.sm.smt
    imply MCUX_COMPONENT_component.ele_base_api
    imply MCUX_COMPONENT_driver.rgpio
    imply MCUX_COMPONENT_component.rgpio_adapter if MCUX_COMPONENT_driver.srtm
    imply MCUX_COMPONENT_component.srtm_io_service if MCUX_COMPONENT_driver.srtm
```

## _boards/frdmimx952/project_segments/display_support/Kconfig.prjseg
```kconfig
# Copyright 2026 NXP
#
# SPDX-License-Identifier: BSD-3-Clause
#

config MCUX_PRJSEG_module.board.display_support
    select MCUX_COMPONENT_driver.display-it6263
    select MCUX_COMPONENT_driver.display-waveshare-dsi2dpi
    select MCUX_COMPONENT_driver.lpi2c

# Which panels the board supports
config MCUX_DEMO_PANEL_LCD_SPEC_SUPPORT
    default y

config MCUX_DEMO_PANEL_LVDS2HDMI_SUPPORT
    default y

config MCUX_DEMO_PANEL_WAVESHARE_DSI2DPI_SUPPORT
    default y

if MCUX_PRJSEG_module.board.display_support

    config DPU_EXAMPLE_DI
        string
        default DPU_DI_MIPI if MCUX_PRJSEG_module.board.display_support.DPU_DI_MIPI
        default DPU_DI_LVDS if MCUX_PRJSEG_module.board.display_support.DPU_DI_LVDS
        help
            Port selection for display support
            No prefix in generated macro

    choice MCUX_PRJSEG_module.board.display_support.port
        prompt "port Selection"
        default MCUX_PRJSEG_module.board.display_support.DPU_DI_LVDS

        config MCUX_PRJSEG_module.board.display_support.DPU_DI_MIPI
            bool "DPU_DI_MIPI port"

        config MCUX_PRJSEG_module.board.display_support.DPU_DI_LVDS
            bool "DPU_DI_LVDS port"
    endchoice

    config APP_DISPLAY_EXTERNAL_CONVERTOR
        bool "MIPI or LVDS to HDMI convertor card"
        help
            No prefix in generated macro

    config LDB_DUAL_PANEL
        int
	default 0 if MCUX_PRJSEG_module.board.display_support.LDB_DUAL_PANEL_DISABLE
	default 1 if MCUX_PRJSEG_module.board.display_support.LDB_DUAL_PANEL_ENABLE
	help
            Ldb dual panel setting selection for display support
            No prefix in generated macro

    choice MCUX_PRJSEG_module.board.display_support.ldb
        prompt "dual panel Selection"
	default MCUX_PRJSEG_module.board.display_support.LDB_DUAL_PANEL_DISABLE

	config MCUX_PRJSEG_module.board.display_support.LDB_DUAL_PANEL_DISABLE
            bool "Disable DUAL panel setting for LDB"

        config MCUX_PRJSEG_module.board.display_support.LDB_DUAL_PANEL_ENABLE
            bool "Enable DUAL panel setting for LDB"
    endchoice

    choice DISPLAY_SUPPORT_PANEL
        default LCD_SPEC
    endchoice

endif
```

## _boards/frdmimxrt1152/eiq_examples/mpp/Kconfig.sysbuild
```kconfig
config secondary_config
    string
    default "debug" if $(config) = "flexspi_nor_sdram_debug"
    default "release" if $(config) = "flexspi_nor_sdram_release"
```

## _boards/frdmimxrt1152/project_segments/display_support/Kconfig.prjseg
```kconfig
# Copyright 2026 NXP
#
# SPDX-License-Identifier: BSD-3-Clause
#

config MCUX_PRJSEG_module.board.display_support
    select MCUX_COMPONENT_driver.display-rm68200
    select MCUX_COMPONENT_driver.display-rm68191
    select MCUX_COMPONENT_driver.display-hx8394
    select MCUX_COMPONENT_driver.display-rpi
    select MCUX_COMPONENT_driver.dc-fb-elcdif
    select MCUX_COMPONENT_driver.dc-fb-lcdifv2
    select MCUX_COMPONENT_driver.lpi2c

# Which panels the board supports
config MCUX_DEMO_PANEL_RK055AHD091_SUPPORT
    default y

config MCUX_DEMO_PANEL_RK055IQH091_SUPPORT
    default y

config MCUX_DEMO_PANEL_RK055MHD091A0_SUPPORT
    default y

config MCUX_DEMO_PANEL_RASPI_7INCH_SUPPORT
    default y

if MCUX_PRJSEG_module.board.display_support

    choice DISPLAY_SUPPORT_PANEL
        default RASPI_7INCH
    endchoice

    config DEMO_DISPLAY_CONTROLLER
        int
        default 0 if DEMO_PANEL_elcdif
        default 1 if DEMO_PANEL_lcdifv2
        help
            Panel driver selection for display support
            No prefix in generated macro


    choice DEMO_PANEL_display_controller
        prompt "Display Controller Selection"
        default DEMO_PANEL_lcdifv2

        config DEMO_PANEL_elcdif
            bool "eLCDIF"

        config DEMO_PANEL_lcdifv2
            bool "LCDIFv2"

    endchoice

    config DEMO_USE_XRGB8888
        bool "Use XRGB8888 pixel format"
        help
            No prefix in generated macro

    config DEMO_USE_LUT8
        bool "Use LUT 8 pixel format"
        help
            No prefix in generated macro

endif
```

## _boards/frdmimxrt1152/xip/Kconfig
```kconfig
# Copyright 2026 NXP
#
# SPDX-License-Identifier: BSD-3-Clause

config MCUX_COMPONENT_board.boot_header
    bool "Use board boot header"
```

## _boards/frdmimxrt1186/Kconfig.prjseg
```kconfig
# Copyright 2024-2025 NXP
#
# SPDX-License-Identifier: BSD-3-Clause

orsource "${core_id}/Kconfig.prjseg"
rsource "../../../examples/_common/project_segments/freertos/examples/tickless/Kconfig.prjseg"
```

## _boards/frdmimxrt700/Kconfig.defconfig
```kconfig
# Copyright 2024-2026 NXP
#
# SPDX-License-Identifier: BSD-3-Clause

if MCUX_COMPONENT_middleware.lvgl

    config LV_DRAW_BUF_ALIGN
        default 192 if LV_COLOR_DEPTH_24
        default 64

endif
```

## _boards/frdmimxrt700/Kconfig.prjseg
```kconfig
# Copyright 2024-2026 NXP
#
# SPDX-License-Identifier: BSD-3-Clause

orsource "${core_id}/Kconfig.prjseg"

rsource "../../_common/project_segments/freertos/examples/tickless/Kconfig.prjseg"
```

## _boards/frdmimxrt700/cm33_core0/Kconfig
```kconfig
# Copyright 2026 NXP
#
# SPDX-License-Identifier: BSD-3-Clause

rsource "../../../lvgl_examples/lvgl_sdk/lvgl_support/rt700/Kconfig.lvgl_support"
```

## _boards/frdmimxrt700/project_segments/display_support/Kconfig.prjseg
```kconfig
# Copyright 2026 NXP
#
# SPDX-License-Identifier: BSD-3-Clause
#

config MCUX_PRJSEG_module.board.display_support
    # select MCUX_COMPONENT_driver.display-co5300
    select MCUX_COMPONENT_driver.display-rpi
    select MCUX_COMPONENT_driver.dc-fb-dsi-cmd
    select MCUX_COMPONENT_driver.dc-fb-lcdif
    select MCUX_COMPONENT_driver.dc-fb-dbi
    select MCUX_COMPONENT_driver.dbi_lcdif
    select MCUX_COMPONENT_driver.dbi_flexio_edma
    select MCUX_COMPONENT_driver.lpflexcomm_lpi2c
    select MCUX_COMPONENT_driver.gpio
    select MCUX_COMPONENT_driver.edma4
    select DBI_USE_MIPI_PANEL

config MCUX_DEMO_PANEL_RASPI_7INCH_SUPPORT
    default y

#config MCUX_DEMO_PANEL_ZC143AC72MIPI_SUPPORT
#    default y

if MCUX_PRJSEG_module.board.display_support

    choice DISPLAY_SUPPORT_PANEL
        default RASPI_7INCH
    endchoice

    # if ZC143AC72MIPI
    #     config DEMO_CO5300_BUFFER_FORMAT
    #         int
    #         default 0 if DEMO_CO5300_BUFFER_RGB565
    #         default 1 if DEMO_CO5300_BUFFER_RGB888
    #         help
    #             No prefix in generated macro

    #     choice DEMO_CO5300_BUFFER_FORMAT_SELECTION
    #         prompt "TFT_PROTO_5 pixel format"
    #         default DEMO_CO5300_BUFFER_RGB565 if LV_COLOR_DEPTH_16
    #         default DEMO_CO5300_BUFFER_RGB888 if LV_COLOR_DEPTH_24
    #         default DEMO_CO5300_BUFFER_RGB565

    #         config DEMO_CO5300_BUFFER_RGB565
    #             bool "RGB565 - 16bit"

    #         config DEMO_CO5300_BUFFER_RGB888
    #             bool "RGB888 - 24bit"
    #     endchoice
    # endif

endif
```

## _boards/frdmimxrt700/tfm_examples/Kconfig.sysbuild
```kconfig
#
# Copyright 2026 NXP
#
# SPDX-License-Identifier: BSD-3-Clause

config secondary_config
    string
    default "debug" if $(config) = "debug"
    default "release" if $(config) = "release"

config secondary_core_id
    string
    default "cm33_core0"
```

## _boards/frdmkw43/Kconfig
```kconfig
# Copyright 2026 NXP
#
# SPDX-License-Identifier: BSD-3-Clause

rsource "Kconfig.defconfig"

config MCUX_HW_BOARD_frdmkw43
    bool
    default y
    imply MCUX_HW_DEVICE_KW43B43ZC7
    imply MCUX_COMPONENT_driver.clock
    imply MCUX_COMPONENT_driver.common
    imply MCUX_COMPONENT_driver.lpuart
    imply MCUX_COMPONENT_driver.port
    imply MCUX_COMPONENT_driver.gpio
    imply MCUX_COMPONENT_driver.ccm32k
    imply MCUX_COMPONENT_driver.glikey
    imply MCUX_COMPONENT_driver.spc

config MCUX_COMPONENT_device.utility
    bool "utility for KW43B43ZC7"
    default n
```

## _boards/frdmkw43/Kconfig.prjseg
```kconfig
# Copyright 2026 NXP
# SPDX-License-Identifier: BSD-3-Clause

rsource "../../../examples/_common/project_segments/wireless/Kconfig.prjseg"
rsource "../../../examples/_common/project_segments/wireless/wireless_mcu/Kconfig.prjseg"
rsource "../../../middleware/wireless/bluetooth/application/common/Kconfig"
rsource "../../../examples/_common/project_segments/ce_lite/Kconfig.prjseg"
rsource "../../../examples/_common/project_segments/freertos/examples/tickless/Kconfig.prjseg"
```

## _boards/frdmmcxa577/Kconfig.prjseg
```kconfig
# Copyright 2026 NXP
# SPDX-License-Identifier: BSD-3-Clause

rsource "${SdkRootDirPath}/examples/_common/project_segments/lvgl/Kconfig.prjseg"
rsource "${SdkRootDirPath}/examples/_common/project_segments/freertos/examples/tickless/Kconfig.prjseg"
rsource "${SdkRootDirPath}/examples/lvgl_examples/lvgl_sdk/lvgl_support/mcx_flexio/Kconfig.lvgl_support"
```
