## _boards/frdmimxrt700/Kconfig.defconfig
```kconfig
# Copyright 2024-2026 NXP
#
# SPDX-License-Identifier: BSD-3-Clause

if MCUX_COMPONENT_middleware.lvgl

    config LV_DRAW_BUF_ALIGN
        default 192 if LV_COLOR_DEPTH_24 || LV_COLOR_FORMAT_RGB888
        default 64

endif
```

## _boards/imxrtl345mb/Kconfig
```kconfig
# Copyright 2025 NXP
#
# SPDX-License-Identifier: BSD-3-Clause

rsource "Kconfig.defconfig"

config MCUX_HW_BOARD_imxrtl345mb
    bool
    default y
    imply MCUX_HW_DEVICE_IMXRTL3459AAA
    imply MCUX_COMPONENT_driver.clock if MCUX_HW_DEVICE_IMXRTL3459AAA_CORE_ID_cm55_core0
    imply MCUX_COMPONENT_driver.common if MCUX_HW_DEVICE_IMXRTL3459AAA_CORE_ID_cm55_core0
    imply MCUX_COMPONENT_driver.reset if MCUX_HW_DEVICE_IMXRTL3459AAA_CORE_ID_cm55_core0
    imply MCUX_COMPONENT_driver.lpc_gpio if MCUX_HW_DEVICE_IMXRTL3459AAA_CORE_ID_cm55_core0
    imply MCUX_COMPONENT_component.serial_manager_uart if MCUX_HW_DEVICE_IMXRTL3459AAA_CORE_ID_cm55_core0
    imply MCUX_COMPONENT_utility.debug_console_lite if MCUX_HW_DEVICE_IMXRTL3459AAA_CORE_ID_cm55_core0
    imply MCUX_COMPONENT_driver.flexcomm_usart if MCUX_HW_DEVICE_IMXRTL3459AAA_CORE_ID_cm55_core0



    ## Board project segment dependency data
    select MCUX_COMPONENT_driver.clock if MCUX_PRJSEG_module.board.clock_board_core_folder && MCUX_HW_DEVICE_IMXRTL3459AAA_CORE_ID_cm55_core0
    select MCUX_COMPONENT_driver.reset if MCUX_PRJSEG_module.board.clock_board_core_folder && MCUX_HW_DEVICE_IMXRTL3459AAA_CORE_ID_cm55_core0
    select MCUX_COMPONENT_component.usart_adapter if MCUX_COMPONENT_component.serial_manager_uart
    select MCUX_COMPONENT_component.usart_adapter if MCUX_COMPONENT_utility.debug_console_lite
```

## lvgl_examples/lvgl_sdk/Kconfig
```kconfig
# Copyright 2024-2025 NXP
# SPDX-License-Identifier: BSD-3-Clause

menuconfig MCUX_COMPONENT_middleware.lvgl
    bool "LVGL"
    imply MCUX_COMPONENT_middleware.lvgl.template

if MCUX_COMPONENT_middleware.lvgl

    # For MCUX SDK integration.
    # In MCUX SDK, the Kconfig string is translate macro with no quote,
    # to generate macro with quote, the Kconfig string value should be
    # set as "\"string\"".
    config LV_OS_CUSTOM_INCLUDE
        string
        default "\"\""

    config LV_DRAW_SW_ASM_CUSTOM_INCLUDE
        string
        default "\"\""

    config LV_GLOBAL_CUSTOM_INCLUDE
        string
        default "\"lv_global.h\""

    config LV_TXT_BREAK_CHARS
        string
        default "\" ,.;:-_)}\""

    config LV_PROFILER_INCLUDE
        string
        default "\"lvgl/debugging/profiler/lv_profiler_builtin.h\""

    config LV_TXT_COLOR_CMD
        string
        default "\"#\""

    # Standard library header includes (v9.6 requirement)
    config LV_STDINT_INCLUDE
        string
        default "\"stdint.h\""
    config LV_STDDEF_INCLUDE
        string
        default "\"stddef.h\""
    config LV_STDBOOL_INCLUDE
        string
        default "\"stdbool.h\""
    config LV_INTTYPES_INCLUDE
        string
        default "\"inttypes.h\""
    config LV_LIMITS_INCLUDE
        string
        default "\"limits.h\""
    config LV_STDARG_INCLUDE
        string
        default "\"stdarg.h\""

    # Day-of-week strings
    config LV_MONDAY_STR
        string
        default "\"Mo\""
    config LV_TUESDAY_STR
        string
        default "\"Tu\""
    config LV_WEDNESDAY_STR
        string
        default "\"We\""
    config LV_THURSDAY_STR
        string
        default "\"Th\""
    config LV_FRIDAY_STR
        string
        default "\"Fr\""
    config LV_SATURDAY_STR
        string
        default "\"Sa\""
    config LV_SUNDAY_STR
        string
        default "\"Su\""

    # Month strings (v9.6 requirement)
    config LV_JANUARY_STR
        string
        default "\"January\""
    config LV_FEBRUARY_STR
        string
        default "\"February\""
    config LV_MARCH_STR
        string
        default "\"March\""
    config LV_APRIL_STR
        string
        default "\"April\""
    config LV_MAY_STR
        string
        default "\"May\""
    config LV_JUNE_STR
        string
        default "\"June\""
    config LV_JULY_STR
        string
        default "\"July\""
    config LV_AUGUST_STR
        string
        default "\"August\""
    config LV_SEPTEMBER_STR
        string
        default "\"September\""
    config LV_OCTOBER_STR
        string
        default "\"October\""
    config LV_NOVEMBER_STR
        string
        default "\"November\""
    config LV_DECEMBER_STR
        string
        default "\"December\""

    # Kconfig default settings
    config LV_USE_DRAW_VG_LITE
        bool
        default y if MCUX_COMPONENT_middleware.vglite

    # VG-Lite default settings for NXP MCU SDK integration.
    config LV_VG_LITE_USE_GPU_INIT
        bool
        depends on LV_USE_DRAW_VG_LITE
        default y

    config LV_VG_LITE_GRAD_CACHE_CNT
        int
        depends on LV_USE_DRAW_VG_LITE
        default 8

    config LV_VG_LITE_STROKE_CACHE_CNT
        int
        depends on LV_USE_DRAW_VG_LITE
        default 32

    config LV_VG_LITE_DISABLE_VLC_OP_CLOSE
        bool
        depends on LV_USE_DRAW_VG_LITE
        default y

    config LV_VG_LITE_DISABLE_LINEAR_GRADIENT_EXT
        bool
        depends on LV_USE_DRAW_VG_LITE
        default y

    config LV_USE_DRAW_PXP
        bool
        default n if LV_USE_DRAW_VG_LITE
        default y if MCUX_COMPONENT_driver.pxp

    config LV_DEMO_BENCHMARK_ALIGNED_FONTS
        bool
        default y if LV_USE_DRAW_VG_LITE && LV_USE_DEMO_BENCHMARK

    config LV_ATTRIBUTE_MEM_ALIGN_SIZE
        int "Required alignment size for buffers (must be power of 2)"
        default 64 if LV_USE_DRAW_VG_LITE || LV_USE_DRAW_PXP
        default 4

    config LV_DRAW_BUF_ALIGN
        int
        default 32 if LV_USE_DRAW_PXP

    config LV_USE_VECTOR_GRAPHIC
        bool
        default y if LV_USE_DRAW_VG_LITE

    # Section placement for large arrays (board-level override via prj.conf)
    # Each pair: bool guard (controls whether #define appears in mcux_config.h)
    #            string section name (the linker section to place data in)
    config LV_USE_LARGE_RAM_ARRAY_SECTION
        bool "Place LVGL memory pool in a custom linker section"
        default n

    config LV_ATTRIBUTE_LARGE_RAM_ARRAY_SECTION
        string "Linker section name for large RAM arrays"
        depends on LV_USE_LARGE_RAM_ARRAY_SECTION
        default "NonCacheable.init"

    config LV_USE_LARGE_CONST_SECTION
        bool "Place large const data in a custom linker section"
        default n

    config LV_ATTRIBUTE_LARGE_CONST_SECTION
        string "Linker section name for large const data"
        depends on LV_USE_LARGE_CONST_SECTION
        default "DataQuickAccess"

    # Custom include defaults: lv_conf.h provides LV_ATTRIBUTE_MEM_ALIGN,
    # LV_SYSMON_GET_IDLE, LV_ASSERT_HANDLER for all SDK projects.
    config LV_ATTRIBUTE_USE_CUSTOM_INCLUDE
        bool
        default y

    config LV_ATTRIBUTE_CUSTOM_INCLUDE
        string
        default "\"lv_conf.h\""

    config LV_SYSMON_USE_CUSTOM_INCLUDE
        bool
        default y if LV_USE_SYSMON

    config LV_SYSMON_CUSTOM_INCLUDE
        string
        default "\"lv_conf.h\"" if LV_USE_SYSMON

    config LV_ASSERT_USE_CUSTOM_INCLUDE
        bool
        default y

    config LV_ASSERT_CUSTOM_INCLUDE
        string
        default "\"lv_conf.h\""

    osource "${SdkRootDirPath}/middleware/lvgl/Kconfig"

endif

menu "LVGL application layers"

    config MCUX_COMPONENT_middleware.lvgl.template
        bool "LVGL project template"

    menu "Demos"

        config MCUX_COMPONENT_middleware.lvgl.demo.common
            bool "common"
            imply MCUX_COMPONENT_middleware.lvgl

        config MCUX_COMPONENT_middleware.lvgl.demo.multilang
            bool "multilang"
            imply MCUX_COMPONENT_middleware.lvgl

        config MCUX_COMPONENT_middleware.lvgl.demo.flex_layout
            bool "flex_layout"
            imply MCUX_COMPONENT_middleware.lvgl

        config MCUX_COMPONENT_middleware.lvgl.demo.scroll
            bool "scroll"
            imply MCUX_COMPONENT_middleware.lvgl

        config MCUX_COMPONENT_middleware.lvgl.demo.music
            bool "music"
            imply MCUX_COMPONENT_middleware.lvgl

        config MCUX_COMPONENT_middleware.lvgl.demo.keypad_encoder
            bool "keypad_encoder"
            imply MCUX_COMPONENT_middleware.lvgl

        config MCUX_COMPONENT_middleware.lvgl.demo.benchmark
            bool "benchmark"
            imply MCUX_COMPONENT_middleware.lvgl
            imply MCUX_COMPONENT_middleware.lvgl.demo.widgets
            imply MCUX_COMPONENT_middleware.lvgl.demo.common

        config MCUX_COMPONENT_middleware.lvgl.demo.stress
            bool "stress"
            imply MCUX_COMPONENT_middleware.lvgl
            imply MCUX_COMPONENT_middleware.lvgl.demo.common

        config MCUX_COMPONENT_middleware.lvgl.demo.widgets
            bool "widgets"
            imply MCUX_COMPONENT_middleware.lvgl
            imply MCUX_COMPONENT_middleware.lvgl.demo.common

        config MCUX_COMPONENT_middleware.lvgl.src.libs.thorvg
            bool "thorvg"
            imply MCUX_COMPONENT_middleware.lvgl
    endmenu

endmenu
```
