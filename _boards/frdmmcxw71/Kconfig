## _boards/frdmmcxw71/Kconfig
```kconfig
# Copyright 2024 NXP
# All rights reserved.
#
# SPDX-License-Identifier: BSD-3-Clause

rsource "Kconfig.defconfig"
rsource "../../_common/project_segments/freertos/examples/tickless/Kconfig.prjseg"

config MCUX_HW_BOARD_frdmmcxw71
    bool
    default y
    imply MCUX_HW_DEVICE_MCXW716C
    imply MCUX_COMPONENT_driver.lpuart
    imply MCUX_COMPONENT_driver.clock
    imply MCUX_COMPONENT_driver.common
    imply MCUX_COMPONENT_driver.ccm32k
    imply MCUX_COMPONENT_driver.port
    imply MCUX_COMPONENT_driver.gpio
    imply MCUX_COMPONENT_driver.spc

config MCUX_COMPONENT_device.utility
    bool "utility for MCXW716C"
    default n
```

## _boards/frdmmcxw72/Kconfig.sysbuild
```kconfig
config secondary_config
    string
    default "debug" if $(config) = "debug"
    default "release" if $(config) = "release"

config secondary_core_id
    string
    default "cm33_core1" if $(core_id) = "cm33_core0"
```

## _boards/frdmrw612/Kconfig.defconfig
```kconfig
# Copyright 2024 NXP
# All rights reserved.
#
# SPDX-License-Identifier: BSD-3-Clause

# Config these macros for applications need to rely on USB.
# So need to enable CONFIG_MCUX_COMPONENT_middleware.usb.host.common_header in prj.conf.
# Build system will generate usb_host_config.h based on middleware/usb/Kconfig.host_config
# The generated file will overwrite the content of the user-added usb_host_config.h.
#
# Follow the implementation of middleware/usb/Kconfig.host_config and attach the same value as in wifi_examples/wifi_wpa_supplicant/usb_host_config.h to the macros.

if MCUX_COMPONENT_middleware.wireless.wpa_supplicant.rtos

menu "wpa_supplicant USB Configurations(usb_host_config.h)"

comment "USB Hardware Configurations"

config USB_HOST_CONFIG_KHCI
    int
    prompt "KHCI Controller Instance Count" if MCUX_HW_IP_DriverType_USB_HOST_DEVICE_KHCI
    default 1 if MCUX_HW_IP_DriverType_USB_HOST_DEVICE_KHCI
    default 0
    help
        No prefix in generated macro

if USB_HOST_CONFIG_KHCI > 0

    config USB_HOST_CONFIG_KHCI_DMA_ALIGN_BUFFER
        int "KHCI Controller DMA Buffer Alignment Length"
        default 64
        help
            No prefix in generated macro

endif

config USB_HOST_CONFIG_EHCI
    int
    prompt "EHCI Controller Instance Count" if MCUX_HW_IP_DriverType_USB_HOST_DEVICE_EHCI
    default 1 if MCUX_HW_IP_DriverType_USB_HOST_DEVICE_EHCI
    default 2
    help
        No prefix in generated macro

if USB_HOST_CONFIG_EHCI > 0

    config USB_HOST_CONFIG_EHCI_FRAME_LIST_SIZE
        int
        default 8 if MCUX_USB_EHCI_FRAME_LIST_SIZE_8
        default 16 if MCUX_USB_EHCI_FRAME_LIST_SIZE_16
        default 32 if MCUX_USB_EHCI_FRAME_LIST_SIZE_32
        default 64 if MCUX_USB_EHCI_FRAME_LIST_SIZE_64
        default 128 if MCUX_USB_EHCI_FRAME_LIST_SIZE_128
        default 256 if MCUX_USB_EHCI_FRAME_LIST_SIZE_256
        default 512 if MCUX_USB_EHCI_FRAME_LIST_SIZE_512
        default 1024 if MCUX_USB_EHCI_FRAME_LIST_SIZE_1024
        help
            No prefix in generated macro

    choice
        prompt "Periodic frame list size supported by the EHCI Controller"
        default MCUX_USB_EHCI_FRAME_LIST_SIZE_1024

    config MCUX_USB_EHCI_FRAME_LIST_SIZE_8
        bool "8 elements"

    config MCUX_USB_EHCI_FRAME_LIST_SIZE_16
        bool "16 elements"

    config MCUX_USB_EHCI_FRAME_LIST_SIZE_32
        bool "32 elements"

    config MCUX_USB_EHCI_FRAME_LIST_SIZE_64
        bool "64 elements"

    config MCUX_USB_EHCI_FRAME_LIST_SIZE_128
        bool "128 elements"

    config MCUX_USB_EHCI_FRAME_LIST_SIZE_256
        bool "256 elements"

    config MCUX_USB_EHCI_FRAME_LIST_SIZE_512
        bool "512 elements"

    config MCUX_USB_EHCI_FRAME_LIST_SIZE_1024
        bool "1024 elements"

    endchoice

    config USB_HOST_CONFIG_EHCI_MAX_QH
        int "Maximum number of QHs supported by the EHCI Controller"
        default 8
        help
            No prefix in generated macro

    config USB_HOST_CONFIG_EHCI_MAX_QTD
        int "Maximum number of QTDs supported by the EHCI Controller"
        default 8
        help
            No prefix in generated macro

    config USB_HOST_CONFIG_EHCI_MAX_ITD
        int "Maximum number of ITDs supported by the EHCI Controller"
        default 0
        help
            No prefix in generated macro

    config USB_HOST_CONFIG_EHCI_MAX_SITD
        int "Maximum number of SITDs supported by the EHCI Controller"
        default 0
        help
            No prefix in generated macro

endif

config USB_HOST_CONFIG_OHCI
    int
    prompt "OHCI Controller Instance Count" if MCUX_HW_IP_DriverType_USB_HOST_OHCI
    default 1 if MCUX_HW_IP_DriverType_USB_HOST_OHCI
    default 0
    help
        No prefix in generated macro

if USB_HOST_CONFIG_OHCI > 0

    config USB_HOST_CONFIG_OHCI_MAX_ED
        int "Maximum number of EDs supported by the OHCI Controller"
        default 16
        help
            No prefix in generated macro

    config USB_HOST_CONFIG_OHCI_MAX_GTD
        int "Maximum number of GTDs supported by the OHCI Controller"
        default 16
        help
            No prefix in generated macro

    config USB_HOST_CONFIG_OHCI_MAX_ITD
        int "Maximum number of ITDs supported by the OHCI Controller"
        default 8
        help
            No prefix in generated macro

endif

config USB_HOST_CONFIG_IP3516HS
    int
    prompt "LPC IP3516 HS Controller Instance Count" if MCUX_HW_IP_DriverType_USB_HOST_IP3516HS
    default 1 if MCUX_HW_IP_DriverType_USB_HOST_IP3516HS
    default 0
    help
        No prefix in generated macro

if USB_HOST_CONFIG_IP3516HS > 0

    config USB_HOST_CONFIG_IP3516HS_MAX_PIPE
        int "Maximum number of USB pipes supported by the IP3516HS Controller"
        default 32
        help
            No prefix in generated macro

    config USB_HOST_CONFIG_IP3516HS_MAX_ATL
        int "Maximum number of ATL PTDs supported by the IP3516HS Controller"
        default 32
        help
            No prefix in generated macro

    config USB_HOST_CONFIG_IP3516HS_MAX_INT
        int "Maximum number of INTL PTDs supported by the IP3516HS Controller"
        default 32
        help
            No prefix in generated macro

    config USB_HOST_CONFIG_IP3516HS_MAX_ISO
        int "Maximum number of ISO PTDs supported by the IP3516HS Controller"
        default 32
        help
            No prefix in generated macro

endif

config USB_HOST_CONFIG_MAX_HOST
    string
    default "(USB_HOST_CONFIG_KHCI + USB_HOST_CONFIG_EHCI + USB_HOST_CONFIG_OHCI + USB_HOST_CONFIG_IP3516HS)"
    help
        Total number of Host Controller instances
        No prefix in generated macro

comment "USB Class Configurations"

config USB_HOST_CONFIG_AUDIO
    int "Audio Class Instance Count"
    default 1
    help
        No prefix in generated macro

config USB_HOST_CONFIG_CDC
    int "CDC (Communication Device Class) Instance Count"
    default 1
    help
        No prefix in generated macro

config USB_HOST_CONFIG_CDC_ECM
    int "CDC-ECM (Communication Device Class Ethernet Control Model) Instance Count"
    default 0
    help
        No prefix in generated macro

config USB_HOST_CONFIG_CDC_RNDIS
    int "RNDIS (Remote Network Driver Interface Specification) Instance Count"
    default 0
    help
        No prefix in generated macro

config USB_HOST_CONFIG_HID
    int "HID (Human Interface Device) Instance Count"
    default 1
    help
        No prefix in generated macro

config USB_HOST_CONFIG_PRINTER
    int "Printer Class Instance Count"
    default 1
    help
        No prefix in generated macro

config USB_HOST_CONFIG_MSD
    int "MSC (Mass Storage Class) Instance Count"
    default 1
    help
        No prefix in generated macro

config USB_HOST_CONFIG_HUB
    int "Hub Class Instance Count"
    default 1
    help
        No prefix in generated macro

config USB_HOST_CONFIG_VIDEO
    int "Video Class Instance Count"
    default 0
    help
        No prefix in generated macro

config USB_HOST_CONFIG_PHDC
    int "PHDC (Personal Healthcare Device Class) Instance Count"
    default 1
    help
        No prefix in generated macro

comment "USB Miscellaneous Configurations"

config USB_HOST_CONFIG_MAX_POWER
    int "Maximum power(mW) supplied by the USB Host"
    default 250
    help
        No prefix in generated macro

config USB_HOST_CONFIG_BUFFER_PROPERTY_CACHEABLE
    bool "Enable Transfer Buffer Cache"
    default n
    help
        No prefix in generated macro

config USB_HOST_CONFIG_MAX_PIPES
    int "Maximum number of USB pipes supported by USB Host"
    default 16
    help
        No prefix in generated macro

config USB_HOST_CONFIG_MAX_TRANSFERS
    int "Maximum number of USB transfers supported by USB Host"
    default 16
    help
        No prefix in generated macro

config USB_HOST_CONFIG_CONFIGURATION_MAX_INTERFACE
    int "Maximum number of USB interfaces supported by a USB configuration descriptor"
    default 5
    help
        No prefix in generated macro

config USB_HOST_CONFIG_INTERFACE_MAX_EP
    int "Maximum number of USB endpoint descriptors supported by a USB interface descriptor"
    default 4
    help
        No prefix in generated macro

config USB_HOST_CONFIG_ENUMERATION_MAX_RETRIES
    int "Maximum number of retries for the USB enumeration"
    default 3
    help
        No prefix in generated macro

config USB_HOST_CONFIG_ENUMERATION_MAX_STALL_RETRIES
    int "Maximum number of retries for the USB enumeration STALL"
    default 1
    help
        No prefix in generated macro

config USB_HOST_CONFIG_CLASS_AUTO_CLEAR_STALL
    bool "Enable USB STALL auto-cleaning"
    default n
    help
        No prefix in generated macro

config USB_HOST_CONFIG_MAX_NAK
    int "Maximum NAK count for one USB transaction"
    default 3000
    help
        No prefix in generated macro

config USB_HOST_CONFIG_COMPLIANCE_TEST
    bool "Enable Compliance Test"
    default n
    help
        No prefix in generated macro
endmenu
endif
```

## _boards/frdmrw612/Kconfig.prjseg
```kconfig
# Copyright 2024 NXP
# SPDX-License-Identifier: BSD-3-Clause

rsource "../../_common/project_segments/wireless/Kconfig.prjseg"
rsource "../../_common/project_segments/wireless/rw61x/Kconfig.prjseg"
```

## _boards/frdmrw612/project_segments/wireless/Kconfig.prjseg
```kconfig
# Copyright 2024 NXP
# All rights reserved.
#
# SPDX-License-Identifier: BSD-3-Clause

config MCUX_PRJSEG_module.board.wireless.board_comp
    select MCUX_COMPONENT_component.led
    select MCUX_COMPONENT_component.button
```

## _boards/imx95lp4xevk15/Kconfig.prjseg
```kconfig
# Copyright 2024 NXP
# SPDX-License-Identifier: BSD-3-Clause

rsource "../../_common/project_segments/display_support/Kconfig.prjseg"
```

## _boards/imx95lp4xevk15/project_segments/display_support/Kconfig.prjseg
```kconfig
# Copyright 2024 NXP
#
# SPDX-License-Identifier: BSD-3-Clause
#

config MCUX_PRJSEG_module.board.display_support
    select MCUX_COMPONENT_driver.display-rm692c9
    select MCUX_COMPONENT_driver.display-adv7535
    select MCUX_COMPONENT_driver.display-it6263
    select MCUX_COMPONENT_driver.lpi2c

if MCUX_PRJSEG_module.board.display_support

    config DPU_EXAMPLE_DI
        string
        default DPU_DI_MIPI if MCUX_PRJSEG_module.board.display_support.DPU_DI_MIPI
        default DPU_DI_LVDS if MCUX_PRJSEG_module.board.display_support.DPU_DI_LVDS
        help
            Port selection for display support
            No prefix in generated macro

    choice MCUX_PRJSEG_module.board.display_support.port
        prompt "port Selection"
        default MCUX_PRJSEG_module.board.display_support.DPU_DI_MIPI

        config MCUX_PRJSEG_module.board.display_support.DPU_DI_MIPI
            bool "DPU_DI_MIPI port"

        config MCUX_PRJSEG_module.board.display_support.DPU_DI_LVDS
            bool "DPU_DI_LVDS port"
    endchoice

    config DEMO_PANEL
        string
        default MX8_DSI_OLED2 if MCUX_PRJSEG_module.board.display_support.MX8_DSI_OLED2
        default MIPI2HDMI if MCUX_PRJSEG_module.board.display_support.MIPI2HDMI
        help
            Panel selection for display support
            No prefix in generated macro

    choice MCUX_PRJSEG_module.board.display_support.panel
        prompt "panel Selection"
        default MCUX_PRJSEG_module.board.display_support.MX8_DSI_OLED2

        config MCUX_PRJSEG_module.board.display_support.MX8_DSI_OLED2
            bool "MX8_DSI_OLED2 panel"

        config MCUX_PRJSEG_module.board.display_support.MIPI2HDMI
            bool "MIPI2HDMI convertor card"

    endchoice

    config APP_DISPLAY_EXTERNAL_CONVERTOR
        bool "MIPI or LVDS to HDMI convertor card"
        help
            No prefix in generated macro

endif
```
