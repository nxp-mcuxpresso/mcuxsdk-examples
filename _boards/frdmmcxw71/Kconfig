## _boards/imx95lpd5evk19/project_segments/display_support/Kconfig.prjseg
```kconfig
# Copyright 2024 NXP
#
# SPDX-License-Identifier: BSD-3-Clause
#

config MCUX_PRJSEG_module.board.display_support
    select MCUX_COMPONENT_driver.display-rm692c9
    select MCUX_COMPONENT_driver.display-adv7535
    select MCUX_COMPONENT_driver.display-it6263
    select MCUX_COMPONENT_driver.lpi2c

if MCUX_PRJSEG_module.board.display_support

    config DPU_EXAMPLE_DI
        string
        default DPU_DI_MIPI if MCUX_PRJSEG_module.board.display_support.DPU_DI_MIPI
        default DPU_DI_LVDS if MCUX_PRJSEG_module.board.display_support.DPU_DI_LVDS
        help
            Port selection for display support
            No prefix in generated macro

    choice MCUX_PRJSEG_module.board.display_support.port
        prompt "port Selection"
        default MCUX_PRJSEG_module.board.display_support.DPU_DI_LVDS

        config MCUX_PRJSEG_module.board.display_support.DPU_DI_MIPI
            bool "DPU_DI_MIPI port"

        config MCUX_PRJSEG_module.board.display_support.DPU_DI_LVDS
            bool "DPU_DI_LVDS port"
    endchoice


    config DEMO_PANEL
        string
        default LCD_SPEC if MCUX_PRJSEG_module.board.display_support.LCD_SPEC
        default LVDS_DUAL_PANEL if MCUX_PRJSEG_module.board.display_support.LVDS_DUAL_PANEL
        default MX8_DSI_OLED2 if MCUX_PRJSEG_module.board.display_support.MX8_DSI_OLED2
        default MIPI2HDMI if MCUX_PRJSEG_module.board.display_support.MIPI2HDMI
        default LVDS2HDMI if MCUX_PRJSEG_module.board.display_support.LVDS2HDMI
        help
            Panel selection for display support
            No prefix in generated macro

    choice MCUX_PRJSEG_module.board.display_support.panel
        prompt "panel Selection"
        default MCUX_PRJSEG_module.board.display_support.LCD_SPEC

        config MCUX_PRJSEG_module.board.display_support.LCD_SPEC
            bool "LCD_SPEC panel"

        config MCUX_PRJSEG_module.board.display_support.LVDS_DUAL_PANEL
            bool "LVDS_DUAL_PANEL panel"

        config MCUX_PRJSEG_module.board.display_support.MX8_DSI_OLED2
            bool "MX8_DSI_OLED2 panel"

        config MCUX_PRJSEG_module.board.display_support.MIPI2HDMI
            bool "MIPI2HDMI convertor card"

        config MCUX_PRJSEG_module.board.display_support.LVDS2HDMI
            bool "LVDS2HDMI convertor card"
    endchoice

    config APP_DISPLAY_EXTERNAL_CONVERTOR
        bool "MIPI or LVDS to HDMI convertor card"
        help
            No prefix in generated macro

    config LDB_DUAL_PANEL
        int
	default 0 if MCUX_PRJSEG_module.board.display_support.LDB_DUAL_PANEL_DISABLE
	default 1 if MCUX_PRJSEG_module.board.display_support.LDB_DUAL_PANEL_ENABLE
	help
            Ldb dual panel setting selection for display support
            No prefix in generated macro

    choice MCUX_PRJSEG_module.board.display_support.ldb
        prompt "dual panel Selection"
	default MCUX_PRJSEG_module.board.display_support.LDB_DUAL_PANEL_DISABLE

	config MCUX_PRJSEG_module.board.display_support.LDB_DUAL_PANEL_DISABLE
            bool "Disable DUAL panel setting for LDB"

        config MCUX_PRJSEG_module.board.display_support.LDB_DUAL_PANEL_ENABLE
            bool "Enable DUAL panel setting for LDB"
     endchoice
endif
```

## _boards/imx95verdinevk/Kconfig
```kconfig
# Copyright 2024 NXP
#
# SPDX-License-Identifier: BSD-3-Clause

rsource "Kconfig.defconfig"
rsource "../../_common/project_segments/display_support/Kconfig.prjseg"

config MCUX_HW_BOARD_imx95verdinevk
    bool
    default y
    imply MCUX_HW_DEVICE_MIMX9596
```

## _boards/imx95verdinevk/project_segments/display_support/Kconfig.prjseg
```kconfig
# Copyright 2024 NXP
#
# SPDX-License-Identifier: BSD-3-Clause
#

config MCUX_PRJSEG_module.board.display_support
    select MCUX_COMPONENT_driver.display-rm692c9
    select MCUX_COMPONENT_driver.display-sn65dsi83
    select MCUX_COMPONENT_driver.display-adv7535
    select MCUX_COMPONENT_driver.display-it6263
    select MCUX_COMPONENT_driver.lpi2c

if MCUX_PRJSEG_module.board.display_support

    config DPU_EXAMPLE_DI
        string
        default DPU_DI_MIPI if MCUX_PRJSEG_module.board.display_support.DPU_DI_MIPI
        default DPU_DI_LVDS if MCUX_PRJSEG_module.board.display_support.DPU_DI_LVDS
        help
            Port selection for display support
            No prefix in generated macro

    choice MCUX_PRJSEG_module.board.display_support.port
        prompt "port Selection"
        default MCUX_PRJSEG_module.board.display_support.DPU_DI_MIPI

        config MCUX_PRJSEG_module.board.display_support.DPU_DI_MIPI
            bool "DPU_DI_MIPI port"

        config MCUX_PRJSEG_module.board.display_support.DPU_DI_LVDS
            bool "DPU_DI_LVDS port"
    endchoice


    config DEMO_PANEL
        string
	default CAP_TOUCH_LVDS if MCUX_PRJSEG_module.board.display_support.CAP_TOUCH_LVDS
	default CAP_TOUCH_DSI if MCUX_PRJSEG_module.board.display_support.CAP_TOUCH_DSI
        default MX8_DSI_OLED2 if MCUX_PRJSEG_module.board.display_support.MX8_DSI_OLED2
        default MIPI2HDMI if MCUX_PRJSEG_module.board.display_support.MIPI2HDMI
        help
            Panel selection for display support
            No prefix in generated macro

    choice MCUX_PRJSEG_module.board.display_support.panel
        prompt "panel Selection"
        default MCUX_PRJSEG_module.board.display_support.MX8_DSI_OLED2

        config MCUX_PRJSEG_module.board.display_support.CAP_TOUCH_LVDS
            bool "CAP_TOUCH_LVDS panel"

        config MCUX_PRJSEG_module.board.display_support.CAP_TOUCH_DSI
            bool "CAP_TOUCH_DSI panel"

        config MCUX_PRJSEG_module.board.display_support.MX8_DSI_OLED2
            bool "MX8_DSI_OLED2 panel"

        config MCUX_PRJSEG_module.board.display_support.MIPI2HDMI
            bool "MIPI2HDMI convertor card"

    endchoice

    config APP_DISPLAY_EXTERNAL_CONVERTOR
        bool "MIPI or LVDS to HDMI convertor card"
        help
            No prefix in generated macro

    config LDB_DUAL_PANEL
        int
	default 0 if MCUX_PRJSEG_module.board.display_support.LDB_DUAL_PANEL_DISABLE
	default 1 if MCUX_PRJSEG_module.board.display_support.LDB_DUAL_PANEL_ENABLE
	help
            Ldb dual panel setting selection for display support
            No prefix in generated macro

    choice MCUX_PRJSEG_module.board.display_support.ldb
        prompt "dual panel Selection"
	default MCUX_PRJSEG_module.board.display_support.LDB_DUAL_PANEL_DISABLE

	config MCUX_PRJSEG_module.board.display_support.LDB_DUAL_PANEL_DISABLE
            bool "Disable DUAL panel setting for LDB"

        config MCUX_PRJSEG_module.board.display_support.LDB_DUAL_PANEL_ENABLE
            bool "Enable DUAL panel setting for LDB"
     endchoice
endif
```

## _boards/kw45b41zloc/Kconfig.prjseg
```kconfig
# Copyright 2024 NXP
# SPDX-License-Identifier: BSD-3-Clause

rsource "../../_common/project_segments/wireless/Kconfig.prjseg"
rsource "../../_common/project_segments/wireless/wireless_mcu/Kconfig.prjseg"
rsource "../../wireless_examples/bluetooth/common/Kconfig"
```

## _boards/kw47evk/Kconfig
```kconfig
# Copyright 2024 NXP
#
# SPDX-License-Identifier: BSD-3-Clause

rsource "${core_id}/Kconfig"
rsource "Kconfig.defconfig"
rsource "../../_common/project_segments/freertos/examples/tickless/Kconfig.prjseg"

config MCUX_HW_BOARD_kw47evk
    bool
    default y
    imply MCUX_HW_DEVICE_KW47B42ZB7
    imply MCUX_COMPONENT_driver.clock
    imply MCUX_COMPONENT_driver.common
    imply MCUX_COMPONENT_driver.lpuart
    imply MCUX_COMPONENT_driver.port
    imply MCUX_COMPONENT_driver.gpio
    imply MCUX_COMPONENT_driver.ccm32k
    imply MCUX_COMPONENT_driver.spc

config MCUX_COMPONENT_device.utility
    bool "utility for KW47B42ZB7"
    default n
```

## _boards/lpcxpresso51u68/Kconfig
```kconfig
# Copyright 2024 NXP
# All rights reserved.
#
# SPDX-License-Identifier: BSD-3-Clause

rsource "Kconfig.defconfig"
rsource "../../_common/project_segments/lvgl/Kconfig.prjseg"
rsource "../../_common/project_segments/freertos/examples/tickless/Kconfig.prjseg"
rsource "../../lvgl_examples/lvgl_sdk/lvgl_support/flexcomm_spi/Kconfig.lvgl_support"

config MCUX_HW_BOARD_lpcxpresso51u68
    bool
    default y
    imply MCUX_HW_DEVICE_LPC51U68
    imply MCUX_COMPONENT_driver.clock
    imply MCUX_COMPONENT_driver.common
    imply MCUX_COMPONENT_driver.flexcomm
    imply MCUX_COMPONENT_driver.flexcomm_usart
    imply MCUX_COMPONENT_driver.lpc_gpio
    imply MCUX_COMPONENT_driver.lpc_iocon
    imply MCUX_COMPONENT_driver.power

    ## Board project segment dependency data

    select MCUX_COMPONENT_driver.lpc_iocon if MCUX_PRJSEG_module.board.pinmux
    select MCUX_COMPONENT_driver.lpc_gpio if MCUX_PRJSEG_module.board.pinmux
    select MCUX_COMPONENT_driver.clock if MCUX_PRJSEG_module.board.clock    
    select MCUX_COMPONENT_driver.power if MCUX_PRJSEG_module.board.clock
    select MCUX_COMPONENT_component.usart_adapter if MCUX_PRJSEG_module.board.console_lite
    select MCUX_COMPONENT_driver.flexcomm if MCUX_PRJSEG_module.board.console_lite
    select MCUX_COMPONENT_driver.flexcomm_usart if MCUX_PRJSEG_module.board.console_lite
```

## _boards/lpcxpresso54628/Kconfig
```kconfig
# Copyright 2024 NXP
# All rights reserved.
#
# SPDX-License-Identifier: BSD-3-Clause

rsource "Kconfig.defconfig"
rsource "../../_common/project_segments/lvgl/Kconfig.prjseg"
rsource "../../_common/project_segments/freertos/examples/tickless/Kconfig.prjseg"
rsource "../../lvgl_examples/lvgl_sdk/lvgl_support/lpc_lcdc/Kconfig.lvgl_support"

config MCUX_HW_BOARD_lpcxpresso54628
    bool
    default y
    imply MCUX_HW_DEVICE_LPC54628
    imply MCUX_COMPONENT_driver.clock
    imply MCUX_COMPONENT_driver.common
    imply MCUX_COMPONENT_driver.emc
    imply MCUX_COMPONENT_driver.flexcomm_i2c
    imply MCUX_COMPONENT_driver.flexcomm_spi
    imply MCUX_COMPONENT_driver.flexcomm_usart
    imply MCUX_COMPONENT_driver.lpc_gpio
    imply MCUX_COMPONENT_driver.lpc_iocon
    imply MCUX_COMPONENT_driver.power
    imply MCUX_COMPONENT_driver.reset
    imply MCUX_COMPONENT_driver.flexcomm

    ## Board project segment dependency data

    select MCUX_COMPONENT_driver.lpc_iocon if MCUX_PRJSEG_module.board.pinmux
    select MCUX_COMPONENT_driver.lpc_gpio if MCUX_PRJSEG_module.board.pinmux
    select MCUX_COMPONENT_driver.clock if MCUX_PRJSEG_module.board.clock    
    select MCUX_COMPONENT_driver.power if MCUX_PRJSEG_module.board.clock
    select MCUX_COMPONENT_component.usart_adapter if MCUX_PRJSEG_module.board.console_lite
    select MCUX_COMPONENT_driver.flexcomm if MCUX_PRJSEG_module.board.console_lite
    select MCUX_COMPONENT_driver.flexcomm_usart if MCUX_PRJSEG_module.board.console_lite
    select MCUX_COMPONENT_driver.emc if MCUX_PRJSEG_module.board.boardfile
```

## _boards/lpcxpresso54s018m/Kconfig
```kconfig
# Copyright 2024 NXP
# All rights reserved.
#
# SPDX-License-Identifier: BSD-3-Clause

rsource "Kconfig.defconfig"
rsource "../../_common/project_segments/lvgl/Kconfig.prjseg"
rsource "../../_common/project_segments/freertos/examples/tickless/Kconfig.prjseg"
rsource "../../lvgl_examples/lvgl_sdk/lvgl_support/lpc_lcdc/Kconfig.lvgl_support"

config MCUX_HW_BOARD_lpcxpresso54s018m
    bool
    default y
    imply MCUX_HW_DEVICE_LPC54S018M
    imply MCUX_COMPONENT_driver.clock
    imply MCUX_COMPONENT_driver.common
    imply MCUX_COMPONENT_driver.emc
    imply MCUX_COMPONENT_driver.flexcomm
    imply MCUX_COMPONENT_driver.flexcomm_usart
    imply MCUX_COMPONENT_driver.lpc_gpio
    imply MCUX_COMPONENT_driver.lpc_iocon
    imply MCUX_COMPONENT_driver.power
    imply MCUX_COMPONENT_driver.reset

    ## Board project segment dependency data

    select MCUX_COMPONENT_driver.lpc_iocon if MCUX_PRJSEG_module.board.pinmux
    select MCUX_COMPONENT_driver.lpc_gpio if MCUX_PRJSEG_module.board.pinmux
    select MCUX_COMPONENT_driver.clock if MCUX_PRJSEG_module.board.clock    
    select MCUX_COMPONENT_driver.power if MCUX_PRJSEG_module.board.clock
    select MCUX_COMPONENT_component.usart_adapter if MCUX_PRJSEG_module.board.console_lite
    select MCUX_COMPONENT_driver.flexcomm if MCUX_PRJSEG_module.board.console_lite
    select MCUX_COMPONENT_driver.flexcomm_usart if MCUX_PRJSEG_module.board.console_lite
    select MCUX_COMPONENT_driver.emc if MCUX_PRJSEG_module.board.boardfile
```

## _boards/lpcxpresso55s06/Kconfig.prjseg
```kconfig
# Copyright 2024 NXP
# SPDX-License-Identifier: BSD-3-Clause

rsource "../../_common/project_segments/lvgl/Kconfig.prjseg"
rsource "../../lvgl_examples/lvgl_sdk/lvgl_support/flexcomm_spi/Kconfig.lvgl_support"
rsource "../../_common/project_segments/freertos/examples/tickless/Kconfig.prjseg"
```

## _boards/lpcxpresso55s36/Kconfig
```kconfig
# Copyright 2024 NXP
#
# SPDX-License-Identifier: BSD-3-Clause

rsource "Kconfig.defconfig"

config MCUX_HW_BOARD_lpcxpresso55s36
    bool
    default y
    imply MCUX_HW_DEVICE_LPC55S36
    imply MCUX_COMPONENT_driver.clock
    imply MCUX_COMPONENT_driver.common
    imply MCUX_COMPONENT_driver.flexcomm_i2c
    imply MCUX_COMPONENT_driver.flexcomm_spi
    imply MCUX_COMPONENT_driver.flexcomm_usart
    imply MCUX_COMPONENT_driver.lpc_gpio
    imply MCUX_COMPONENT_driver.lpc_iocon
    imply MCUX_COMPONENT_driver.power
    imply MCUX_COMPONENT_driver.reset
    imply MCUX_COMPONENT_driver.flexcomm

    ## Board project segment dependency data

    select MCUX_COMPONENT_driver.lpc_iocon if MCUX_PRJSEG_module.board.pinmux
    select MCUX_COMPONENT_driver.lpc_gpio if MCUX_PRJSEG_module.board.pinmux
    select MCUX_COMPONENT_driver.clock if MCUX_PRJSEG_module.board.clock    
    select MCUX_COMPONENT_driver.power if MCUX_PRJSEG_module.board.clock
    select MCUX_COMPONENT_component.usart_adapter if MCUX_PRJSEG_module.board.console_lite
    select MCUX_COMPONENT_driver.flexcomm if MCUX_PRJSEG_module.board.console_lite
    select MCUX_COMPONENT_driver.flexcomm_usart if MCUX_PRJSEG_module.board.console_lite
```

## _boards/lpcxpresso55s69/Kconfig.board
```kconfig
# Copyright 2024 NXP
# All rights reserved.
#
# SPDX-License-Identifier: BSD-3-Clause

config BOARD_lpcxpresso55s69
    bool "Board lpcxpresso55s69"
    select DEVICE_LPC55S69
    select MCUX_HW_DEVICE_ID_LPC55S69
```

## _boards/lpcxpresso804/Kconfig
```kconfig
# Copyright 2024 NXP
# All rights reserved.
#
# SPDX-License-Identifier: BSD-3-Clause

rsource "Kconfig.defconfig"

config MCUX_HW_BOARD_lpcxpresso804
    bool
    default y
    imply MCUX_HW_DEVICE_LPC804
    imply MCUX_COMPONENT_driver.clock
    imply MCUX_COMPONENT_driver.common
    imply MCUX_COMPONENT_driver.lpc_gpio
    imply MCUX_COMPONENT_driver.lpc_iocon_lite
    imply MCUX_COMPONENT_driver.lpc_miniusart
    imply MCUX_COMPONENT_driver.power
    imply MCUX_COMPONENT_driver.rom_api
    imply MCUX_COMPONENT_driver.swm
    imply MCUX_COMPONENT_driver.syscon

    ## Board project segment dependency data

    select MCUX_COMPONENT_driver.lpc_iocon_lite if MCUX_PRJSEG_module.board.pinmux
    select MCUX_COMPONENT_driver.lpc_gpio if MCUX_PRJSEG_module.board.pinmux
    select MCUX_COMPONENT_driver.clock if MCUX_PRJSEG_module.board.clock    
    select MCUX_COMPONENT_driver.power if MCUX_PRJSEG_module.board.clock
    select MCUX_COMPONENT_component.miniusart_adapter if MCUX_PRJSEG_module.board.console_lite
    select MCUX_COMPONENT_driver.miniusart if MCUX_PRJSEG_module.board.console_lite
```
