## driver_examples/lpc_enet/txrx_ptp1588_transfer/Kconfig
```kconfig
# Copyright 2025 NXP
#
# SPDX-License-Identifier: BSD-3-Clause

menu "Project Settings"

source "${SdkRootDirPath}/examples/driver_examples/lpc_enet/Kconfig"

config APP_MAC_ADDRESS2
    string "MAC Address 2 Byte Array"
    default "{0x01, 0x00, 0x5e, 0x00, 0x01, 0x81}"
    help
        No prefix in generated macro

endmenu

source "${SdkRootDirPath}/Kconfig.mcuxpresso"
```

## driver_examples/lpc_enet/txrx_rxpoll/Kconfig
```kconfig
# Copyright 2025 NXP
#
# SPDX-License-Identifier: BSD-3-Clause

menu "Project Settings"

source "${SdkRootDirPath}/examples/driver_examples/lpc_enet/Kconfig"

endmenu

source "${SdkRootDirPath}/Kconfig.mcuxpresso"
```

## driver_examples/lpi2c/interrupt/Kconfig
```kconfig
# Copyright 2024 NXP
#
# SPDX-License-Identifier: BSD-3-Clause

menu "Project Settings"

config LPI2C_MASTER_SLAVE_ADDR_7BIT
    hex "LPI2C Device Address (7bit)"
    default 0x7E
    range 0x00 0x7F
    help
        No prefix in generated macro
        type unsigned

config LPI2C_BAUDRATE
    int "LPI2C BaudRate (bps)"
    default 100000
    help
        No prefix in generated macro
        type unsigned

config LPI2C_DATA_LENGTH
    int "LPI2C Transfer Data Length (byte)"
    default 32
    help
        No prefix in generated macro
        type unsigned

endmenu

source "${SdkRootDirPath}/Kconfig.mcuxpresso"
```

## driver_examples/mcx_enet/txrx_transfer_rxpoll/Kconfig
```kconfig
# Copyright 2025 NXP
#
# SPDX-License-Identifier: BSD-3-Clause

menu "Project Settings"

source "${SdkRootDirPath}/examples/driver_examples/mcx_enet/Kconfig"

endmenu

source "${SdkRootDirPath}/Kconfig.mcuxpresso"
```

## driver_examples/mu/polling/Kconfig.prj
```kconfig
# Copyright 2025 NXP
#
# SPDX-License-Identifier: BSD-3-Clause

menu "Project Settings"

config MSG_LENGTH
    int "How many message is used to test message sending"
    range 1 32
    default 32
    help
        type unsigned

endmenu

source "${SdkRootDirPath}/Kconfig.mcuxpresso"
```

## driver_examples/netc/psi_vsi_message/primary_core/Kconfig.sysbuild
```kconfig
config secondary_board
    string
    default "$(board)"

config secondary_toolchain
    string
    default "$(toolchain)"

source "${SdkRootDirPath}/${board_root}/${board}/Kconfig.sysbuild"
source "${SdkRootDirPath}/${board_root}/${board}/driver_examples/netc/psi_vsi_message/${core_id}/Kconfig.sysbuild"
```

## driver_examples/pxp/copy_pic/Kconfig
```kconfig
# Copyright 2025 NXP
#
# SPDX-License-Identifier: BSD-3-Clause

menu "Project Settings"

config INPUT_BUF_WIDTH
    int "Input buffer width"
    default 128
    help
        No prefix in generated macro

config INPUT_BUF_HEIGHT
    int "Input buffer height"
    default 64
    help
        No prefix in generated macro

config OUTPUT_BUF_WIDTH
    int "Output buffer width"
    default 64
    help
        No prefix in generated macro

config OUTPUT_BUF_HEIGHT
    int "Output buffer height"
    default 32
    help
        No prefix in generated macro

config COPY_WIDTH
    int "Horizontal size of the copied area"
    default 16
    help
        No prefix in generated macro

config COPY_HEIGHT
    int "Vertical size of the copied area"
    default 8
    help
        No prefix in generated macro

config SRC_OFFSET_X
    int "The x coordinate of the upper left corner of the copied area"
    default 0
    help
        No prefix in generated macro

config SRC_OFFSET_Y
    int "The y coordinate of the upper left corner of the copied area"
    default 0
    help
        No prefix in generated macro

config DEST_OFFSET_X
    int "The x coordinate of the upper left corner of the destination area"
    default 10
    help
        No prefix in generated macro

config DEST_OFFSET_Y
    int "The y coordinate of the upper left corner of the destination area"
    default 20
    help
        No prefix in generated macro

endmenu

source "${SdkRootDirPath}/Kconfig.mcuxpresso"
```

## driver_examples/pxp/scale/Kconfig
```kconfig
# Copyright 2025 NXP
#
# SPDX-License-Identifier: BSD-3-Clause

menu "Project Settings"

config USE_RGB565
    bool "Enable to use RGB565 as source pixel format, otherwise use XRGB8888"
    default y
    help
        No prefix in generated macro

config APP_PS_ULC_X
    int "The x value of upper-left coordinate of the picture"
    default 0
    help
        No prefix in generated macro

config APP_PS_ULC_Y
    int "The y value of upper-left coordinate of the picture"
    default 0
    help
        No prefix in generated macro

endmenu

source "${SdkRootDirPath}/Kconfig.mcuxpresso"
```

## driver_examples/sctimer/simple_pwm/Kconfig
```kconfig
# Copyright 2025 NXP
#
# SPDX-License-Identifier: BSD-3-Clause

menu "Project Settings"

config DUTY_CYCLE_CH1
    int "Channel 1 PWM duty cycle"
    default 50
    range 0 100
    help
        No prefix in generated macro
        type unsigned

config DUTY_CYCLE_CH2
    int "Channel 2 PWM duty cycle"
    default 20
    range 0 100
    help
        No prefix in generated macro
        type unsigned

config PWM_MODE
    string
    default "kSCTIMER_CenterAlignedPwm" if EXAMPLE_CENTER_ALIGNED
    default "kSCTIMER_EdgeAlignedPwm" if EXAMPLE_EDGE_ALIGNED
    help
        No prefix in generated macro

choice
    prompt "Select PWM mode"
    default EXAMPLE_CENTER_ALIGNED

    config EXAMPLE_CENTER_ALIGNED
        bool "Center Aligned PWM"

    config EXAMPLE_EDGE_ALIGNED
        bool "Edge Aligned PWM"

endchoice

endmenu

source "${SdkRootDirPath}/Kconfig.mcuxpresso"
```

## driver_examples/semc/sdram/Kconfig
```kconfig
# Copyright 2025 NXP
#
# SPDX-License-Identifier: BSD-3-Clause

menu "Project Settings"

config SEMC_EXAMPLE_DATALEN
    hex "SEMC Buffer Length"
    default 0x1000
    help
        No prefix in generated macro
        type unsigned

config SEMC_EXAMPLE_WRITETIMES
    int "SEMC Example write times"
    default 1000
    help
        No prefix in generated macro
        type unsigned
endmenu

source "${SdkRootDirPath}/Kconfig.mcuxpresso"
```

## driver_examples/sinc/lpspi/Kconfig
```kconfig
# Copyright 2024 NXP
#
# SPDX-License-Identifier: BSD-3-Clause

menu "Project Settings"

config TRANSFER_SIZE
    int "Transfer Size"
    default 64
    help
        No prefix in generated macro
        type unsigned

config TRANSFER_BAUDRATE
    int "Transfer Baudrate"
    default 5000000
    help
        No prefix in generated macro
        type unsigned

endmenu

source "${SdkRootDirPath}/Kconfig.mcuxpresso"
```

## driver_examples/trdc/multicore/primary_core/Kconfig.sysbuild
```kconfig
config secondary_board
    string
    default "$(board)"

config secondary_toolchain
    string
    default "$(toolchain)"

source "${SdkRootDirPath}/examples/_boards/${board}/driver_examples/trdc/${core_id}/Kconfig.sysbuild"
```

## driver_examples/tsi/tsi_v6/mutual_cap/Kconfig
```kconfig
# Copyright 2025 NXP
#
# SPDX-License-Identifier: BSD-3-Clause

menu "Project Settings"

config TOUCH_DELTA_VALUE
    int "Delta value to indicate a touch event"
    default 100
    help
        No prefix in generated macro

endmenu

source "${SdkRootDirPath}/Kconfig.mcuxpresso"
```

## driver_examples/tsi/tsi_v6/self_cap/Kconfig
```kconfig
# Copyright 2025 NXP
#
# SPDX-License-Identifier: BSD-3-Clause

menu "Project Settings"

config TOUCH_DELTA_VALUE
    int "Delta value to indicate a touch event"
    default 20
    help
        No prefix in generated macro

endmenu

source "${SdkRootDirPath}/Kconfig.mcuxpresso"
```

## dsp_examples/voice_spot_demo/cm/Kconfig.sysbuild
```kconfig
#
# Copyright 2024 NXP
#
# SPDX-License-Identifier: BSD-3-Clause

rsource "../../../../examples/dsp_examples/Kconfig.sysbuild"
```

## el2go_examples/el2go_blob_test/el2go_blob_test_ns/Kconfig
```kconfig
rsource "${SdkRootDirPath}/Kconfig.mcuxpresso"

mainmenu "EL2GO Blob Test Configuration"

config RUN_VERIFIED_ONLY
    default y
    bool "Only run testcases that are expected to pass"

config LARGE_BLOBS_ENABLED
    bool "Enable testing of blobs with a key size larger than 2783 bytes"
```

## el2go_examples/el2go_import_blob/el2go_import_blob_ns/Kconfig
```kconfig
rsource "${SdkRootDirPath}/Kconfig.mcuxpresso"

mainmenu "EL2GO Import Blob Configuration"

config BLOB_AREA
    default 0x084B0000
    hex "The start address of the area where the blobs should be read from"
    help
        No prefix in generated macro

config BLOB_AREA_SIZE
    default 8192
    int "The size of the area where the blobs should be read from in bytes"
    help
        No prefix in generated macro

config VALIDATE_PSA_IMPORT_OPERATION
    bool "If the imported blobs should be validated by using them in PSA operations"
    help
        No prefix in generated macro
```

## lvgl_examples/lvgl_sdk/lvgl_support/flexcomm_spi/Kconfig.lvgl_support
```kconfig
if MCUX_PRJSEG_module.board.lvgl

    config LVGL_SUPPORT_VDB_COUNT
        int "LVGL virtual buffer count"
        default 2
        range 1 2

endif

config MCUX_PRJSEG_module.board.lvgl
    select MCUX_COMPONENT_driver.cmsis_flexcomm_i2c
    select MCUX_COMPONENT_driver.cmsis_flexcomm_spi
    select MCUX_COMPONENT_driver.flexcomm_i2c
    select MCUX_COMPONENT_driver.flexcomm_i2c_dma
    select MCUX_COMPONENT_driver.flexcomm_spi
    select MCUX_COMPONENT_driver.flexcomm_spi_dma
    select MCUX_COMPONENT_driver.ft6x06
    select MCUX_COMPONENT_driver.ili9341
    select MCUX_COMPONENT_driver.inputmux
    select MCUX_COMPONENT_driver.inputmux_connections
    select MCUX_COMPONENT_driver.lpc_dma
```

## lvgl_examples/lvgl_sdk/lvgl_support/k22/Kconfig.lvgl_support
```kconfig
config MCUX_PRJSEG_module.board.lvgl
    select MCUX_COMPONENT_driver.cmsis_dspi
    select MCUX_COMPONENT_driver.cmsis_i2c
    select MCUX_COMPONENT_driver.dmamux
    select MCUX_COMPONENT_driver.dspi
    select MCUX_COMPONENT_driver.dspi_edma
    select MCUX_COMPONENT_driver.edma
    select MCUX_COMPONENT_driver.ft6x06
    select MCUX_COMPONENT_driver.i2c
    select MCUX_COMPONENT_driver.i2c_edma
    select MCUX_COMPONENT_driver.ili9341
```

## lvgl_examples/lvgl_sdk/lvgl_support/lpc_lcdc/Kconfig.lvgl_support
```kconfig
config MCUX_PRJSEG_module.board.lvgl
    select MCUX_COMPONENT_driver.flexcomm_i2c
    select MCUX_COMPONENT_driver.ft5406
    select MCUX_COMPONENT_driver.gt911
    select MCUX_COMPONENT_driver.lpc_lcdc
    select MCUX_COMPONENT_driver.video-common

if MCUX_PRJSEG_module.board.lvgl

    config LVGL_PANEL
        int
        default 0 if MCUX_PRJSEG_module.board.lvgl.RK043FN02H
        default 1 if MCUX_PRJSEG_module.board.lvgl.RK043FN66HS
        help
            Panel selection for LVGL
            No prefix in generated macro

    choice MCUX_PRJSEG_module.board.lvgl.panel
        prompt "Panel Selection"
        default MCUX_PRJSEG_module.board.lvgl.RK043FN66HS

        config MCUX_PRJSEG_module.board.lvgl.RK043FN02H
            bool "RK043FN02H-CT"

        config MCUX_PRJSEG_module.board.lvgl.RK043FN66HS
            bool "RK043FN66HS-CTG"

    endchoice

endif
```

## lvgl_examples/lvgl_sdk/lvgl_support/mcx_flexio/Kconfig.lvgl_support
```kconfig
if MCUX_PRJSEG_module.board.lvgl

    config BOARD_USE_FLEXIO_SMARTDMA
        bool "Enable SMARTDMA for FLEXIO"
        default y
        depends on MCUX_HAS_COMPONENT_driver.flexio_mculcd_smartdma
        help
            No prefix in generated macro

    config LVGL_SUPPORT_VDB_COUNT
        int "LVGL virtual buffer count"
        default 2
        range 1 2

endif

config MCUX_PRJSEG_module.board.lvgl
    select MCUX_COMPONENT_driver.flexio_mculcd_edma if MCUX_HAS_COMPONENT_driver.flexio_mculcd_edma
    select MCUX_COMPONENT_driver.dbi_flexio_edma if MCUX_HAS_COMPONENT_driver.flexio_mculcd_edma
    select MCUX_COMPONENT_driver.flexio_mculcd_smartdma if MCUX_HAS_COMPONENT_driver.flexio_mculcd_smartdma
    select MCUX_COMPONENT_driver.dbi_flexio_smartdma if MCUX_HAS_COMPONENT_driver.flexio_mculcd_smartdma
    select MCUX_COMPONENT_driver.gt911
    select MCUX_COMPONENT_driver.lpflexcomm_lpi2c if MCUX_HAS_COMPONENT_driver.lpflexcomm_lpi2c
    select MCUX_COMPONENT_driver.lpflexcomm if MCUX_HAS_COMPONENT_driver.lpflexcomm
    select MCUX_COMPONENT_driver.lpi2c if MCUX_HAS_COMPONENT_driver.lpi2c
    select MCUX_COMPONENT_driver.st7796s
    select MCUX_COMPONENT_driver.inputmux
```

## lvgl_examples/lvgl_sdk/lvgl_support/rt101x_lpspi/Kconfig.lvgl_support
```kconfig
config MCUX_PRJSEG_module.board.lvgl
    select MCUX_COMPONENT_driver.cache_armv7_m7
    select MCUX_COMPONENT_driver.cmsis_lpi2c
    select MCUX_COMPONENT_driver.cmsis_lpspi
    select MCUX_COMPONENT_driver.dmamux
    select MCUX_COMPONENT_driver.edma
    select MCUX_COMPONENT_driver.ft6x06
    select MCUX_COMPONENT_driver.ili9341
    select MCUX_COMPONENT_driver.lpi2c
    select MCUX_COMPONENT_driver.lpi2c_edma
    select MCUX_COMPONENT_driver.lpspi_edma
```

## lvgl_examples/lvgl_sdk/lvgl_support/rt10xx_elcdif/Kconfig.lvgl_support
```kconfig
config MCUX_PRJSEG_module.board.lvgl
    select MCUX_COMPONENT_driver.elcdif
    select MCUX_COMPONENT_driver.ft5406_rt
    select MCUX_COMPONENT_driver.gt911
    select MCUX_COMPONENT_driver.lpi2c
    select MCUX_COMPONENT_driver.pxp
    select MCUX_COMPONENT_driver.cache_armv7_m7
    select MCUX_COMPONENT_driver.video-common


if MCUX_PRJSEG_module.board.lvgl

    config LVGL_PANEL
        int
        default 0 if MCUX_PRJSEG_module.board.lvgl.RK043FN02H
        default 1 if MCUX_PRJSEG_module.board.lvgl.RK043FN66HS
        help
            Panel selection for LVGL
            No prefix in generated macro

    choice MCUX_PRJSEG_module.board.lvgl.panel
        prompt "Panel Selection"
        default MCUX_PRJSEG_module.board.lvgl.RK043FN66HS

        config MCUX_PRJSEG_module.board.lvgl.RK043FN02H
            bool "RK043FN02H-CT"

        config MCUX_PRJSEG_module.board.lvgl.RK043FN66HS
            bool "RK043FN66HS-CTG"

    endchoice

endif
```

## lvgl_examples/lvgl_sdk/lvgl_support/rt11xx/Kconfig.lvgl_support
```kconfig
config MCUX_PRJSEG_module.board.lvgl
    select MCUX_COMPONENT_driver.ft5406_rt
    select MCUX_COMPONENT_driver.gt911
    select MCUX_COMPONENT_driver.lpi2c
    select MCUX_COMPONENT_driver.pxp
    select MCUX_PRJSEG_module.board.display_support
```

## lvgl_examples/lvgl_sdk/lvgl_support/rt595/Kconfig.lvgl_support
```kconfig
config MCUX_PRJSEG_module.board.lvgl
    select MCUX_COMPONENT_driver.flexcomm_i2c
    select MCUX_COMPONENT_driver.ft3267
    select MCUX_COMPONENT_driver.ft5406
    select MCUX_COMPONENT_driver.gt911
    select MCUX_COMPONENT_driver.dbi_flexio_smartdma
    select MCUX_COMPONENT_driver.lpc_dma
    select MCUX_COMPONENT_driver.inputmux
    select MCUX_COMPONENT_driver.ssd1963
    select MCUX_COMPONENT_driver.dbi
    select MCUX_COMPONENT_driver.dc-fb-ssd1963
    select MCUX_COMPONENT_driver.flexio_mculcd_smartdma
    select MCUX_COMPONENT_driver.dc-fb-lcdif
    select MCUX_COMPONENT_driver.mipi_dsi
    select MCUX_COMPONENT_driver.lcdif
    select MCUX_COMPONENT_driver.dc-fb-dsi-cmd
    select MCUX_COMPONENT_driver.mipi_dsi_smartdma
    select MCUX_COMPONENT_driver.flexio
    select MCUX_COMPONENT_driver.flexio_mculcd
    select MCUX_COMPONENT_driver.flexio_mculcd_dma
    select MCUX_COMPONENT_middleware.vglite if MCUX_COMPONENT_middleware.freertos-kernel
    select MCUX_PRJSEG_module.board.display_support
```
