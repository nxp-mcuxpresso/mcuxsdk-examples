## driver_examples/ctimer/simple_pwm/Kconfig
```kconfig
# Copyright 2025 NXP
#
# SPDX-License-Identifier: BSD-3-Clause

menu "Project Settings"

config DUTY_CYCLE
    int "PWM signal duty cycle."
    default 20
    range 0 100
    help
        No prefix in generated macro
        type unsigned

endmenu

source "${SdkRootDirPath}/Kconfig.mcuxpresso"
```

## driver_examples/dac/continuous_pit_dma/Kconfig
```kconfig
# Copyright 2024 NXP
#
# SPDX-License-Identifier: BSD-3-Clause

menu "Project Settings"

config DEMO_DAC_USED_BUFFER_SIZE
    int "Buffer Size to Store DAC Value"
    default 32
    help
        No prefix in generated macro
        type unsigned

endmenu

source "${SdkRootDirPath}/Kconfig.mcuxpresso"
```

## driver_examples/dsc_cadc/continuous_dma_conversion/Kconfig
```kconfig
# Copyright 2024 NXP
#
# SPDX-License-Identifier: BSD-3-Clause

menu "Project Settings"

config DEMO_CADC_SAMPLE_COUNT
    int "CADC Sample Count"
    default 16
    help
        No prefix in generated macro
        type unsigned

endmenu

source "${SdkRootDirPath}/Kconfig.mcuxpresso"
```

## driver_examples/edma/wrap_transfer/Kconfig
```kconfig
# Copyright 2025 NXP
#
# SPDX-License-Identifier: BSD-3-Clause

menu "Project Settings"

config BUFFER_LENGTH
    int "Number of buffer length"
    default 8
    help
        No prefix in generated macro

config TCD_QUEUE_SIZE
    int "Number of tcd queue size"
    default 2
    help
        No prefix in generated macro

endmenu

source "${SdkRootDirPath}/Kconfig.mcuxpresso"
```

## driver_examples/edma4/ping_pong_transfer/Kconfig
```kconfig
# Copyright 2025 NXP
#
# SPDX-License-Identifier: BSD-3-Clause

menu "Project Settings"

config BUFFER_LENGTH
    int "Number of buffer length"
    default 8
    help
        No prefix in generated macro

endmenu

source "${SdkRootDirPath}/Kconfig.mcuxpresso"
```

## driver_examples/elcdif/lut/Kconfig
```kconfig
# Copyright 2025 NXP
#
# SPDX-License-Identifier: BSD-3-Clause

menu "Project Settings"

config APP_FRAME_PER_PIC
    int "How many frames to show before swithing to the other picture"
    default 60
    help
        No prefix in generated macro

endmenu

source "${SdkRootDirPath}/Kconfig.mcuxpresso"
```

## driver_examples/enet/txrx_multiring_transfer/Kconfig
```kconfig
# Copyright 2025 NXP
#
# SPDX-License-Identifier: BSD-3-Clause

menu "Project Settings"

config APP_PHY_AUTONEGO_TIMEOUT_COUNT
    int "PHY Autonegotiation Timeout Count"
    default 800000
    help
        No prefix in generated macro
        type unsigned

config APP_PHY_STABILITY_DELAY_US
    int "PHY Stability Delay (μs)"
    default 500000
    help
        No prefix in generated macro
        type unsigned

config APP_MAC_ADDRESS
    string "MAC Address Byte Array"
    default "{0xd4, 0xbe, 0xd9, 0x45, 0x22, 0x60}"
    help
        No prefix in generated macro

config APP_ENET_BUFF_ALIGNMENT
    string "Ethernet Buffers Alignment"
    default "ENET_BUFF_ALIGNMENT"
    help
        No prefix in generated macro

endmenu

source "${SdkRootDirPath}/Kconfig.mcuxpresso"
```

## driver_examples/enet/txrx_ptp1588_transfer/Kconfig
```kconfig
# Copyright 2025 NXP
#
# SPDX-License-Identifier: BSD-3-Clause

menu "Project Settings"

config APP_PHY_AUTONEGO_TIMEOUT_COUNT
    int "PHY Autonegotiation Timeout Count"
    default 300000
    help
        No prefix in generated macro
        type unsigned

config APP_PHY_STABILITY_DELAY_US
    int "PHY Stability Delay (μs)"
    default 0
    help
        No prefix in generated macro
        type unsigned

config APP_USER_DEFINED_MAC_ADDRESS
    bool "MAC Address Defined by User"
    default n
    help
        No prefix in generated macro

config APP_MAC_ADDRESS
    string "MAC Address Byte Array"
    default "{0x54, 0x27, 0x8d, 0x00, 0x00, 0x00}"
    depends on APP_USER_DEFINED_MAC_ADDRESS
    help
        No prefix in generated macro

config APP_ENET_BUFF_ALIGNMENT
    string "Ethernet Buffers Alignment"
    default "ENET_BUFF_ALIGNMENT"
    help
        No prefix in generated macro

endmenu

source "${SdkRootDirPath}/Kconfig.mcuxpresso"
```

## driver_examples/enet/txrx_ptp1588_xfer/Kconfig
```kconfig
# Copyright 2025 NXP
#
# SPDX-License-Identifier: BSD-3-Clause

source "${SdkRootDirPath}/examples/driver_examples/enet/txrx_ptp1588_transfer/Kconfig"
```

## driver_examples/enet_1g/txrx_multiring_transfer/Kconfig
```kconfig
# Copyright 2025 NXP
#
# SPDX-License-Identifier: BSD-3-Clause

source "${SdkRootDirPath}/examples/driver_examples/enet/txrx_multiring_transfer/Kconfig"
```

## driver_examples/enet_qos/Kconfig
```kconfig
# Copyright 2025 NXP
#
# SPDX-License-Identifier: BSD-3-Clause

config APP_PHY_LINKUP_TIMEOUT_COUNT
    int "PHY Link-Up Timeout Count"
    default 800000
    help
        No prefix in generated macro
        type unsigned

config APP_PHY_AUTONEGO_TIMEOUT_COUNT
    int "PHY Autonegotiation Timeout Count"
    default 800000
    help
        No prefix in generated macro
        type unsigned

config APP_PHY_STABILITY_DELAY_US
    int "PHY Stability Delay (μs)"
    default 500000
    help
        No prefix in generated macro
        type unsigned

config APP_USER_DEFINED_MAC_ADDRESS
    bool "MAC Address Defined by User"
    default n
    help
        No prefix in generated macro

config APP_MAC_ADDRESS
    string "MAC Address Byte Array"
    default "{0x54, 0x27, 0x8d, 0x00, 0x00, 0x00}"
    depends on APP_USER_DEFINED_MAC_ADDRESS
    help
        No prefix in generated macro

config APP_MAC_ADDRESS2
    string "MAC Address 2 Byte Array"
    default "{0xd3, 0xbe, 0xd9, 0x45, 0x22, 0x60}"
    help
        No prefix in generated macro
```

## driver_examples/enet_qos/txrx_multiring_transfer/Kconfig
```kconfig
# Copyright 2025 NXP
#
# SPDX-License-Identifier: BSD-3-Clause

menu "Project Settings"

source "${SdkRootDirPath}/examples/driver_examples/enet_qos/Kconfig"

config APP_ENET_QOS_BUFF_ALIGNMENT
    string "Ethernet Buffers Alignment"
    default "ENET_QOS_BUFF_ALIGNMENT"
    help
        No prefix in generated macro

endmenu

source "${SdkRootDirPath}/Kconfig.mcuxpresso"
```

## driver_examples/enet_qos/txrx_ptp1588_transfer/Kconfig
```kconfig
# Copyright 2025 NXP
#
# SPDX-License-Identifier: BSD-3-Clause

menu "Project Settings"

source "${SdkRootDirPath}/examples/driver_examples/enet_qos/Kconfig"

config APP_PHY_LINK_INTR_SUPPORT
    bool "PHY Link Interrupt"
    default n
    help
        No prefix in generated macro

endmenu

source "${SdkRootDirPath}/Kconfig.mcuxpresso"
```

## driver_examples/flexcan/canfd_loopback/Kconfig
```kconfig
# Copyright 2025 NXP
#
# SPDX-License-Identifier: BSD-3-Clause

menu "Project Settings"

config DLC
    int "DLC field value of frame to be transmitted, indicates CANFD frame data length (Range: 1~15)"
    default 15
    range 1 15
    help
        DLC         1  2  3  4  5  6  7  8  9   10  11  12  13  14  15
        Data Length 1  2  3  4  5  6  7  8  12  16  20  24  32  48  64
        No prefix in generated macro
        type unsigned

endmenu

source "${SdkRootDirPath}/Kconfig.mcuxpresso"
```

## driver_examples/flexcan/loopback/Kconfig
```kconfig
# Copyright 2025 NXP
#
# SPDX-License-Identifier: BSD-3-Clause

menu "Project Settings"

config DLC
    int "CAN frame data length in bytes (Range: 1~8)"
    default 8
    range 1 8
    help
        Correspond to the DLC field value of frame to be transmitted.
        No prefix in generated macro
        type unsigned

endmenu

source "${SdkRootDirPath}/Kconfig.mcuxpresso"
```

## driver_examples/i3c/master_read_sensor_icm42688p/Kconfig
```kconfig
# Copyright 2025 NXP
#
# SPDX-License-Identifier: BSD-3-Clause

menu "Project Settings"

config EXAMPLE_I2C_BAUDRATE
    int "I2C mode baud rate"
    default 400000
    help
        No prefix in generated macro
        type unsigned

config EXAMPLE_I3C_OD_BAUDRATE
    int "I3C open-drain mode baud rate"
    default 6250000
    help
        No prefix in generated macro
        type unsigned

config EXAMPLE_I3C_PP_BAUDRATE
    int "I3C push-pull mode baud rate"
    default 12500000
    help
        No prefix in generated macro
        type unsigned

endmenu

source "${SdkRootDirPath}/Kconfig.mcuxpresso"
```

## driver_examples/jpegdec/single_stream_repeat/Kconfig
```kconfig
# Copyright 2025 NXP
#
# SPDX-License-Identifier: BSD-3-Clause

menu "Project Settings"

config APP_FB_WIDTH
    int "Frame buffer width"
    default 480
    help
        No prefix in generated macro
        type unsigned

config APP_FB_HEIGHT
    int "Frame buffer height"
    default 272
    help
        No prefix in generated macro
        type unsigned

config APP_PIC_NUM
    int "Total number of pictures to decode"
    default 121
    help
        No prefix in generated macro

endmenu

source "${SdkRootDirPath}/Kconfig.mcuxpresso"
```

## driver_examples/jpegdec/single_stream_single_frame/config/Kconfig
```kconfig
# Copyright 2025 NXP
#
# SPDX-License-Identifier: BSD-3-Clause

menu "Project Settings"

config APP_MJPEG
    bool "Perform the mJpeg decode"
    default n
    help
        No prefix in generated macro

endmenu

source "${SdkRootDirPath}/Kconfig.mcuxpresso"
```

## driver_examples/lcu/Kconfig
```kconfig
# Copyright 2025 NXP
#
# SPDX-License-Identifier: BSD-3-Clause

menu "Project Settings"

config DEMO_LCU_LUT_VALUE
    int "LCU lookup tdable value"
    default 2
    help
        No prefix in generated macro

endmenu

source "${SdkRootDirPath}/Kconfig.mcuxpresso"
```

## driver_examples/lpadc/dma/Kconfig
```kconfig
# Copyright 2024 NXP
#
# SPDX-License-Identifier: BSD-3-Clause

menu "Project Settings"

config DMA_DESCRIPTOR_NUM
    int "DMA Descriptor Numbers"
    default 2
    help
        No prefix in generated macro
        type unsigned

config DEMO_CADC_SAMPLE_COUNT
    int "LPADC Sample Count"
    default 3
    help
        No prefix in generated macro
        type unsigned

endmenu

source "${SdkRootDirPath}/Kconfig.mcuxpresso"
```

## driver_examples/lpc_adc/lpc_adc_dma/Kconfig
```kconfig
# Copyright 2024 NXP
#
# SPDX-License-Identifier: BSD-3-Clause

menu "Project Settings"

config DEMO_DMA_ADC_CHANNEL
    int "DMA Channel"
    default 0
    help
        No prefix in generated macro
        type unsigned

config DMA_DESCRIPTOR_NUM
    int "DMA Descriptor Numbers"
    default 2
    help
        No prefix in generated macro
        type unsigned

endmenu

source "${SdkRootDirPath}/Kconfig.mcuxpresso"
```

## driver_examples/lpc_dma/channel_chain/Kconfig
```kconfig
# Copyright 2025 NXP
#
# SPDX-License-Identifier: BSD-3-Clause

menu "Project Settings"

config BUFF_LENGTH
    int "Number of buffer length"
    default 4
    help
        No prefix in generated macro

config DMA_DESCRIPTOR_NUM
    int "Number of dma descriptor"
    default 3
    help
        No prefix in generated macro

config DEST_BUFFER_LENGTH
    int "Number of Destination buffer length"
    default 16
    help
        No prefix in generated macro

endmenu

source "${SdkRootDirPath}/Kconfig.mcuxpresso"
```

## driver_examples/lpc_dma/interleave_transfer/Kconfig
```kconfig
# Copyright 2025 NXP
#
# SPDX-License-Identifier: BSD-3-Clause

menu "Project Settings"

config BUFF_LENGTH
    int "Number of buffer length"
    default 4
    help
        No prefix in generated macro

config DMA_DESCRIPTOR_NUM
    int "Number of dma descriptor"
    default 2
    help
        No prefix in generated macro

endmenu

source "${SdkRootDirPath}/Kconfig.mcuxpresso"
```

## driver_examples/lpc_dma/wrap_transfer/Kconfig
```kconfig
# Copyright 2025 NXP
#
# SPDX-License-Identifier: BSD-3-Clause

menu "Project Settings"

config SOURCE_BUFFER_LENGTH
    int "Number of source buffer length"
    default 8
    help
        No prefix in generated macro

config DEST_BUFFER_LENGTH
    int "Number of Destination buffer length"
    default 8
    help
        No prefix in generated macro

config DMA_DESCRIPTOR_NUM
    int "Number of descriptor"
    default 2
    help
        No prefix in generated macro


endmenu

source "${SdkRootDirPath}/Kconfig.mcuxpresso"
```

## driver_examples/lpc_enet/Kconfig
```kconfig
# Copyright 2025 NXP
#
# SPDX-License-Identifier: BSD-3-Clause

config APP_PHY_AUTONEGO_TIMEOUT_COUNT
    int "PHY Autonegotiation Timeout Count"
    default 500000
    help
        No prefix in generated macro
        type unsigned

config APP_USER_DEFINED_MAC_ADDRESS
    bool "MAC Address Defined by User"
    default n
    help
        No prefix in generated macro

config APP_MAC_ADDRESS
    string "MAC Address Byte Array"
    default "{0x54, 0x27, 0x8d, 0x00, 0x00, 0x00}"
    depends on APP_USER_DEFINED_MAC_ADDRESS
    help
        No prefix in generated macro
```
