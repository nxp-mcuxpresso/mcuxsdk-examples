## CMakeLists.txt
```
cmake_minimum_required(VERSION 3.22.0)

include(${SdkRootDirPath}/cmake/extension/mcux.cmake)

project(coex_wifi_peripheral_ht LANGUAGES C CXX ASM PROJECT_BOARD_PORT_PATH ${board_root}/${board}/coex_examples/coex_wifi_peripheral_ht)

include(${SdkRootDirPath}/examples/coex_examples/coex_wifi_peripheral_ht/app_config.cmake)

mcux_add_include(
 	BASE_PATH ${SdkRootDirPath}
    INCLUDES examples/_boards/${board}/coex_examples/coex_wifi_peripheral_ht
	TARGET edgefast_open_app.h
)
mcux_add_source(
	BASE_PATH ${SdkRootDirPath}
    SOURCES examples/_boards/${board}/coex_examples/coex_wifi_peripheral_ht/${multicore_foldername}/edgefast_open_app.h
    CONFIG True
    PREINCLUDE True
    PREINCLUDE_TYPE c_include cpp_include
)

include(${SdkRootDirPath}/CMakeLists.txt)
mcux_add_source(
    BASE_PATH ${SdkRootDirPath}
    SOURCES examples/coex_examples/coex_wifi_peripheral_ht/main.c
            middleware/wireless/coex/src/common/controller_coex_nxp.c
            middleware/wireless/coex/src/cli/coex_cli.c
            middleware/wireless/coex/src/cli/coex_cli.h
            middleware/edgefast_open/examples/peripheral_ht/peripheral_ht.c
            middleware/edgefast_open/examples/peripheral_ht/peripheral_ht.h
            middleware/wireless/coex/src/common/coex_lfs_defines.h
)

mcux_add_include(
    BASE_PATH ${SdkRootDirPath}
    INCLUDES examples/coex_examples/coex_wifi_peripheral_ht
             middleware/edgefast_open/examples/peripheral_ht
             middleware/wireless/coex/src/cli
             middleware/wireless/coex/src/common
)

mcux_add_macro(
  CC "-DCFG_BLE\
      -DPRINTF_ADVANCED_ENABLE=1\
      -DSDK_DEBUGCONSOLE_UART=1\
      -DSDK_OS_FREE_RTOS\
      -DUSE_RTOS=1\
      -DLFS_DEFINES=coex_lfs_defines.h"
)

# Add MCUXPRESSO IDE support
mcux_add_include(
    INCLUDES
        mcuxpresso_config
)

mcux_add_source(
    SOURCES mcuxpresso_config/app_mcuxpresso_config.h
)

include(${SdkRootDirPath}/${board_root}/${board}/coex_examples/coex_wifi_peripheral_ht/reconfig.cmake OPTIONAL)

mcux_convert_binary(BINARY ${APPLICATION_BINARY_DIR}/${MCUX_SDK_PROJECT_NAME}.bin)
```

## prj.conf
```kconfig
# periphreal config
# component
CONFIG_MCUX_COMPONENT_middleware.freertos-kernel.heap_4=y
CONFIG_MCUX_COMPONENT_utility.assert_lite=n
CONFIG_MCUX_COMPONENT_utility.debug_console_lite=n
CONFIG_MCUX_PRJSEG_middleware.fatfs.generated_config=n
CONFIG_MCUX_PRJSEG_middleware.freertos-kernel.generated_config=n
CONFIG_MCUX_PRJSEG_module.board.pinmux_customize_folder=y
CONFIG_MCUX_PRJSEG_project.hw_app_customize_folder=y
CONFIG_MCUX_COMPONENT_component.phyksz8081=y
CONFIG_MCUX_COMPONENT_driver.conn_fwloader.fw_bin=y
CONFIG_MCUX_COMPONENT_middleware.edgefast_open=y

# config
CONFIG_BT_DEVICE_NAME="peripheral_ht"
CONFIG_BT_HOST_CRYPTO=y
CONFIG_BT_KEYS_OVERWRITE_OLDEST=y
CONFIG_BT_PERIPHERAL=y
CONFIG_BT_SETTINGS=y
CONFIG_BT_SMP=y
CONFIG_BT_HTS=y
CONFIG_DEBUG_CONSOLE_SYNCHRONIZATION_MODE=1
CONFIG_FSL_OSA_MAIN_FUNC_ENABLE=n
CONFIG_BT_SMP_ALLOW_UNAUTH_OVERWRITE=y
#CONFIG_USB_HOST_CONFIG_MSD=1

#FreeRTOS config
CONFIG_MCUX_COMPONENT_middleware.freertos-kernel.extension=y
```

## src/coex.c
```c
/**
 * Copyright 2024 NXP
 * All rights reserved.
 *
 * SPDX-License-Identifier: BSD-3-Clause
 */

///////////////////////////////////////////////////////////////////////////////
//  Includes
///////////////////////////////////////////////////////////////////////////////
#include <string.h>/**/
#include "BT_common.h"
#include "BT_version.h"
#include "BT_hci_api.h"
#include "wlan.h"
#include "cli.h"
#include "coex.h"

extern struct cli_command tests[];
char *wlantemp;
#define WLAN_CMD_BUF_SIZE 512
char wlan_command[WLAN_CMD_BUF_SIZE];
void execute_commnd(char *wlan_command,char** args,int j);
extern int appl_main (int argc, char **argv);
int wlan_connect_success_count = 0;
int wlan_connect_total_count   = 0;
void coex_menuPrint(void);

#define TASK_SCAN_STACK_SIZE      (2* 1024)
#define TASK_CONNECT_STACK_SIZE   (10 * 1024)
int wlan_scan_running=0;
int wlan_connect_running=0;
portSTACK_TYPE *task_scan_stack = NULL;
void scan_loop(void * parameter);
static OSA_TASK_HANDLE_DEFINE(ScanTaskHandle);
static OSA_TASK_DEFINE(scan_loop, OSA_PRIORITY_LOW, 1, TASK_SCAN_STACK_SIZE, 0);

void connect_loop(void * parameter);
static OSA_TASK_HANDLE_DEFINE(ConnectTaskHandle);
static OSA_TASK_DEFINE(connect_loop, OSA_PRIORITY_LOW, 1, TASK_CONNECT_STACK_SIZE, 0);
/*******************************************************************************
 * Code
 ******************************************************************************/

static void printSeparator(void)
{
    PRINTF("========================================\r\n");
}

/*!
 * @brief Function to menu Separator.
 */
static void menuSeparator(void)
{
    printSeparator();
}

static struct cli_command built_ins[] = {
    {"help", NULL, help_command},
};

int coex_cli_init(void)
{
    if (cli_register_commands(&built_ins[0], (int)(sizeof(built_ins) / sizeof(struct cli_command))) != 0)
    {
        return -WM_FAIL;
    }

     return WM_SUCCESS;
}

/*!
 * @brief Function to start MAIN BT MENU.
 */
#if defined(CONFIG_DISABLE_BLE) && (CONFIG_DISABLE_BLE == 0)
/*static void bt_menu(void)
{
	appl_main(0 , NULL);
}*/
#endif

void wifi_cli(void)
{
	char a;
	int i=0;
    char wlan_command[WLAN_CMD_MAX_LEN];
	PRINTF("Enter WiFi commands\n");

	while (1)
	{
		PRINTF("\n>");
		while (1) 
		{
			a=pollChar();
			if(a == '\n') continue;
			if (a== '\r')
			{
				wlan_command[i]='\0';          
				break;
			}
			wlan_command[i]=a;
			i++;
            if (i >= WLAN_CMD_MAX_LEN)
                break;
		} 
 
		i=0;
		char* List[20];
		char *wlantemp=strtok(wlan_command, " ");
		int j=1;
		List[0]=wlan_command;
		while(1)
		{
			wlantemp = strtok(NULL, " ");
			if(wlantemp == NULL)
				break;     	  
			List[j]=wlantemp;
			j++;    	
		}
   
		if (strcmp(wlan_command,"0")==0)
		{	
			break;
		}
		if (strcmp(wlan_command,"")==0)
		{	
			continue;
		}
		execute_commnd(wlan_command,List,j);
	}	
}

void scan_loop(void *parameter)
{
    int j = 0;
    char *args[20];
    const struct cli_command *command = NULL;
    char wlan_command[10];
    const char *p;
    int i   = 0;
    args[0] = "wlan-scan";
    strcpy(wlan_command, "wlan-scan");
    i       = ((p = strchr(wlan_command, '.')) == NULL) ? 0 : (p - wlan_command);
    command = lookup_command(wlan_command, i);
    while (1)
    {
        command->function(j, args);
        OSA_TimeDelay(5000);
    }
}

bool is_connected()
{
    enum wlan_connection_state state;
    wlan_get_connection_state(&state);

    if (state == WLAN_CONNECTED)
    {
        return 1;
    }
    else
        return 0;
}

bool is_disconnected()
{
    enum wlan_connection_state state;
    wlan_get_connection_state(&state);

    if (state == WLAN_DISCONNECTED)
    {
        return 1;
    }
    else
        return 0;
}

void connect_loop(void *profile)
{
    int j = 2;
    char *args[ARGS_SIZE];
    const struct cli_command *command = NULL;
    const char *p;
    int i = 0;
    char wlan_command[30];

    char profile_name[PROFILE_NAME_LEN];
    if ((profile != NULL) && (strlen((char *)profile) < PROFILE_NAME_LEN))
    {	    
    	strcpy(profile_name, profile);
    }
    wlan_connect_total_count   = 0;
    wlan_connect_success_count = 0;

    while (1)
    {
    	args[0] = "wlan-connect";
    	args[1] = profile_name;
    	strcpy(wlan_command, "wlan-connect");
    	i       = ((p = strchr(wlan_command, '.')) == NULL) ? 0 : (p - wlan_command);
    	command = lookup_command(wlan_command, i);
        command->function(j, args);
        while (1)
        {
            OSA_TimeDelay(500);
            if (is_disconnected())
            {
                PRINTF("wlan connection failed");
                wlan_connect_total_count++;
                break;
            }
            else if (is_connected())
            {
                wlan_connect_success_count++;
                wlan_connect_total_count++;
                args[0] = "wlan-disconnect";
                strcpy(wlan_command, "wlan-disconnect");
                i       = ((p = strchr(wlan_command, '.')) == NULL) ? 0 : (p - wlan_command);
                command = lookup_command(wlan_command, i);
                command->function(j, args);
                OSA_TimeDelay(5000);
                break;
            }
            else
            {
                continue;
            }
        }
    }
}

void execute_commnd(char *wlan_command, char **args, int j)

{
	osa_status_t status;
	(void)status;
	const struct cli_command *command = NULL;
	const char *p;
	int i=0;
	if(strcmp(wlan_command,"wlan-scan-loop")==0)
    {
        if (wlan_scan_running == 0)
        {
		    wlan_scan_running=1;
		    status =
                OSA_TaskCreate((osa_task_handle_t)ScanTaskHandle, OSA_TASK(scan_loop), NULL);
            assert(KOSA_StatusSuccess == status);
        }
        {
            PRINTF("wlan scan loop is already running");
        }
	}   
    else if(strcmp(wlan_command,"wlan-scan-stop")==0)
    {
		if (wlan_scan_running==1)
		{
			OSA_TaskDestroy(ScanTaskHandle);
			wlan_scan_running=0;
            PRINTF("wlan scan loop stopped");
		}
	    else{
			PRINTF("wlan scan loop is not running");
		}
	}
	else if(strcmp(wlan_command,"wlan-connect-loop")==0)
    {
        if (j == 1)
        {
            printf("Error Usage: wlan-connect-loop <profile_name>");
        }
        else if (wlan_connect_running == 0)
        {
		    wlan_connect_running=1;
		    wlan_command="wlan-connect";
		    status =OSA_TaskCreate((osa_task_handle_t)ConnectTaskHandle, OSA_TASK(connect_loop), args[1]);
            assert(KOSA_StatusSuccess == status);
        }
        else
        {
            PRINTF("wlan connect-disconnect loop is already running");
        }
	}
	else if(strcmp(wlan_command,"wlan-connect-stop")==0)
    {
        if (wlan_connect_running==1)
        {
            OSA_TaskDestroy(ConnectTaskHandle);

            PRINTF("Pass count is %d\n", wlan_connect_success_count);
            PRINTF("Total count is %d\n", wlan_connect_total_count);
            wlan_connect_running = 0;
        }
        else
        {
            PRINTF("wlan connect-disconnect loop is not running");
        }
    }
    else
    {
        i       = ((p = strchr(wlan_command, '.')) == NULL) ? 0 : (p - wlan_command);
        command = lookup_command(wlan_command, i);
        if (command == NULL)
            PRINTF("Invalid Command");
        else
            command->function(j, args);
    }
}

/*!
 * @brief struct for coex menu.
 */
typedef struct
{
    char key;
    // int key;
    void (*func)(void);
    const char *text;
} menu_item_t;

menu_item_t menuItems[] = {
	{'0',coex_menuPrint, "Coex menu print"},
#if defined(CONFIG_DISABLE_BLE) && (CONFIG_DISABLE_BLE == 0)
	//{'b', bt_menu, "BT MAIN MENU-Call"},
#endif
#if defined(CONFIG_WIFI_BLE_COEX_APP) && (CONFIG_WIFI_BLE_COEX_APP == 1)
	{'w',wifi_cli, "Wifi Cli"},
#endif
	{0, NULL, NULL},
};

/*!
 * @brief Function to coex menu print.
 */
void coex_menuPrint(void)
{
    for (int i = 0; menuItems[i].text != NULL; i++)
    {
        if (menuItems[i].key)
            PRINTF("  %c  %s\r\n", menuItems[i].key, menuItems[i].text);
        else
            PRINTF("  %d  %s\r\n", i, menuItems[i].text);
    }
}

/*!
 * @brief Function to coex menu action.
 */
void coex_menuAction(int ch)
{
    if (ch == '\r' || ch == ' ' || ch == '\n')
    {
        menuSeparator();
        return;
    }

    for (int i = 0; menuItems[i].func != NULL; i++)
    {
        if (menuItems[i].key == ch)
        {
            PRINTF("Key '%c': %s\r\n", ch, menuItems[i].text);
            menuItems[i].func();
            return;
        }
    }
    PRINTF("ERROR: No action bound to '%c'\r\n", ch);
}

/*!
 * @brief Function to Poll char.
 */
int pollChar(void)
{
    //    if (!UART_HAL_GetStatusFlag(BOARD_DEBUG_UART_BASEADDR, kUartRxDataRegFull))
    //        return -1;
    //
    //    uint8_t ch;
    //    UART_HAL_Getchar(BOARD_DEBUG_UART_BASEADDR, &ch);
    //    // Flush the UART to avoid the "OpenSDA UART infinite RX FIFO" bug:
    //    // If user presses keys very quickly then after a while, the UART enters
    //    // a mode where the same sequence of characters are repeatedly returned
    //    // by UART_HAL_Getchar(). Even a hard reset does not fix it.
    //    // Only way to recover is by unplugging OpenSDA USB.
    //    UART_HAL_FlushRxFifo(BOARD_DEBUG_UART_BASEADDR);

    int tmp;
    // TODO: verify the message above. Which board has this issue ?
    tmp = GETCHAR();
    // scanf("%d,", &tmp);
    return tmp;
}

//*********************************************************************************************
```

## src/coex_cli.c
```c
/*
 * Copyright 2024 NXP
 *
 * SPDX-License-Identifier: BSD-3-Clause
 * The BSD-3-Clause license can be found at https://spdx.org/licenses/BSD-3-Clause.html
 */

 ///////////////////////////////////////////////////////////////////////////////
//  Includes
///////////////////////////////////////////////////////////////////////////////
#include <string.h>

#include "fsl_debug_console.h"
#include "cli.h"
#include "coex_cli.h"
#include "wlan.h"

#define CMD_BUF_SIZE 512
char cmd_buf[CMD_BUF_SIZE];

void coex_menuPrint(void);

/*******************************************************************************
 * Code
 ******************************************************************************/

static void printSeparator(void)
{
    PRINTF("========================================\r\n");
}

static struct cli_command built_ins[] = {
    {"help (exit: 0)", NULL, help_command},
};

int coex_cli_init()
{
    if (cli_register_commands(&built_ins[0], (int)(sizeof(built_ins) / sizeof(struct cli_command))) != 0)
    {
        return -1;
    }
    return 0;
}

static int coex_console_input(void)
{
    char a;
    int i;

retry:
    i = 0;
    PRINTF("\n>");

    while (1)
    {
        a = pollChar();
        if (a == '\n')
            continue;
        if (a == '\r')
        {
            cmd_buf[i]='\0';
            break;
        }

        cmd_buf[i++] = a;

        if (i >= CMD_BUF_SIZE)
        {
            PRINTF("Error: overflow!\r\n");
            goto retry;
        }
    }

    if (strcmp(cmd_buf, "0")==0)
    {
        coex_menuPrint();
        return -1;
    }
    if (strcmp(cmd_buf,"")==0)
    {
        goto retry;
    }

    return 0;
}

void execute_commnd(char *wlan_command,char** args,int j);
void wifi_cli(void)
{
    char* cmd_list[20] = {0};
    char *wlantemp = NULL;
    char *psave = NULL;
    char *delim = " ";
    int j=1;
    int ret = 0;

    PRINTF("Enter WiFi commands\n");

    while (1)
    {
        ret = coex_console_input();
        if (ret == -1)
        {
            return;
        }
        wlantemp=strtok_r(cmd_buf, delim, &psave);
        j = 1;
        cmd_list[0]=cmd_buf;
        while(1)
        {
            wlantemp=strtok_r(NULL, delim, &psave);
            if(wlantemp == NULL)
                break;
            cmd_list[j++]=wlantemp;
        }

        PRINTF("wifi commands: %s\n", cmd_buf);
        execute_commnd(cmd_buf, cmd_list, j);
    }
}

void execute_commnd(char *wlan_command,char** args,int j)
{
    osa_status_t status;
    (void)status;
    const struct cli_command *command = NULL;
    const char *p;
    int i=0;

    i = ((p = strchr(wlan_command, '.')) == NULL) ? 0 : (p - wlan_command);
    command = lookup_command(wlan_command, i);
    if (command == NULL)
        PRINTF("Invalid Command");
    else
        command->function(j, args);
}

/*!
 * @brief struct for coex menu.
 */
typedef struct
{
    char key;
    void (*func)(void);
    const char *text;
} menu_item_t;

menu_item_t menuItems[] = {
    {'0',coex_menuPrint, "Coex menu print"},
    {'w',wifi_cli, "Wifi Cli"},
    {0, NULL, NULL},
};

/*!
 * @brief Function to coex menu print.
 */
void coex_menuPrint(void)
{
    PRINTF(" Coex menu called\r\n");
    printSeparator();

    for (int i = 0; menuItems[i].text != NULL; i++)
    {
        if (menuItems[i].key)
            PRINTF("  %c  %s\r\n", menuItems[i].key, menuItems[i].text);
        else
            PRINTF("  %d  %s\r\n", i, menuItems[i].text);
    }

    printSeparator();
}

/*!
 * @brief Function to coex menu action.
 */
void coex_menuAction(int ch)
{
    if (ch == '\r' || ch == ' ' || ch == '\n')
    {
        printSeparator();
        return;
    }

    for (int i = 0; menuItems[i].func != NULL; i++)
    {
        if (menuItems[i].key == ch)
        {
            PRINTF("Key '%c': %s\r\n", ch, menuItems[i].text);
            menuItems[i].func();
            return;
        }
    }
    PRINTF("ERROR: No action bound to '%c'\r\n", ch);
}


/*!
 * @brief Function to Poll char.
 */
int pollChar(void)
{
    int tmp;
    tmp = GETCHAR();
    return tmp;
}

//*********************************************************************************************
```

## src/coex_cli.h
```c
/*
 * Copyright 2024 NXP
 *
 * SPDX-License-Identifier: BSD-3-Clause
 * The BSD-3-Clause license can be found at https://spdx.org/licenses/BSD-3-Clause.html
 */

///////////////////////////////////////////////////////////////////////////////
//  Includes
///////////////////////////////////////////////////////////////////////////////

#ifndef __COEX_CLI_H__
#define __COEX_CLI_H__

/***********************************************************************************************************************
 * Definitions
 **********************************************************************************************************************/

int coex_cli_init(void);
int pollChar(void);
void coex_menuPrint(void);
void coex_menuAction(int ch);

#endif
```

## src/controller_coex_nxp.c
```c
/*
 * Copyright 2025 NXP
 *
 * SPDX-License-Identifier: BSD-3-Clause
 * The BSD-3-Clause license can be found at https://spdx.org/licenses/BSD-3-Clause.html
 */

 #include "fsl_debug_console.h"

 #if(CONFIG_WIFI_BLE_COEX_APP)
 #include "cli.h"
 #include "dhcp-server.h"
 #include "wlan.h"
 // #include "wifi_ping.h"
 #include "iperf.h"
 #include <wm_net.h>
 #include "wlan_bt_fw.h"
 
 #ifndef RW612_SERIES
 #include "wifi_bt_config.h"
 #include "controller.h"
 #include "firmware_dnld.h"
 #if (CONFIG_BT_IND_DNLD || CONFIG_WIFI_IND_DNLD)
 #include "fw_loader_uart.h"
 #endif /* CONFIG_BT_IND_DNLD || CONFIG_WIFI_IND_DNLD */
 #else
 #include "fsl_rtc.h"
 #endif /* RW612_SERIES */
 #endif /* CONFIG_WIFI_BLE_COEX_APP */
 
 #ifdef RW612_SERIES
 #if(CONFIG_OT_CLI)
 #include "ot_platform_common.h"
 #include "fwk_platform_coex.h"
 #else
 #include "fwk_platform_ble.h"
 #endif /* CONFIG_OT_CLI */
 #endif /* RW612_SERIES */
 
 static void printSeparator(void)
 {
     PRINTF("========================================\r\n");
 }
 
 #if(CONFIG_WIFI_BLE_COEX_APP)
 static struct wlan_network uap_network;
 static struct wlan_network sta_network;
 extern int ping_cli_init(void);
 
 #ifdef RW612_SERIES
 static void dump_set_rtc_time_usage(void)
 {
     (void)PRINTF("Usage: wlan-set-rtc-time <year> <month> <day> <hour> <minute> <second>\r\n");
     (void)PRINTF("\r\nUsage example : \r\n");
     (void)PRINTF("wlan-set-rtc-time 2022 12 31 19 00\r\n");
 }
 
 static void test_wlan_set_rtc_time(int argc, char **argv)
 {
     rtc_datetime_t date;
     int ret;
 
     if (argc < 0)
     {
         (void)PRINTF("Error: invalid number of arguments\r\n");
         dump_set_rtc_time_usage();
         return;
     }
     date.year   = (uint16_t)atoi(argv[1]);
     date.month  = (uint8_t)atoi(argv[2]);
     date.day    = (uint8_t)atoi(argv[3]);
     date.hour   = (uint8_t)atoi(argv[4]);
     date.minute = (uint8_t)atoi(argv[5]);
     date.second = (uint8_t)atoi(argv[6]);
 
     /* RTC time counter has to be stopped before setting the date & time in the TSR register */
     RTC_EnableTimer(RTC, false);
 
     /* Set RTC time to default */
     ret = RTC_SetDatetime(RTC, &date);
     if (ret != kStatus_Success)
     {
         (void)PRINTF("Error: invalid number of arguments\r\n");
         dump_set_rtc_time_usage();
     }
 
     /* Start the RTC time counter */
     RTC_EnableTimer(RTC, true);
 
     /* Get date time */
     RTC_GetDatetime(RTC, &date);
 
     /* print default time */
     (void)PRINTF("Current datetime: %04hd-%02hd-%02hd %02hd:%02hd:%02hd\r\n", date.year, date.month, date.day,
                 date.hour, date.minute, date.second);
 }
 
 static void test_wlan_get_rtc_time(int argc, char **argv)
 {
     rtc_datetime_t date;
 
     /* Get date time */
     RTC_GetDatetime(RTC, &date);
 
     /* print default time */
     (void)PRINTF("Current datetime: %04hd-%02hd-%02hd %02hd:%02hd:%02hd\r\n", date.year, date.month, date.day,
                 date.hour, date.minute, date.second);
 }
 
 static struct cli_command wlan_prov_commands[] = {
     {"wlan-set-rtc-time", "<year> <month> <day> <hour> <minute> <second>", test_wlan_set_rtc_time},
     {"wlan-get-rtc-time", NULL, test_wlan_get_rtc_time},
 };
 
 static int wlan_prov_cli_init(void)
 {
     unsigned int i;
 
     for (i = 0; i < sizeof(wlan_prov_commands) / sizeof(struct cli_command); i++)
     {
         if (cli_register_command(&wlan_prov_commands[i]) != 0)
         {
             return -1;
         }
     }
 
     return 0;
 }
 #endif
 
 int wlan_event_callback(enum wlan_event_reason reason, void *data)
 {
     int ret;
     struct wlan_ip_config addr;
     char ip[16];
     static int auth_fail                      = 0;
     wlan_uap_client_disassoc_t *disassoc_resp = data;
 
     printSeparator();
     PRINTF("app_cb: WLAN: received event %d\r\n", reason);
     printSeparator();
 
     switch (reason)
     {
         case WLAN_REASON_INITIALIZED:
             PRINTF("app_cb: WLAN initialized\r\n");
             printSeparator();
 
             ret = wlan_basic_cli_init();
             if (ret != WM_SUCCESS)
             {
                 PRINTF("Failed to initialize BASIC WLAN CLIs\r\n");
                 return 0;
             }
 
             ret = wlan_cli_init();
             if (ret != WM_SUCCESS)
             {
                 PRINTF("Failed to initialize WLAN CLIs\r\n");
                 return 0;
             }
             PRINTF("WLAN CLIs are initialized\r\n");
             printSeparator();
 #ifdef RW610
             ret = wlan_enhanced_cli_init();
             if (ret != WM_SUCCESS)
             {
                 PRINTF("Failed to initialize WLAN CLIs\r\n");
                 return 0;
             }
             PRINTF("ENHANCED WLAN CLIs are initialized\r\n");
             printSeparator();
 #endif
             ret = ping_cli_init();
             if (ret != WM_SUCCESS)
             {
                 PRINTF("Failed to initialize PING CLI\r\n");
                 return 0;
             }
 
             ret = iperf_cli_init();
             if (ret != WM_SUCCESS)
             {
                 PRINTF("Failed to initialize IPERF CLI\r\n");
                 return 0;
             }
 
             ret = dhcpd_cli_init();
             if (ret != WM_SUCCESS)
             {
                 PRINTF("Failed to initialize DHCP Server CLI\r\n");
                 return 0;
             }
 #ifdef RW612_SERIES
             ret = wlan_prov_cli_init();
             if (ret != WM_SUCCESS)
             {
                 PRINTF("Failed to initialize PROV CLI\r\n");
                 return 0;
             }
 #endif
             PRINTF("CLIs Available:\r\n");
             printSeparator();
             help_command(0, NULL);
             printSeparator();
             break;
         case WLAN_REASON_INITIALIZATION_FAILED:
             PRINTF("app_cb: WLAN: initialization failed\r\n");
             break;
         case WLAN_REASON_AUTH_SUCCESS:
             PRINTF("app_cb: WLAN: authenticated to network\r\n");
             break;
         case WLAN_REASON_SUCCESS:
             PRINTF("app_cb: WLAN: connected to network\r\n");
             ret = wlan_get_address(&addr);
             if (ret != WM_SUCCESS)
             {
                 PRINTF("failed to get IP address\r\n");
                 return 0;
             }
 
             net_inet_ntoa(addr.ipv4.address, ip);
 
             ret = wlan_get_current_network(&sta_network);
             if (ret != WM_SUCCESS)
             {
                 PRINTF("Failed to get External AP network\r\n");
                 return 0;
             }
 
             PRINTF("Connected to following BSS:\r\n");
             PRINTF("SSID = [%s]\r\n", sta_network.ssid);
             if (addr.ipv4.address != 0U)
             {
                 PRINTF("IPv4 Address: [%s]\r\n", ip);
             }
 #if CONFIG_IPV6
             int i;
             for (i = 0; i < CONFIG_MAX_IPV6_ADDRESSES; i++)
             {
                 if (ip6_addr_isvalid(addr.ipv6[i].addr_state))
                 {
                     (void)PRINTF("IPv6 Address: %-13s:\t%s (%s)\r\n", ipv6_addr_type_to_desc((struct net_ipv6_config *)&addr.ipv6[i]),
                                 inet6_ntoa(addr.ipv6[i].address), ipv6_addr_state_to_desc(addr.ipv6[i].addr_state));
                 }
             }
             (void)PRINTF("\r\n");
 #endif
             auth_fail = 0;
             break;
         case WLAN_REASON_CONNECT_FAILED:
             PRINTF("app_cb: WLAN: connect failed\r\n");
             break;
         case WLAN_REASON_NETWORK_NOT_FOUND:
             PRINTF("app_cb: WLAN: network not found\r\n");
             break;
         case WLAN_REASON_NETWORK_AUTH_FAILED:
             PRINTF("app_cb: WLAN: network authentication failed\r\n");
             auth_fail++;
             if (auth_fail >= 3)
             {
                 PRINTF("Authentication Failed. Disconnecting ... \r\n");
                 wlan_disconnect();
                 auth_fail = 0;
             }
             break;
         case WLAN_REASON_ADDRESS_SUCCESS:
             PRINTF("network mgr: DHCP new lease\r\n");
             break;
         case WLAN_REASON_ADDRESS_FAILED:
             PRINTF("app_cb: failed to obtain an IP address\r\n");
             break;
         case WLAN_REASON_USER_DISCONNECT:
             PRINTF("app_cb: disconnected\r\n");
             auth_fail = 0;
             break;
         case WLAN_REASON_LINK_LOST:
             PRINTF("app_cb: WLAN: link lost\r\n");
             break;
         case WLAN_REASON_CHAN_SWITCH:
             PRINTF("app_cb: WLAN: channel switch\r\n");
             break;
         case WLAN_REASON_UAP_SUCCESS:
             PRINTF("app_cb: WLAN: UAP Started\r\n");
             ret = wlan_get_current_uap_network(&uap_network);
 
             if (ret != WM_SUCCESS)
             {
                 PRINTF("Failed to get Soft AP network\r\n");
                 return 0;
             }
 
             printSeparator();
             PRINTF("Soft AP \"%s\" started successfully\r\n", uap_network.ssid);
             printSeparator();
             if (dhcp_server_start(net_get_uap_handle()))
                 PRINTF("Error in starting dhcp server\r\n");
 
             PRINTF("DHCP Server started successfully\r\n");
             printSeparator();
             break;
         case WLAN_REASON_UAP_CLIENT_ASSOC:
             PRINTF("app_cb: WLAN: UAP a Client Associated\r\n");
             printSeparator();
             PRINTF("Client => ");
             print_mac((const char *)data);
             PRINTF("Associated with Soft AP\r\n");
             printSeparator();
             break;
         case WLAN_REASON_UAP_CLIENT_CONN:
             PRINTF("app_cb: WLAN: UAP a Client Connected\r\n");
             printSeparator();
             PRINTF("Client => ");
             print_mac((const char *)data);
             PRINTF("Connected with Soft AP\r\n");
             printSeparator();
             break;
         case WLAN_REASON_UAP_CLIENT_DISSOC:
             printSeparator();
             PRINTF("app_cb: WLAN: UAP a Client Dissociated:");
             PRINTF(" Client MAC => ");
             print_mac((const char *)(disassoc_resp->sta_addr));
             PRINTF(" Reason code => ");
             PRINTF("%d\r\n", disassoc_resp->reason_code);
             printSeparator();
             break;
         case WLAN_REASON_UAP_STOPPED:
             PRINTF("app_cb: WLAN: UAP Stopped\r\n");
             printSeparator();
             PRINTF("Soft AP \"%s\" stopped successfully\r\n", uap_network.ssid);
             printSeparator();
 
             dhcp_server_stop();
 
             PRINTF("DHCP Server stopped successfully\r\n");
             printSeparator();
             break;
         case WLAN_REASON_PS_ENTER:
             PRINTF("app_cb: WLAN: PS_ENTER\r\n");
             break;
         case WLAN_REASON_PS_EXIT:
             PRINTF("app_cb: WLAN: PS EXIT\r\n");
             break;
         default:
             PRINTF("app_cb: WLAN: Unknown Event: %d\r\n", reason);
     }
     return 0;
 }
 #endif
 
 #ifndef RW612_SERIES
 void coex_controller_init(void)
 {
     int result;
     (void) result;
 #if (CONFIG_BT_IND_DNLD || CONFIG_WIFI_IND_DNLD)
     BOARD_WIFI_BT_Enable(true);
     /* BT only firmware download over UART */
     (void)PRINTF("Download BT FW...\r\n");
     void *intf = uart_init_interface();
     assert(intf != NULL);
     result = firmware_download(bt_fw_bin, bt_fw_bin_len, intf, 0);
     assert(0 == result);
     (void)PRINTF("Download WLAN FW...\r\n");
 #endif /* CONFIG_BT_IND_DNLD || CONFIG_WIFI_IND_DNLD*/
     /* WLAN only/Combo firmware download over SDIO */
     result = wlan_init(wlan_fw_bin, wlan_fw_bin_len);  
     assert(0 == result);
     result = wlan_start(wlan_event_callback);
     assert(0 == result);
 }
 
 #else /* RW612_SERIES */
 
 #if(CONFIG_OT_CLI)
 extern void appOtStart(int argc, char *argv[]);
 #endif
 
 /* Initialize the platform */
 void coex_controller_init(void)
 {
     int result = 0;
     (void) result;
 
 #if(CONFIG_WIFI_BLE_COEX_APP)
     /* Wi-Fi firmware download over IMU */
     result = wlan_init(wlan_fw_bin, wlan_fw_bin_len);
     assert(0 == result);
 
     result = wlan_start(wlan_event_callback);
     assert(0 == result);
 
     vTaskDelay(1500);
 #endif /* CONFIG_WIFI_BLE_COEX_APP */
 
 #if(CONFIG_OT_CLI)
     /* Initialize 15.4+BLE combo controller first
     * Any other attemps to init a 15.4 or BLE single mode will be ignored
     * For BLE, ethermind calls controller_init which calls PLATFORM_InitBle which calls PLATFORM_InitControllers(connBle_c)
     * As we already initialized the controller in combo mode here, the PLATFORM_InitControllers(connBle_c) call does nothing
     * Same applies for PLATFORM_InitOt which calls PLATFORM_InitControllers(conn802_15_4_c)
     * For RW61x, 15.4/BLE combo image must be flashed at 15.4 firmware address Z154_IMAGE_A_OFFSET (0x85e0000) */
     PLATFORM_InitControllers(conn802_15_4_c | connBle_c);
 
 #if(CONFIG_WIFI_BLE_COEX_APP == 0)
     /* Initialize LWIP stack */
     tcpip_init(NULL, NULL);
 #endif
 
     appOtStart(0, NULL);
 #elif(CONFIG_DISABLE_BLE == 0)
     /* BTonly firmware download */
     PLATFORM_InitBle();
 #endif
 }
 #endif /* RW612_SERIES */
 
```
