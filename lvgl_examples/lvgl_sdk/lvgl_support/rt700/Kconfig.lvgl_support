## lvgl_examples/lvgl_sdk/lvgl_support/rt700/Kconfig.lvgl_support
```kconfig
config MCUX_PRJSEG_module.board.lvgl
    select MCUX_COMPONENT_driver.flexio_mculcd_edma
    select MCUX_COMPONENT_driver.dbi_flexio_edma
    select MCUX_COMPONENT_driver.gt911
    select MCUX_COMPONENT_driver.lpflexcomm_lpi2c
    select MCUX_COMPONENT_driver.lpflexcomm
    select MCUX_COMPONENT_driver.ft5406_rt
    select MCUX_COMPONENT_driver.ssd1963
    select MCUX_COMPONENT_driver.inputmux
    select MCUX_COMPONENT_driver.dbi_lcdif
    select MCUX_COMPONENT_driver.edma4
    select MCUX_COMPONENT_driver.dc-fb-dbi
    select MCUX_COMPONENT_driver.dbi
    select MCUX_COMPONENT_driver.dbi_flexio_edma
    select MCUX_COMPONENT_driver.dc-fb-lcdif
    select MCUX_COMPONENT_driver.lcdif
    select MCUX_COMPONENT_driver.ft3267
    select MCUX_PRJSEG_module.board.display_support
    select MCUX_COMPONENT_driver.tma525b
```

## lvgl_examples/lvgl_sdk/lvgl_support/rw61x/Kconfig.lvgl_support
```kconfig
config MCUX_PRJSEG_module.board.lvgl
    select MCUX_PRJSEG_module.board.display_support
```

## mbedtls3x_examples/psa_crypto_opaque_key_examples/Kconfig
```kconfig
# It is optional to provide example specific Kconfig.

rsource "${SdkRootDirPath}/Kconfig.mcuxpresso"

mainmenu "PSA Crypto Opaque Key example Configuration"

config TEST_KEY_LOCATION
    default 0x0
    hex "The key location to be used for test"
    help
        No prefix in generated macro
        This macro defines a PSA API psa_key_location_t value for the keys used
        in this test example. The default value is overridden in the device-specific
        project configuration files. For more information on the meaning of this value,
        please refer to the PSA API documentation for the psa_key_location_t type.
```

## tfm_examples/tfm_regression_s/Kconfig
```kconfig
# It is optional to provide example specific Kconfig.

mainmenu "tfm regression secure"

# Need to refer the root Kconfig.mcuxpreso to get all Kconfig data
source "${SdkRootDirPath}/Kconfig.mcuxpresso"

# Board example specific Kconfig can be linked in this way if needed
osource "${SdkRootDirPath}/${project_board_port_path}/Kconfig"
```

## wireless_examples/bluetooth/common/Kconfig
```kconfig
# Copyright 2024 NXP
# SPDX-License-Identifier: BSD-3-Clause

config MCUX_PRJSEG_module.wireless.ble.app_common
    bool "BLE Application Common layer"
    select MCUX_COMPONENT_middleware.wireless.framework
    select MCUX_COMPONENT_middleware.wireless.framework.seclib_rng
    select MCUX_COMPONENT_middleware.wireless.framework.platform.ble
    select MCUX_COMPONENT_middleware.wireless.framework.module_info #should be selected by ble_host used by ble_globals.c
    select MCUX_COMPONENT_middleware.wireless.framework.lowpower
    select MCUX_COMPONENT_middleware.wireless.framework.nvm
    select MCUX_COMPONENT_middleware.wireless.framework.systicks if MCUX_COMPONENT_middleware.freertos-kernel
    select MCUX_COMPONENT_middleware.wireless.framework.heap_mem_manager if MCUX_COMPONENT_middleware.freertos-kernel
    select MCUX_PRJSEG_module.board.wireless.app_ble
    select MCUX_COMPONENT_component.osa
    select MCUX_COMPONENT_component.panic
    select MCUX_COMPONENT_middleware.wireless.ble_host
    select MCUX_COMPONENT_middleware.wireless.ble_hci_transport_rpmsg
    select MCUX_COMPONENT_middleware.wireless.controller_api
```
