## Kconfig
```kconfig
# Copyright 2025 NXP
#
# SPDX-License-Identifier: BSD-3-Clause

# External repository board, exclusive to the internal repository board
osource "${CUSTOM_BOARD_ROOT}/${board}/Kconfig"

# Internal repository board, exclusive to the external repository board
orsource "../${board_root}/${board}/Kconfig"

rsource "_common/Kconfig.interfaces"

menu "Project Segments"
rsource  "./_common/project_segments/common/Kconfig.prjseg"
orsource "../${board_root}/${board}/Kconfig.prjseg"
endmenu
```

## _boards/evk9mimx8ulp/Kconfig
```kconfig
# Copyright 2024 NXP
#
# SPDX-License-Identifier: BSD-3-Clause

rsource "Kconfig.defconfig"

config MCUX_HW_BOARD_evk9mimx8ulp
    bool
    default y
    imply MCUX_HW_DEVICE_MIMX8UD5
    imply MCUX_COMPONENT_driver.fusion if MCUX_HW_DEVICE_MIMX8ULP_CORE_ID_cm33
```

## _boards/evk9mimx8ulp/cm33/Kconfig.prjseg
```kconfig
# Copyright 2024 NXP
# All rights reserved.
#
# SPDX-License-Identifier: BSD-3-Clause

rsource "../../../_common/project_segments/dsp/Kconfig.prjseg"

config MCUX_PRJSEG_module.dsp_support
    select MCUX_COMPONENT_driver.dsp
```

## _boards/evk9mimx8ulp/project_segments/display_support/Kconfig.prjseg
```kconfig
# Copyright 2024 NXP
#
# SPDX-License-Identifier: BSD-3-Clause
#

config MCUX_PRJSEG_module.board.display_support
    select MCUX_COMPONENT_driver.display-rm68200
    select MCUX_COMPONENT_driver.display-hx8394
    select MCUX_COMPONENT_driver.lpi2c

if MCUX_PRJSEG_module.board.display_support

    config DEMO_PANEL
        int
        default 0 if MCUX_PRJSEG_module.board.display_support.RK055AHD091
        default 1 if MCUX_PRJSEG_module.board.display_support.RK055MHD091A0
        help
            Panel selection for display support
            No prefix in generated macro


    choice MCUX_PRJSEG_module.board.display_support.panel
        prompt "Panel Selection"
        default MCUX_PRJSEG_module.board.display_support.RK055MHD091A0

        config MCUX_PRJSEG_module.board.display_support.RK055AHD091
            bool "RK055AHD091-CTG"

        config MCUX_PRJSEG_module.board.display_support.RK055MHD091A0
            bool "RK055MHD091A0-CTG"

    endchoice


    config APP_DISPLAY_EXTERNAL_CONVERTOR
        bool "Use HDMI port"
        help
            No prefix in generated macro


endif
```

## _boards/evkbimxrt1050/Kconfig
```kconfig
# Copyright 2024 NXP
# All rights reserved.
#
# SPDX-License-Identifier: BSD-3-Clause

rsource "xip/Kconfig"
rsource "Kconfig.defconfig"

config MCUX_HW_BOARD_evkbimxrt1050
    bool
    default y
    imply MCUX_HW_DEVICE_MIMXRT1052

    imply MCUX_COMPONENT_driver.clock
    imply MCUX_COMPONENT_driver.igpio
    imply MCUX_COMPONENT_driver.iomuxc
    imply MCUX_COMPONENT_driver.dcdc_1
    imply MCUX_COMPONENT_driver.gpc_1
    imply MCUX_COMPONENT_driver.src
    imply MCUX_COMPONENT_driver.pmu
    select MCUX_COMPONENT_component.lpuart_adapter  if MCUX_COMPONENT_component.serial_manager_uart
    select MCUX_COMPONENT_component.lpuart_adapter  if MCUX_COMPONENT_utility.debug_console_lite
```

## _boards/evkbimxrt1050/Kconfig.prjseg
```kconfig
# Copyright 2024 NXP
# SPDX-License-Identifier: BSD-3-Clause

rsource "../../_common/project_segments/display_support/Kconfig.prjseg"
rsource "../../_common/project_segments/lvgl/Kconfig.prjseg"
rsource "../../lvgl_examples/lvgl_sdk/lvgl_support/rt10xx_elcdif/Kconfig.lvgl_support"
rsource "../../_common/project_segments/freertos/examples/tickless/Kconfig.prjseg"
```

## _boards/evkbmimxrt1060/project_segments/display_support/Kconfig.prjseg
```kconfig
config MCUX_PRJSEG_module.board.display_support
    select MCUX_COMPONENT_driver.dc-fb-elcdif
```

## _boards/evkbmimxrt1170/Kconfig
```kconfig
# Copyright 2024 NXP
# All rights reserved.
#
# SPDX-License-Identifier: BSD-3-Clause

rsource "${core_id}/Kconfig"
rsource "Kconfig.defconfig"
rsource "../../_common/project_segments/display_support/Kconfig.prjseg"
rsource "../../_common/project_segments/vglite_support/Kconfig.prjseg"
rsource "../../_common/project_segments/lvgl/Kconfig.prjseg"
rsource "../../_common/project_segments/freertos/examples/tickless/Kconfig.prjseg"
rsource "../../lvgl_examples/lvgl_sdk/lvgl_support/rt11xx/Kconfig.lvgl_support"

config MCUX_HW_BOARD_evkbmimxrt1170
    bool
    default y
    imply MCUX_HW_DEVICE_MIMXRT1176

    imply MCUX_COMPONENT_driver.clock
    imply MCUX_COMPONENT_driver.igpio
    imply MCUX_COMPONENT_driver.iomuxc
    imply MCUX_COMPONENT_driver.anatop_ai
    imply MCUX_COMPONENT_driver.memory
    imply MCUX_COMPONENT_driver.dcdc_2
    imply MCUX_COMPONENT_driver.gpc_xxx_ctrl
    imply MCUX_COMPONENT_driver.pgmc
    imply MCUX_COMPONENT_driver.anadig_pmu
    imply MCUX_COMPONENT_driver.src_2
    select MCUX_COMPONENT_component.lpuart_adapter  if MCUX_COMPONENT_component.serial_manager_uart
    select MCUX_COMPONENT_component.lpuart_adapter  if MCUX_COMPONENT_utility.debug_console_lite
```

## _boards/evkbmimxrt1170/Kconfig.sysbuild
```kconfig
config secondary_config
    string
    default "debug" if $(config) = "flexspi_nor_debug"
    default "release" if $(config) = "flexspi_nor_release"
    default "debug" if $(config) = "debug"
    default "release" if $(config) = "release"

config secondary_core_id
    string
    default "cm4" if $(core_id) = "cm7"
```

## _boards/evkbmimxrt1170/demo_apps/power_manager_test/multiCore_bm/core0/Kconfig.sysbuild
```kconfig
config secondary_core_id
    string
    default "cm4"

config secondary_config
    string
    default "debug"   if $(config) = "flexspi_nor_debug"
    default "release"   if $(config) = "flexspi_nor_release"
```

## _boards/evkbmimxrt1170/demo_apps/power_mode_switch/bm_dcdc/core0/Kconfig.sysbuild
```kconfig
config secondary_core_id
    string
    default "cm4"

config secondary_config
    string
```

## _boards/evkmcimx7ulp/Kconfig
```kconfig
# Copyright 2024 NXP
#
# SPDX-License-Identifier: BSD-3-Clause

rsource "Kconfig.defconfig"

config MCUX_HW_BOARD_evkmcimx7ulp
    bool
    default y
    imply MCUX_HW_DEVICE_MCIMX7U5
```

## _boards/evkmcimx7ulp/Kconfig.prjseg
```kconfig
# Copyright 2024 NXP
# SPDX-License-Identifier: BSD-3-Clause

rsource "../../_common/project_segments/freertos/examples/tickless/Kconfig.prjseg"
```

## _boards/evkmimx8mm/Kconfig
```kconfig
# Copyright 2024 NXP
#
# SPDX-License-Identifier: BSD-3-Clause

rsource "Kconfig.defconfig"


config MCUX_HW_BOARD_evkmimx8mm
    bool
    default y
    imply MCUX_HW_DEVICE_MIMX8MM6
    imply MCUX_COMPONENT_driver.igpio
```

## _boards/evkmimx8mn/Kconfig
```kconfig
# Copyright 2024 NXP
#
# SPDX-License-Identifier: BSD-3-Clause

rsource "Kconfig.defconfig"

config MCUX_HW_BOARD_evkmimx8mn
    bool
    default y
    imply MCUX_HW_DEVICE_MIMX8MN6
    imply MCUX_COMPONENT_driver.igpio
```

## _boards/evkmimx8mp/Kconfig
```kconfig
# Copyright 2024 NXP
#
# SPDX-License-Identifier: BSD-3-Clause

rsource "Kconfig.defconfig"

config MCUX_HW_BOARD_evkmimx8mp
    bool
    default y
    imply MCUX_HW_DEVICE_MIMX8ML8
```

## _boards/evkmimx8mq/Kconfig
```kconfig
# Copyright 2024 NXP
# All rights reserved.
#
# SPDX-License-Identifier: BSD-3-Clause

rsource "Kconfig.defconfig"
rsource "../../_common/project_segments/freertos/examples/tickless/Kconfig.prjseg"

config MCUX_HW_BOARD_evkmimx8mq
    bool
    default y
    imply MCUX_HW_DEVICE_MIMX8MQ6
```

## _boards/evkmimx8ulp/Kconfig
```kconfig
# Copyright 2024 NXP
# All rights reserved.
#
# SPDX-License-Identifier: BSD-3-Clause

rsource "Kconfig.defconfig"

config MCUX_HW_BOARD_evkmimx8ulp
    bool
    default y
    imply MCUX_HW_DEVICE_MIMX8UD7
    imply MCUX_COMPONENT_driver.fusion if MCUX_HW_DEVICE_MIMX8ULP_CORE_ID_cm33
```

## _boards/evkmimx8ulp/Kconfig.prjseg
```kconfig
# Copyright 2024 NXP
#
# SPDX-License-Identifier: BSD-3-Clause

orsource "${core_id}/Kconfig.prjseg"

rsource "../../_common/project_segments/display_support/Kconfig.prjseg"
```

## _boards/evkmimx8ulp/Kconfig.sysbuild
```kconfig
config dsp_config
    string
    default "debug" if $(config) = "debug"
    default "release" if $(config) = "release"
    default "debug" if $(config) = "flash_debug"
    default "release" if $(config) = "flash_release"

config dsp_core_id
    string
    default "fusionf1" if $(core_id) = "cm33"
```

## _boards/evkmimxrt1015/Kconfig
```kconfig
# Copyright 2024 NXP
# All rights reserved.
#
# SPDX-License-Identifier: BSD-3-Clause

rsource "xip/Kconfig"
rsource "Kconfig.defconfig"
rsource "../../_common/project_segments/lvgl/Kconfig.prjseg"
rsource "../../_common/project_segments/freertos/examples/tickless/Kconfig.prjseg"
rsource "../../lvgl_examples/lvgl_sdk/lvgl_support/rt101x_lpspi/Kconfig.lvgl_support"

config MCUX_HW_BOARD_evkmimxrt1015
    bool
    default y
    imply MCUX_HW_DEVICE_MIMXRT1015

    imply MCUX_COMPONENT_driver.clock
    imply MCUX_COMPONENT_driver.igpio
    imply MCUX_COMPONENT_driver.iomuxc
    imply MCUX_COMPONENT_driver.dcdc_1
    imply MCUX_COMPONENT_driver.gpc_1
    imply MCUX_COMPONENT_driver.src
    imply MCUX_COMPONENT_driver.pmu
    select MCUX_COMPONENT_component.lpuart_adapter  if MCUX_COMPONENT_component.serial_manager_uart
    select MCUX_COMPONENT_component.lpuart_adapter  if MCUX_COMPONENT_utility.debug_console_lite
```
