## _common/project_segments/ezhv/Kconfig.prjseg
```kconfig
# Copyright 2024 NXP
#
# SPDX-License-Identifier: BSD-3-Clause

config MCUX_PRJSEG_module.ezhv_support
    bool "Use ${board_root}/${board}/ezhv_examples/ezhv_support[.c|.h]"

config MCUX_PRJSEG_module.incbin.ezhv
    bool "Use ${board_root}/${board}/ezhv_examples/incbin_ezhv.S"
```

## _common/project_segments/lvgl/Kconfig.prjseg
```kconfig
# Copyright 2024 NXP
#
# SPDX-License-Identifier: BSD-3-Clause

menuconfig MCUX_PRJSEG_module.board.lvgl
    bool "Enable LVGL Support"
    select MCUX_COMPONENT_middleware.lvgl

orsource "../../../../${board_root}/${board}/project_segments/lvgl/Kconfig.prjseg"
```

## _common/project_segments/multicore/Kconfig.prjseg
```kconfig
config MCUX_PRJSEG_module.core1_support
    bool "Use boards/${board}/core1_support.c"
```

## _common/project_segments/ota_examples/mcxn_boards/Kconfig.prjseg
```kconfig
# Copyright 2024-2025 NXP
#
# SPDX-License-Identifier: BSD-3-Clause

# MCUboot application - default config
config MCUX_PRJSEG_module.board.ota_examples.mcxn.default_linker_mcuboot
    bool
    default y
    depends on !MCUX_COMPONENT_middleware.mcuboot.mcxn_custom_cfg.main_flash_only
    depends on MCUX_COMPONENT_middleware.mcuboot.bootutil
    depends on !MCUX_COMPONENT_middleware.mcuboot.nxp_app_support
    help
      Use default mcuboot linker - bootloader located in IFR region

# MCUboot application - custom config
config MCUX_PRJSEG_module.board.ota_examples.mcxn.custom_linker_mcuboot
    bool
    default y
    depends on MCUX_COMPONENT_middleware.mcuboot.mcxn_custom_cfg.main_flash_only
    depends on MCUX_COMPONENT_middleware.mcuboot.bootutil
    depends on !MCUX_COMPONENT_middleware.mcuboot.nxp_app_support
    help
      Use custom mcuboot linker - bootloader located in main flash

# OTA application - default config
config MCUX_PRJSEG_module.board.ota_examples.mcxn.default_linker_application
    bool
    default y
    depends on !MCUX_COMPONENT_middleware.mcuboot.mcxn_custom_cfg.main_flash_only
    depends on !MCUX_COMPONENT_middleware.mcuboot.bootutil
    depends on MCUX_COMPONENT_middleware.mcuboot.nxp_app_support
    help
      Use default ota app linker - bootloader located in IFR region

# OTA application - custom config
config MCUX_PRJSEG_module.board.ota_examples.mcxn.custom_linker_application
    bool
    default y
    depends on MCUX_COMPONENT_middleware.mcuboot.mcxn_custom_cfg.main_flash_only
    depends on !MCUX_COMPONENT_middleware.mcuboot.bootutil
    depends on MCUX_COMPONENT_middleware.mcuboot.nxp_app_support
    help
      Use custom ota app linker - bootloader located in main flash
```

## _common/project_segments/pmic/Kconfig.prjseg
```kconfig
config MCUX_PRJSEG_module.pmic_support
    bool "Use boards/${board}/pmic_support.c"
```

## _common/project_segments/vglite_support/Kconfig.prjseg
```kconfig
# Copyright 2024 NXP
# All rights reserved.
#
# SPDX-License-Identifier: BSD-3-Clause

config MCUX_PRJSEG_module.board.vglite_support
    bool "Enable VGLite Configuration Support"
```

## _common/project_segments/wireless/Kconfig.prjseg
```kconfig
# Copyright 2024 NXP
# SPDX-License-Identifier: BSD-3-Clause

config MCUX_PRJSEG_module.board.wireless.linker_script
    bool "Connectivity linker script"
    help
      Use the linker script provided by the Connectivity Framework for the current platform.
      This should be left disabled if the user wants to use a custom linker script.

config MCUX_PRJSEG_module.board.wireless.linker_script_ble
    bool "Connectivity linker script for bluetooth"
    help
      Use the linker script provided by the Connectivity Framework for the current platform in case of bluetooth examples.
      This should be left disabled if the user wants to use a custom linker script.

config MCUX_PRJSEG_module.board.wireless.core_linker_script
    bool "Connectivity linker script for specific core"
    help
      Use the linker script provided by the Connectivity Framework for the current platform core.
      This should be left disabled if the user wants to use a custom linker script.
```

## _common/project_segments/wireless/mcxw23/Kconfig.prjseg
```kconfig
# Copyright 2025 NXP
# SPDX-License-Identifier: BSD-3-Clause

config MCUX_PRJSEG_module.board.wireless.app_services
    bool "Wireless Application Services"
    depends on MCUX_PRJSEG_module.board.wireless.board
    help
      This is a collection of APP helpers used in wireless examples to abstract the initialization flow of
      some software components acting like services. This is a template for demo purpose and doesn't aim to
      always support all use cases.

config MCUX_PRJSEG_module.board.wireless.app_ble
    bool "Wireless BLE Application"
    depends on MCUX_PRJSEG_module.board.wireless.board
    select MCUX_COMPONENT_middleware.wireless.framework.platform.ble
    help
      This is a collection of APP helpers used in wireless examples to abstract the initialization flow of
      NXP BLE software components.

menuconfig MCUX_PRJSEG_module.board.wireless.board
    bool "wireless connectivity board files"
    select MCUX_COMPONENT_middleware.wireless.framework
    select MCUX_COMPONENT_middleware.wireless.framework.platform
    depends on !MCUX_PRJSEG_module.board.boardfile
    help
      This is a customized implementation of board file used in wireless examples.

if MCUX_PRJSEG_module.board.wireless.board
  config MCUX_PRJSEG_module.board.wireless.board.components
      bool "Components: Serial Manager, LED, Button"
      default y
      select MCUX_COMPONENT_component.led
      select MCUX_COMPONENT_component.button
      select MCUX_COMPONENT_component.serial_manager
      select MCUX_COMPONENT_component.timer_manager
      select MCUX_COMPONENT_component.lpc_gpio_adapter
    help
      This is a wireless implementation of board file used in wireless examples for components usage such as Serial Manager, LED, Button

  config MCUX_PRJSEG_module.board.wireless.board.lowpower
      bool "Lowpower"
      select MCUX_COMPONENT_middleware.wireless.framework.platform.lowpower
      select MCUX_COMPONENT_middleware.wireless.framework.seclib_rng
      select MCUX_COMPONENT_component.timer_manager
      select MCUX_COMPONENT_component.power_manager_framework
endif

config MCUX_PRJSEG_module.board.wireless.hw_app
    bool "Specific HW init and app common for wireless applications"
    depends on MCUX_COMPONENT_middleware.wireless.framework
    depends on MCUX_PRJSEG_project.hw_app_customize_folder
    help
      This is a customized implementation of hardware init used in wireless examples.

config MCUX_PRJSEG_module.board.wireless.board.extflash
    bool "External flash"
    select MCUX_COMPONENT_component.flash_nor_spifi

orsource "../../../../../${board_root}/${board}/project_segments/wireless/Kconfig.prjseg"
```

## _common/project_segments/wireless/wireless_mcu/cm33_core1/Kconfig.prjseg
```kconfig
# Copyright 2024-2025 NXP
# SPDX-License-Identifier: BSD-3-Clause

rsource "../../wireless_nbu/Kconfig.prjseg"
```

## _common/project_segments/wireless/wireless_nbu/Kconfig.prjseg
```kconfig
# Copyright 2025 NXP
# SPDX-License-Identifier: BSD-3-Clause

config MCUX_PRJSEG_module.board.wireless.nbu.app.threadx
    bool "Wireless NBU Application Main"
    help
      Provides an implementation of the main entry point for an NBU application running ThreadX.
      Creates an idle task which can call the application with a hook, and provides Pre and Post kernel
      initialization stages to the application.
      This is a template for demo purpose and doesn't aim to always support all use cases.

config MCUX_PRJSEG_module.board.wireless.hw_app
    bool "Specific HW init for Wireless NBU applications"
    help
      This is a customized implementation of hardware init used in wireless examples.

config MCUX_PRJSEG_module.board.wireless.board
    bool "Wireless NBU board files"
    help
      This is a customized implementation of board file used in wireless examples.
```

## audio_examples/Kconfig
```kconfig
menu "Configs"
    config MCUX_PRJSEG_module.audio_voice.default_config
        bool "Default config"

    config MCUX_PRJSEG_module.audio_voice.lpc_config
        bool "LPC config"
endmenu

config MCUX_PRJSEG_MAESTRO_EXAMPLE_MAESTRO_LOGGING_ON
    bool "Turns on logging of Maestro library"
    default n

menu "VIT model packs"
    depends on MCUX_PRJSEG_middleware.audio_voice.components.vit

    config MAESTRO_EXAMPLE_VIT_MODEL_ALL_ENABLE
        bool "Enables all model packs"
        select MCUX_PRJSEG_MAESTRO_EXAMPLE_VIT_MODEL_EN_ENABLE
        select MCUX_PRJSEG_MAESTRO_EXAMPLE_VIT_MODEL_CN_ENABLE
        select MCUX_PRJSEG_MAESTRO_EXAMPLE_VIT_MODEL_DE_ENABLE
        select MCUX_PRJSEG_MAESTRO_EXAMPLE_VIT_MODEL_ES_ENABLE
        select MCUX_PRJSEG_MAESTRO_EXAMPLE_VIT_MODEL_FR_ENABLE
        select MCUX_PRJSEG_MAESTRO_EXAMPLE_VIT_MODEL_IT_ENABLE
        select MCUX_PRJSEG_MAESTRO_EXAMPLE_VIT_MODEL_JA_ENABLE
        select MCUX_PRJSEG_MAESTRO_EXAMPLE_VIT_MODEL_KO_ENABLE
        select MCUX_PRJSEG_MAESTRO_EXAMPLE_VIT_MODEL_PT_ENABLE
        select MCUX_PRJSEG_MAESTRO_EXAMPLE_VIT_MODEL_TR_ENABLE
        default n

    config MCUX_PRJSEG_MAESTRO_EXAMPLE_VIT_MODEL_EN_ENABLE
        bool "Enables English model pack"
        default n

    config MCUX_PRJSEG_MAESTRO_EXAMPLE_VIT_MODEL_CN_ENABLE
        bool "Enables Chinese model pack"
        default n

    config MCUX_PRJSEG_MAESTRO_EXAMPLE_VIT_MODEL_DE_ENABLE
        bool "Enables Deutch model pack"
        default n

    config MCUX_PRJSEG_MAESTRO_EXAMPLE_VIT_MODEL_ES_ENABLE
        bool "Enables Espanol model pack"
        default n

    config MCUX_PRJSEG_MAESTRO_EXAMPLE_VIT_MODEL_FR_ENABLE
        bool "Enables French model pack"
        default n

    config MCUX_PRJSEG_MAESTRO_EXAMPLE_VIT_MODEL_IT_ENABLE
        bool "Enables Italian model pack"
        default n

    config MCUX_PRJSEG_MAESTRO_EXAMPLE_VIT_MODEL_JA_ENABLE
        bool "Enables Japaneese model pack"
        default n

    config MCUX_PRJSEG_MAESTRO_EXAMPLE_VIT_MODEL_KO_ENABLE
        bool "Enables Korean model pack"
        default n

    config MCUX_PRJSEG_MAESTRO_EXAMPLE_VIT_MODEL_PT_ENABLE
        bool "Enables Portuguese model pack"
        default n

    config MCUX_PRJSEG_MAESTRO_EXAMPLE_VIT_MODEL_TR_ENABLE
        bool "Enables Turkish model pack"
        default n
endmenu
```

## audio_examples/maestro_record/Kconfig
```kconfig
menu "Maestro record"
    osource "examples/audio_examples/Kconfig"

    # Board example specific Kconfig can be linked in this way if needed
    osource "${SdkRootDirPath}/${project_board_port_path}/Kconfig"

endmenu

# Need to refer the root Kconfig.mcuxpreso to get all Kconfig data
source "Kconfig"
```

## audio_examples/maestro_sync/Kconfig
```kconfig
menu "Maestro sync"
    osource "examples/audio_examples/Kconfig"

    # Board example specific Kconfig can be linked in this way if needed
    osource "${SdkRootDirPath}/${project_board_port_path}/Kconfig"

endmenu

# Need to refer the root Kconfig.mcuxpreso to get all Kconfig data
source "Kconfig"
```

## ce_examples/basic_test/Kconfig
```kconfig
# It is optional to provide example specific Kconfig.

mainmenu "CE basic test"

# Need to refer the root Kconfig.mcuxpreso to get all Kconfig data
source "${SdkRootDirPath}/Kconfig.mcuxpresso"

# Board example specific Kconfig can be linked in this way if needed
osource "${SdkRootDirPath}/${project_board_port_path}/Kconfig"
```

## cmsis_driver_examples/enet/txrx_transfer/Kconfig
```kconfig
# Copyright 2025 NXP
#
# SPDX-License-Identifier: BSD-3-Clause

menu "Project Settings"

config APP_USER_DEFINED_MAC_ADDRESS
    bool "MAC Address Defined by User"
    default n
    help
        No prefix in generated macro

config APP_MAC_ADDRESS
    string "MAC Address Byte Array"
    default "{0x54, 0x27, 0x8d, 0x00, 0x00, 0x00}"
    depends on APP_USER_DEFINED_MAC_ADDRESS
    help
        No prefix in generated macro

endmenu

source "${SdkRootDirPath}/Kconfig.mcuxpresso"
```

## component_examples/i3c_bus/master/Kconfig
```kconfig
# Copyright 2025 NXP
#
# SPDX-License-Identifier: BSD-3-Clause

menu "Project Settings"

config EXAMPLE_I2C_BAUDRATE
    int "I2C mode baud rate"
    default 400000
    help
        No prefix in generated macro
        type unsigned

config EXAMPLE_I3C_OD_BAUDRATE
    int "I3C open-drain mode baud rate"
    default 2000000
    help
        No prefix in generated macro
        type unsigned

config EXAMPLE_I3C_PP_BAUDRATE
    int "I3C push-pull mode baud rate"
    default 4000000
    help
        No prefix in generated macro
        type unsigned

endmenu

source "${SdkRootDirPath}/Kconfig.mcuxpresso"
```

## component_examples/i3c_bus/slave/Kconfig
```kconfig
# Copyright 2025 NXP
#
# SPDX-License-Identifier: BSD-3-Clause

menu "Project Settings"

config EXAMPLE_I2C_BAUDRATE
    int "I2C mode baud rate"
    default 400000
    help
        No prefix in generated macro
        type unsigned

config EXAMPLE_I3C_OD_BAUDRATE
    int "I3C open-drain mode baud rate"
    default 2000000
    help
        No prefix in generated macro
        type unsigned

config EXAMPLE_I3C_PP_BAUDRATE
    int "I3C push-pull mode baud rate"
    default 4000000
    help
        No prefix in generated macro
        type unsigned

config EXAMPLE_EVENT_WAIT_DELAY_NS
    int "Time delay count with us to ensure status flag is ready"
    default 10000
    help
        No prefix in generated macro
        type unsigned

endmenu

source "${SdkRootDirPath}/Kconfig.mcuxpresso"
```

## component_examples/mpi_loader/dsp_hello_world/loader/Kconfig.sysbuild
```kconfig
#
# Copyright 2024 NXP
#
# SPDX-License-Identifier: BSD-3-Clause

rsource "../../../../dsp_examples/Kconfig.sysbuild"
```

## demo_apps/power_mode_switch_rt1xxx/rt1170/bm_pmic/core0/Kconfig.sysbuild
```kconfig
config secondary_board
    string
    default "$(board)"

config secondary_toolchain
    string
    default "$(toolchain)"

source "${SdkRootDirPath}/${board_root}/${board}/Kconfig.sysbuild"
```

## demo_apps/power_mode_switch_rt1xxx/rt1180/bm_dcdc/core0/Kconfig.sysbuild
```kconfig
#
# Copyright 2024 NXP
#
# SPDX-License-Identifier: BSD-3-Clause

config secondary_board
    string
    default "$(board)"

config secondary_toolchain
    string
    default "$(toolchain)"

source "${SdkRootDirPath}/${board_root}/${board}/Kconfig.sysbuild"
```

## demo_apps/tee_fault/core0/Kconfig.sysbuild
```kconfig
config secondary_board
    string
    default "$(board)"

config secondary_toolchain
    string
    default "$(toolchain)"

source "${SdkRootDirPath}/${board_root}/${board}/demo_apps/tee_fault/core0/Kconfig.sysbuild"
```

## driver_examples/adc12/lpit_trgmux/Kconfig
```kconfig
# Copyright 2024 NXP
#
# SPDX-License-Identifier: BSD-3-Clause

menu "Project Settings"

config LPIT_TRIGGER_TIME
    int "LPIT Trigger Period in us"
    default 1000000
    help
        No prefix in generated macro
        type unsigned

endmenu

source "${SdkRootDirPath}/Kconfig.mcuxpresso"
```

## driver_examples/adc16/continuous_dma/Kconfig
```kconfig
# Copyright 2024 NXP
#
# SPDX-License-Identifier: BSD-3-Clause

menu "Project Settings"

config DEMO_ADC16_SAMPLE_COUNT
    int "ADC16 Sample Count"
    default 16
    help
        No prefix in generated macro
        type unsigned

endmenu

source "${SdkRootDirPath}/Kconfig.mcuxpresso"
```

## driver_examples/adc_etc/hardware_trigger_conv/adc/Kconfig
```kconfig
# Copyright 2024 NXP
#
# SPDX-License-Identifier: BSD-3-Clause

menu "Project Settings"

config ADC_ETC_DONE0_FLAG
    hex "ADC ETC Conversion Done Flag 0"
    default 0x1
    help
        No prefix in generated macro
        type unsigned

config ADC_ETC_DONE1_FLAG
    hex "ADC ETC Conversion Done Flag 1"
    default 0x2
    help
        No prefix in generated macro
        type unsigned

endmenu

source "${SdkRootDirPath}/Kconfig.mcuxpresso"
```
